/**
 * @file UIBuilder.cpp
 * @ingroup ui
 * @brief Dynamic gauge engine implementation.
 */
#include "UIBuilder.h"

#include "ButtonManager.h"
#include "ConfigManager.h"
#include "DisplayManager.h"
#include "HardwareConfig.h"
#include "MasterPacket.h"
#include "Palette.h"
#include "TouchManager.h"
#include "TelemetryStore.h"
#include "Textures.h"   // generated by tools/make_assets.py

UIBuilder UI;

/* ═══════════════════════════════ helpers ═════════════════════════════════ */

/**
 * @brief Parse a "#RRGGBB" string from the layout.
 * @param s        Candidate string; may be null or malformed.
 * @param fallback Returned when @p s is not a valid 7-character hex color.
 * @return The parsed color, or @p fallback.
 */
static lv_color_t colorFromHex(const char *s, lv_color_t fallback) {
    if (!s || s[0] != '#' || strlen(s) < 7) return fallback;
    uint32_t rgb = strtoul(s + 1, nullptr, 16);
    return lv_color_hex(rgb);
}

/**
 * @brief Read a metric ID written either as "0x010C" or as a number.
 * @param v JSON value holding the ID.
 * @return The 16-bit metric ID, or 0 when unparseable.
 */
static uint16_t parseMetricId(JsonVariantConst v) {
    if (v.is<const char *>())
        return (uint16_t)strtoul(v.as<const char *>(), nullptr, 0);
    return v.as<uint16_t>();
}

/**
 * @brief Map a layout easing name onto an LVGL animation path.
 * @param name One of linear, ease_in, ease_out, ease_in_out, overshoot, bounce.
 * @return The matching path callback; ease-out when unrecognized.
 */
static lv_anim_path_cb_t easingFromName(const char *name) {
    if (!name)                        return lv_anim_path_ease_out;
    if (!strcmp(name, "linear"))      return lv_anim_path_linear;
    if (!strcmp(name, "ease_in"))     return lv_anim_path_ease_in;
    if (!strcmp(name, "ease_in_out")) return lv_anim_path_ease_in_out;
    if (!strcmp(name, "overshoot"))   return lv_anim_path_overshoot;
    if (!strcmp(name, "bounce"))      return lv_anim_path_bounce;
    return lv_anim_path_ease_out;
}

/**
 * @brief Map a requested pixel size onto the nearest compiled-in font.
 * @param px Desired size in pixels.
 * @return The closest enabled Montserrat face; never null.
 */
static const lv_font_t *fontForSize(int px) {
    struct { int sz; const lv_font_t *f; } table[] = {
        {12, &lv_font_montserrat_12}, {14, &lv_font_montserrat_14},
        {16, &lv_font_montserrat_16}, {20, &lv_font_montserrat_20},
        {24, &lv_font_montserrat_24}, {28, &lv_font_montserrat_28},
        {32, &lv_font_montserrat_32}, {40, &lv_font_montserrat_40},
        {48, &lv_font_montserrat_48},
    };
    const lv_font_t *best = table[0].f;
    int bestErr = 999;
    for (auto &e : table) {
        int err = abs(e.sz - px);
        if (err < bestErr) { bestErr = err; best = e.f; }
    }
    return best;
}

/**
 * @brief Format a metric value for display.
 * @param[out] out Destination buffer.
 * @param n        Buffer size.
 * @param v        Value; NaN renders as "--".
 * @param decimals Decimal places.
 */
static void formatValue(char *out, size_t n, float v, uint8_t decimals) {
    if (isnan(v)) { strlcpy(out, "--", n); return; }
    snprintf(out, n, "%.*f", decimals, v);
}

/**
 * @brief Create a styled, aligned label in one call.
 * @param parent Container to attach to.
 * @param txt    Initial text.
 * @param font   Face to render with.
 * @param color  Text color.
 * @param align  LVGL alignment anchor.
 * @param x      X offset from the anchor.
 * @param y      Y offset from the anchor.
 * @return The new label.
 */
static lv_obj_t *makeLabel(lv_obj_t *parent, const char *txt,
                           const lv_font_t *font, lv_color_t color,
                           lv_align_t align, int x, int y) {
    lv_obj_t *l = lv_label_create(parent);
    lv_label_set_text(l, txt);
    lv_obj_set_style_text_font(l, font, 0);
    lv_obj_set_style_text_color(l, color, 0);
    lv_obj_align(l, align, x, y);
    return l;
}

/** @name Animation exec callbacks
 *  Each takes the animated object as @p obj and the current value as @p v.
 *  @{ */
/** @brief Animate an arc indicator's opacity. @param obj Arc. @param v Opacity. */
static void animArcOpa(void *obj, int32_t v) {
    lv_obj_set_style_arc_opa((lv_obj_t *)obj, (lv_opa_t)v, LV_PART_INDICATOR);
}
/** @brief Animate a label's opacity. @param obj Label. @param v Opacity. */
static void animTextOpa(void *obj, int32_t v) {
    lv_obj_set_style_text_opa((lv_obj_t *)obj, (lv_opa_t)v, 0);
}
/** @brief Animate a border's opacity. @param obj Object. @param v Opacity. */
static void animBorderOpa(void *obj, int32_t v) {
    lv_obj_set_style_border_opa((lv_obj_t *)obj, (lv_opa_t)v, 0);
}
/** @} */

/**
 * @brief Draw-time hook rewriting meter tick labels (8000 rpm shown as "8").
 * @param e LVGL draw event; its user_data points at the binding's divisor.
 */
static void meterTickLabelCb(lv_event_t *e) {
    auto *dsc = lv_event_get_draw_part_dsc(e);
    if (dsc->class_p != &lv_meter_class || dsc->type != LV_METER_DRAW_PART_TICK)
        return;
    if (!dsc->text) return;
    float div = *(float *)lv_event_get_user_data(e);
    if (div <= 1.0f) return;
    lv_snprintf(dsc->text, 16, "%d", (int)lroundf(dsc->value / div));
}

/** @name Lamp images
 *  @{ */
/** Colour value meaning "hidden" in a lamp's change guard. */
static constexpr uint32_t LAMP_HIDDEN = 0xFFFFFFFFu;

/**
 * @brief Create a lamp symbol: a 24x24 alpha mask coloured by img_recolor.
 * @param parent Container.
 * @param icon   @ref LampIcon.
 * @param x      Left edge.
 * @param y      Top edge.
 * @return The image, drawn in the unlit colour.
 */
static lv_obj_t *makeLamp(lv_obj_t *parent, uint8_t icon, int x, int y) {
    lv_obj_t *img = lv_img_create(parent);
    lv_img_set_src(img, Telltales::iconImage(icon));
    lv_obj_set_pos(img, x, y);
    lv_obj_set_style_img_recolor(img, lv_color_hex(UI_LAMP_OFF), 0);
    lv_obj_set_style_img_recolor_opa(img, LV_OPA_COVER, 0);
    lv_obj_clear_flag(img, LV_OBJ_FLAG_CLICKABLE);
    return img;
}

/**
 * @brief Colour or hide a lamp, touching LVGL only when something changed.
 * @param img   Lamp image; nullptr is ignored.
 * @param cache Last value written, updated here.
 * @param rgb   0xRRGGBB, or LAMP_HIDDEN.
 */
static void setLamp(lv_obj_t *img, uint32_t &cache, uint32_t rgb) {
    if (!img || cache == rgb) return;
    if (rgb == LAMP_HIDDEN) {
        lv_obj_add_flag(img, LV_OBJ_FLAG_HIDDEN);
    } else {
        if (cache == LAMP_HIDDEN) lv_obj_clear_flag(img, LV_OBJ_FLAG_HIDDEN);
        lv_obj_set_style_img_recolor(img, lv_color_hex(rgb), 0);
    }
    cache = rgb;
}

/** @brief `"part": false` in the layout switches a part off. */
static bool partOff(JsonVariant v) { return v.is<bool>() && !v.as<bool>(); }
/** @} */

/* ═══════════════════════ landscape design system ══════════════════════════
 *
 * One set of measures for every screen, so eight screens read as one
 * instrument rather than eight experiments:
 *
 *   - a header band across the top holds the screen's title on the left and
 *     the warning lamps on the right, so a lamp never sits over a reading;
 *   - content lives in rounded panels on a common margin and gutter;
 *   - anything with a needle is the round board's dial - carbon face with a
 *     lit hub, bezel, the same ticks, numerals, zones and red needle - so the
 *     two displays are plainly the same family;
 *   - text has three levels only: small spaced captions, big white values,
 *     muted units.
 */
namespace ds {
constexpr int MARGIN  = 12;    /**< Screen edge to panel.                    */
constexpr int GUTTER  = 8;     /**< Between panels.                          */
constexpr int TOP     = 38;    /**< Content starts below the header band.    */
constexpr int BOTTOM  = 252;   /**< ...and ends above the page dots.         */
constexpr int RADIUS  = 12;    /**< Panel corners.                           */
constexpr int FACE_D  = 248;   /**< tex_dial_face.                           */
constexpr int METER_D = 236;   /**< The scale inside it, as on the round.    */
}

/**
 * @brief A rounded panel, the container every landscape reading sits in.
 * @return The panel; children are positioned inside it.
 */
static lv_obj_t *makeCard(lv_obj_t *parent, int x, int y, int w, int h) {
    lv_obj_t *c = lv_obj_create(parent);
    lv_obj_remove_style_all(c);
    lv_obj_set_pos(c, x, y);
    lv_obj_set_size(c, w, h);
    lv_obj_set_style_radius(c, ds::RADIUS, 0);
    lv_obj_set_style_bg_color(c, lv_color_hex(UI_CARD), 0);
    lv_obj_set_style_bg_grad_color(c, lv_color_hex(UI_CARD_LOW), 0);
    lv_obj_set_style_bg_grad_dir(c, LV_GRAD_DIR_VER, 0);
    lv_obj_set_style_bg_opa(c, LV_OPA_COVER, 0);
    lv_obj_set_style_border_width(c, 1, 0);
    lv_obj_set_style_border_color(c, lv_color_hex(UI_LINE_SOFT), 0);
    lv_obj_set_style_border_opa(c, LV_OPA_COVER, 0);
    lv_obj_clear_flag(c, LV_OBJ_FLAG_SCROLLABLE | LV_OBJ_FLAG_CLICKABLE);
    return c;
}

/** @brief A 1 px separator inside a panel. */
static lv_obj_t *makeRule(lv_obj_t *parent, int x, int y, int w) {
    lv_obj_t *r = lv_obj_create(parent);
    lv_obj_remove_style_all(r);
    lv_obj_set_pos(r, x, y);
    lv_obj_set_size(r, w, 1);
    lv_obj_set_style_bg_color(r, lv_color_hex(UI_LINE_SOFT), 0);
    lv_obj_set_style_bg_opa(r, LV_OPA_COVER, 0);
    lv_obj_clear_flag(r, LV_OBJ_FLAG_SCROLLABLE | LV_OBJ_FLAG_CLICKABLE);
    return r;
}

/** @brief A caption: small, muted, letter-spaced. */
static lv_obj_t *makeCaption(lv_obj_t *parent, const char *txt, lv_align_t align,
                             int x, int y) {
    lv_obj_t *l = makeLabel(parent, txt, &lv_font_montserrat_12,
                            lv_color_hex(UI_MUTED), align, x, y);
    lv_obj_set_style_text_letter_space(l, 1, 0);
    return l;
}

/**
 * @brief The title for a screen's header: its label, or failing that its id
 *        in capitals with '_' as spaces ("load_trend" -> "LOAD TREND").
 */
static String screenTitle(JsonObject cfg, const char *fallback = "") {
    const char *label = cfg["label"] | (const char *)nullptr;
    if (label && label[0]) return String(label);
    const char *id = cfg["id"] | (const char *)nullptr;
    if (!id || !id[0]) return String(fallback);
    String t(id);
    t.replace("_", " ");
    t.toUpperCase();
    return t;
}

/** @brief The screen's title, left in the header band. */
static void addHeader(lv_obj_t *root, const char *title) {
    if (!title || !title[0]) return;
    lv_obj_t *l = makeLabel(root, title, &lv_font_montserrat_14,
                            lv_color_hex(UI_MUTED), LV_ALIGN_TOP_LEFT,
                            ds::MARGIN + 2, 11);
    lv_obj_set_style_text_letter_space(l, 1, 0);
}

/** @brief The dial's carbon face and bezel, centred on (cx, cy). */
static void makeFace(lv_obj_t *parent, int cx, int cy) {
    lv_obj_t *img = lv_img_create(parent);
    lv_img_set_src(img, &tex_dial_face);
    lv_obj_set_pos(img, cx - ds::FACE_D / 2, cy - ds::FACE_D / 2);
    lv_obj_clear_flag(img, LV_OBJ_FLAG_CLICKABLE);

    // The bezel covers the chroma-keyed edge and gives the dial its rim.
    lv_obj_t *ring = lv_obj_create(parent);
    lv_obj_remove_style_all(ring);
    lv_obj_set_size(ring, ds::FACE_D + 4, ds::FACE_D + 4);
    lv_obj_set_pos(ring, cx - ds::FACE_D / 2 - 2, cy - ds::FACE_D / 2 - 2);
    lv_obj_set_style_radius(ring, LV_RADIUS_CIRCLE, 0);
    lv_obj_set_style_border_width(ring, 3, 0);
    lv_obj_set_style_border_color(ring, lv_color_hex(UI_LINE), 0);
    lv_obj_set_style_border_opa(ring, LV_OPA_COVER, 0);
    lv_obj_clear_flag(ring, LV_OBJ_FLAG_SCROLLABLE | LV_OBJ_FLAG_CLICKABLE);
}

/**
 * @brief The round board's instrument: face (optional) and a transparent
 *        meter sized and styled as on the round tach.
 * @return The meter; the caller adds the scale, zones and needle.
 */
static lv_obj_t *makeDial(lv_obj_t *parent, int cx, int cy, bool face) {
    if (face) makeFace(parent, cx, cy);
    lv_obj_t *m = lv_meter_create(parent);
    lv_obj_set_size(m, ds::METER_D, ds::METER_D);
    lv_obj_set_pos(m, cx - ds::METER_D / 2, cy - ds::METER_D / 2);
    lv_obj_set_style_bg_opa(m, LV_OPA_TRANSP, 0);
    lv_obj_set_style_border_width(m, 0, 0);
    lv_obj_set_style_pad_all(m, 0, 0);
    lv_obj_set_style_text_font(m, &lv_font_montserrat_14, LV_PART_TICKS);
    // Set outright: the day theme's dark text colour would otherwise reach
    // the numerals and all but hide them on the carbon face.
    lv_obj_set_style_text_color(m, lv_color_hex(UI_TEXT_DIM), LV_PART_TICKS);
    // A dark centre cap by day and by night (the night theme made it white).
    lv_obj_set_style_bg_color(m, lv_color_hex(UI_LINE), LV_PART_INDICATOR);
    lv_obj_clear_flag(m, LV_OBJ_FLAG_CLICKABLE);
    return m;
}

/**
 * @brief The round tach's scale: minor and major ticks, numerals, range.
 *
 * Every tick is redrawn whenever the needle moves across it, so a wide range
 * thins its minor ticks rather than growing past 41.
 */
static lv_meter_scale_t *dialScale(lv_obj_t *meter, float minV, float maxV,
                                   float majorEvery, int start, int range) {
    if (majorEvery <= 0) majorEvery = (maxV - minV) / 8.0f;
    int minorPerMajor = 4;
    auto count = [&] {
        return (int)roundf((maxV - minV) / (majorEvery / minorPerMajor)) + 1;
    };
    int n = count();
    while (n > 41 && minorPerMajor > 1) { minorPerMajor /= 2; n = count(); }
    n = constrain(n, 2, 41);
    lv_meter_scale_t *s = lv_meter_add_scale(meter);
    lv_meter_set_scale_ticks(meter, s, n, 2, 8, lv_color_hex(UI_DIM));
    lv_meter_set_scale_major_ticks(meter, s, minorPerMajor, 3, 14,
                                   lv_color_hex(UI_TEXT_DIM), 12);
    lv_meter_set_scale_range(meter, s, (int32_t)minV, (int32_t)maxV, range, start);
    return s;
}

/** @brief One coloured zone along the scale's rim. */
static void dialZone(lv_obj_t *meter, lv_meter_scale_t *s, float from, float to,
                     lv_color_t c) {
    if (to <= from) return;
    lv_meter_indicator_t *z = lv_meter_add_arc(meter, s, 6, c, 0);
    lv_meter_set_indicator_start_value(meter, z, (int32_t)from);
    lv_meter_set_indicator_end_value(meter, z, (int32_t)to);
}

/**
 * @brief Collect the lit lamps for a row, most urgent first.
 * @param lamps    The lamp set.
 * @param forStrip true for the strip: takes the lamps Telltales::onStrip
 *                 allows, pins the indicators to the ends where the eye
 *                 expects them, and gives up a slot to "+N" when there are
 *                 too many. false for the dash row, whose indicators have
 *                 their own arrows.
 * @param[out] slots Lamp indices, left to right; -1 marks the "+N" slot.
 * @param cap      Capacity of @p slots.
 * @param[out] more Lamps that did not fit, 0 when all did.
 * @return Slots used.
 */
static size_t collectLamps(const Telltales &lamps, bool forStrip,
                           int *slots, size_t cap, int &more) {
    int order[Telltales::MAX_LAMPS];
    size_t m = 0;
    int left = -1, right = -1;
    for (size_t i = 0; i < lamps.size(); i++) {
        const Lamp &l = lamps[i];
        if (forStrip ? !lamps.onStrip(i) : !l.on) continue;
        if (l.turn) {
            if (!forStrip) continue;
            if (l.icon == ICON_TURN_L && left  < 0) { left  = (int)i; continue; }
            if (l.icon == ICON_TURN_R && right < 0) { right = (int)i; continue; }
        }
        size_t k = m++;                                   // stable insertion
        while (k > 0 && lamps.rank((size_t)order[k - 1]) > lamps.rank(i)) {
            order[k] = order[k - 1];
            k--;
        }
        order[k] = (int)i;
    }
    size_t n = 0;
    const size_t room = cap - (left >= 0) - (right >= 0);
    size_t mid = m;
    more = 0;
    if (mid > room) {
        mid  = forStrip ? room - 1 : room;
        more = (int)(m - mid);
    }
    if (left >= 0) slots[n++] = left;
    for (size_t k = 0; k < mid; k++) slots[n++] = order[k];
    if (forStrip && more > 0) slots[n++] = -1;
    if (right >= 0) slots[n++] = right;
    return n;
}

/* ═══════════════════════════════ build ═══════════════════════════════════ */

void UIBuilder::begin() {
    // Lamps first: the dash screen lays its lamp row out from them.
    _lamps.configure(Config.layout()["warnings"].as<JsonVariantConst>(),
                     Config.alertAckMs());
    _tickCache.reserve(64);

    JsonArray screens = Config.layout()["screens"].as<JsonArray>();
    _screens.reserve(screens.size());
    for (JsonObject cfg : screens) buildScreen(cfg);

    if (_screens.empty()) {                      // defensive: never blank-screen
        JsonDocument d;
        d["type"] = "diag";
        buildScreen(d.as<JsonObject>());
    }

    addPageDots();
    // Parse first: the watchdog block carries alert_style, and buildAlertCard
    // needs to know whether it is building a bar or a card.
    parseWatchdog();
    // The strip goes onto lv_layer_top before the card: later children draw
    // on top, and an alert must never be hidden under the lamps.
    buildTelltaleStrip();
    buildAlertCard();
    _gaugeAlarms = Config.gaugeAlarmColors();
    applyNight(false);
    lv_scr_load(_screens[0].scr);
    _timer = lv_timer_create(uiTimerCb, UI_UPDATE_PERIOD_MS, this);
    log_i("UI built: %u screens, %u lamps, warnings %s", (unsigned)_screens.size(),
          (unsigned)_lamps.size(), _lamps.enabled() ? "on" : "off");
    // LVGL does not report running out of its heap: the next widget comes
    // back null and the display reboots. Log the margin so it can be watched.
    lv_mem_monitor_t mon;
    lv_mem_monitor(&mon);
    log_i("LVGL heap: %u of %u bytes used, largest free block %u",
          (unsigned)(mon.total_size - mon.free_size), (unsigned)mon.total_size,
          (unsigned)mon.free_biggest_size);
}

void UIBuilder::buildScreen(JsonObject cfg) {
    const char *type = cfg["type"] | "arc_gauge";

    _screens.emplace_back();
    ScreenDef &sd = _screens.back();
    sd.allowPopup = cfg["show_popup"] | true;
    // The lamp strip would cover the diagnostics screen's colour swatches.
    sd.showTelltales = cfg["show_telltales"] | (strcmp(type, "diag") != 0);
    sd.scr = lv_obj_create(nullptr);
    lv_obj_set_style_bg_color(sd.scr, lv_color_black(), 0);
    makeRoot(sd, cfg);

    // Dials draw their own face (makeFace): an instrument set into the
    // panel, not a bezel drawn round the whole rectangle.

    if      (!strcmp(type, "arc_gauge"))   buildArcGauge(sd, cfg);
    else if (!strcmp(type, "meter_gauge")) buildMeterGauge(sd, cfg);
    else if (!strcmp(type, "quad") ||
             !strcmp(type, "split"))       buildQuad(sd, cfg);
    else if (!strcmp(type, "text_list"))   buildTextList(sd, cfg);
    else if (!strcmp(type, "bars"))        buildBars(sd, cfg);
    else if (!strcmp(type, "cluster"))     buildCluster(sd, cfg);
    else if (!strcmp(type, "chart"))       buildChart(sd, cfg);
    else if (!strcmp(type, "dash"))        buildDash(sd, cfg);
    else if (!strcmp(type, "diag"))      { buildDiag(sd); _diagIndex = _screens.size() - 1; }
    else                                   buildArcGauge(sd, cfg);   // fallback

    // "no link" badge — shown while the firehose is silent
    sd.linkIcon = makeLabel(sd.root, LV_SYMBOL_WIFI, &lv_font_montserrat_14,
                            lv_palette_main(LV_PALETTE_RED),
                            LV_ALIGN_TOP_MID, 0, 10);
    lv_obj_add_flag(sd.linkIcon, LV_OBJ_FLAG_HIDDEN);
}

/**
 * @brief Draw the static "instrument bezel": two concentric hairline rings and
 *        twelve rim ticks, like the chapter ring of a real gauge.
 *
 * Everything here is created once at boot and never touched again, so it
 * costs nothing per frame — LVGL only redraws it when the area is
 * invalidated by something above it.
 */
/** Diameter available to a round gauge on this landscape panel. */
static constexpr int DIAL_D = (LCD_HEIGHT < LCD_WIDTH ? LCD_HEIGHT : LCD_WIDTH);

/** Default trace colours for a multi-series chart, in assignment order.
 *  Chosen to stay distinguishable from each other on a dark background. */
static constexpr uint32_t kSeriesColors[4] = {
    UI_ACCENT,   // cyan
    UI_ACCENT,   // amber
    UI_OK,   // mint
    UI_ACCENT_ALT    // violet
};

void UIBuilder::addDialFace(lv_obj_t *root) {
    auto ring = [&](int size, int width, uint32_t color, lv_opa_t opa) {
        lv_obj_t *r = lv_obj_create(root);
        lv_obj_set_size(r, size, size);
        lv_obj_center(r);
        lv_obj_set_style_radius(r, LV_RADIUS_CIRCLE, 0);
        lv_obj_set_style_bg_opa(r, LV_OPA_TRANSP, 0);
        lv_obj_set_style_border_width(r, width, 0);
        lv_obj_set_style_border_color(r, lv_color_hex(color), 0);
        lv_obj_set_style_border_opa(r, opa, 0);
        lv_obj_clear_flag(r, LV_OBJ_FLAG_SCROLLABLE | LV_OBJ_FLAG_CLICKABLE);
        return r;
    };
    // Sized to the short edge: a round bezel on a landscape panel is bounded
    // by its height, not its width.
    ring(DIAL_D - 4,  2, UI_LINE, LV_OPA_COVER);   // outer bezel
    ring(DIAL_D - 44, 1, UI_LINE_SOFT, LV_OPA_70);      // inner hairline

    // Twelve rim ticks on the chapter ring.
    const float tickR = (DIAL_D - 4) / 2.0f - 13.0f;
    for (int i = 0; i < 12; i++) {
        const float ang = i * 30.0f * 3.14159265f / 180.0f;
        lv_obj_t *t = lv_obj_create(root);
        lv_obj_set_size(t, 2, 2);
        lv_obj_set_style_radius(t, LV_RADIUS_CIRCLE, 0);
        lv_obj_set_style_bg_color(t, lv_color_hex(UI_LINE), 0);
        lv_obj_set_style_border_width(t, 0, 0);
        lv_obj_clear_flag(t, LV_OBJ_FLAG_SCROLLABLE | LV_OBJ_FLAG_CLICKABLE);
        lv_obj_align(t, LV_ALIGN_CENTER, (int)(cosf(ang) * tickR),
                                          (int)(sinf(ang) * tickR));
    }
}

/**
 * @brief Draw one screen's row of page dots.
 *
 * Its user data packs the screen's own index (low byte) and the screen count
 * (next byte). Dots are drawn here rather than created as objects: one
 * object per dot per screen grows with the square of the screen count, and at
 * eight screens that was 64 objects, each with its own style - about 9 KB of
 * the LVGL heap for decoration.
 *
 * @param e LVGL draw event.
 */
static void pageDotsDrawCb(lv_event_t *e) {
    lv_obj_t *obj = lv_event_get_target(e);
    lv_draw_ctx_t *ctx = lv_event_get_draw_ctx(e);
    const uintptr_t packed = (uintptr_t)lv_event_get_user_data(e);
    const int active = (int)(packed & 0xFF), n = (int)((packed >> 8) & 0xFF);

    lv_area_t box;
    lv_obj_get_coords(obj, &box);
    lv_draw_rect_dsc_t d;
    lv_draw_rect_dsc_init(&d);
    d.radius = LV_RADIUS_CIRCLE;
    for (int j = 0; j < n; j++) {
        const int size = (j == active) ? 6 : 4;
        const int cx   = box.x1 + 3 + j * 10;
        d.bg_color = lv_color_hex(j == active ? UI_ACCENT : UI_DIM);
        lv_area_t a;
        a.x1 = cx - size / 2;
        a.x2 = a.x1 + size - 1;
        a.y2 = box.y2;                            // bottom-aligned, as before
        a.y1 = a.y2 - size + 1;
        lv_draw_rect(ctx, &d, &a);
    }
}

/**
 * @brief Page-position dots along the bottom rim, one row per screen.
 *
 * Placed at y = −12 from the bottom, where the round glass still leaves
 * ±56 px of usable width — enough for a dozen dots.
 */
void UIBuilder::addPageDots() {
    const size_t n = _screens.size();
    if (n < 2 || n > 12) return;                 // pointless / too wide

    // One small object per screen that draws the whole row itself.
    for (size_t i = 0; i < n; i++) {
        lv_obj_t *row = lv_obj_create(_screens[i].root);
        lv_obj_remove_style_all(row);
        lv_obj_set_size(row, (lv_coord_t)((n - 1) * 10 + 6), 6);
        lv_obj_align(row, LV_ALIGN_BOTTOM_MID, 0, -12);
        lv_obj_clear_flag(row, LV_OBJ_FLAG_SCROLLABLE | LV_OBJ_FLAG_CLICKABLE);
        lv_obj_add_event_cb(row, pageDotsDrawCb, LV_EVENT_DRAW_MAIN,
                            (void *)(uintptr_t)(i | (n << 8)));
    }
}

lv_obj_t *UIBuilder::makeRoot(ScreenDef &sd, JsonObject cfg) {
    lv_obj_t *root = lv_obj_create(sd.scr);
    lv_obj_set_size(root, LCD_WIDTH, LCD_HEIGHT);
    lv_obj_center(root);
    /*
     * Rectangular canvas. The round board masked every screen to a circle with
     * radius + clip_corner; here that would be pure cost — this panel has real
     * pixels in all four corners, and a full-screen radius mask is applied per
     * child on every redraw. Square corners, no clipping.
     */
    lv_obj_set_style_radius(root, 0, 0);
    lv_obj_set_style_clip_corner(root, false, 0);
    lv_obj_set_style_border_width(root, 0, 0);
    lv_obj_set_style_pad_all(root, 0, 0);
    lv_obj_clear_flag(root, LV_OBJ_FLAG_SCROLLABLE);
    applyBackground(root, cfg);
    sd.root = root;
    return root;
}

/**
 * @brief Paint a screen's background, cheapest option first.
 *
 * Three mechanisms, in ascending cost:
 *
 *  1. "bg_grad": {from, to}  — a two-stop gradient drawn by the style engine.
 *     Essentially free; this is the default.
 *  2. "texture": "carbon"|"mesh" — a 32×32 tile compiled into the firmware
 *     (see tools/make_assets.py). Repeated by LVGL with no filesystem in the
 *     path, so it costs a handful of small blits.
 *  3. "background_asset": "/assets/x.bin" — a full-screen image on LittleFS.
 *     LVGL's built-in decoder streams file-backed images line by line on
 *     EVERY repaint with no full-frame cache, so a 240×240 background is
 *     ~115 KB of flash reads per full repaint. That is fine on a screen that
 *     only invalidates small label areas and ruinous on one that animates,
 *     which is why nothing in the default layout uses it.
 */
void UIBuilder::applyBackground(lv_obj_t *root, JsonObject cfg) {
    lv_color_t base = colorFromHex(Config.dayBg(), lv_color_hex(UI_BG_DAY));
    lv_obj_set_style_bg_color(root, base, 0);

    JsonObject grad = cfg["bg_grad"];
    if (!grad.isNull()) {
        lv_obj_set_style_bg_color(root, colorFromHex(grad["from"] | "", base), 0);
        lv_obj_set_style_bg_grad_color(root,
            colorFromHex(grad["to"] | "", lv_color_hex(UI_BG_GRAD)), 0);
        lv_obj_set_style_bg_grad_dir(root, LV_GRAD_DIR_VER, 0);
    }

    const char *tex = cfg["texture"] | (const char *)nullptr;
    if (tex && tex[0] && strcmp(tex, "none") != 0) {
        const lv_img_dsc_t *src = nullptr;
        if      (!strcmp(tex, "carbon"))  src = &tex_carbon;
        else if (!strcmp(tex, "mesh"))    src = &tex_mesh;
        else if (!strcmp(tex, "gt"))      src = &tex_gt;
        else if (!strcmp(tex, "gt_dial")) src = &tex_gt_dial;
        if (src) {
            // A texture the size of the screen is a complete dial face, so lay
            // it down once, centred. Anything smaller is a swatch meant to be
            // repeated. Deciding from the asset's own dimensions keeps the
            // layout schema free of a flag that could contradict the image.
            const bool full = src->header.w >= LCD_WIDTH &&
                              src->header.h >= LCD_HEIGHT;
            lv_obj_set_style_bg_img_src(root, src, 0);
            lv_obj_set_style_bg_img_tiled(root, !full, 0);
            lv_obj_set_style_bg_img_opa(root, cfg["texture_opa"] | 255, 0);
        } else {
            log_w("unknown texture '%s' — ignored", tex);
        }
    }

    const char *asset = cfg["background_asset"] | (const char *)nullptr;
    if (asset && asset[0]) {
        String src = String("L:") + asset;
        lv_obj_t *img = lv_img_create(root);
        lv_img_set_src(img, src.c_str());
        lv_obj_center(img);
        log_w("screen uses file-backed background '%s' — costs frame rate",
              asset);
    }
}

void UIBuilder::parseCommon(GaugeBinding &b, JsonObject cfg) {
    b.metricId = parseMetricId(cfg["metric_id"]);
    b.label    = String(cfg["label"] | "");
    b.units    = String(cfg["units"] | "");
    b.decimals = cfg["decimals"] | 0;
    b.minV     = cfg["min"] | 0.0f;
    b.maxV     = cfg["max"] | 100.0f;
    if (b.maxV <= b.minV) b.maxV = b.minV + 1;    // never divide by zero

    JsonObject th = cfg["thresholds"];
    if (!th.isNull()) {
        parseThreshold(b.warn, th["warning"], false);
        parseThreshold(b.crit, th["critical"], true);
    }
}

void UIBuilder::parseThreshold(ThresholdCfg &t, JsonObject cfg, bool critical) {
    if (cfg.isNull()) return;
    t.enabled = true;
    t.value   = cfg["value"] | 0.0f;
    t.hyst    = cfg["hysteresis"] | 0.0f;
    t.above   = strcmp(cfg["direction"] | "above", "below") != 0;
    t.color   = colorFromHex(cfg["color"] | "",
                             critical ? lv_color_hex(UI_CRIT)
                                      : lv_color_hex(UI_WARN));
    // Leave the headline EMPTY when the layout does not set one. Defaulting it
    // to "CRITICAL" would permanently replace the far more useful
    // "HIGH · LIMIT 115 °C" detail line with a word the red border already
    // conveys. Empty means "fall back to the computed detail".
    if (critical) t.overlayText = String(cfg["overlay_text"] | "");
}

/* ---- arc gauge: one big arc + numeric readout --------------------------- */

void UIBuilder::buildArcGauge(ScreenDef &sd, JsonObject cfg) {
    sd.bindings.reserve(1);
    sd.bindings.emplace_back();
    GaugeBinding &b = sd.bindings.back();
    parseCommon(b, cfg);
    b.kind = WidgetKind::Arc;

    JsonObject ac      = cfg["arc"];
    int  startAngle    = ac["start_angle"] | 135;
    int  endAngle      = ac["end_angle"]   | 45;
    int  width         = ac["width"]       | 14;
    bool rounded       = ac["rounded"]     | false;
    b.normalColor      = colorFromHex(ac["color"] | "", lv_color_hex(UI_ACCENT));
    lv_color_t trackCl = colorFromHex(ac["bg_color"] | "", lv_color_hex(UI_LINE_SOFT));

    // The round board's arc screen, as an instrument centred in the panel.
    const int cx = LCD_WIDTH / 2, cy = LCD_HEIGHT / 2;
    if (cfg["dial_face"] | true) makeFace(sd.root, cx, cy);

    lv_obj_t *arc = lv_arc_create(sd.root);
    lv_obj_set_size(arc, ds::FACE_D - 16, ds::FACE_D - 16);
    lv_obj_align(arc, LV_ALIGN_CENTER, 0, 0);
    lv_arc_set_bg_angles(arc, startAngle, endAngle);
    lv_arc_set_rotation(arc, 0);
    lv_arc_set_range(arc, 0, 1000);               // internal fixed resolution
    lv_arc_set_value(arc, 0);
    lv_obj_remove_style(arc, nullptr, LV_PART_KNOB);
    lv_obj_clear_flag(arc, LV_OBJ_FLAG_CLICKABLE);
    lv_obj_set_style_arc_width(arc, width, LV_PART_MAIN);
    lv_obj_set_style_arc_width(arc, width, LV_PART_INDICATOR);
    lv_obj_set_style_arc_color(arc, trackCl, LV_PART_MAIN);
    lv_obj_set_style_arc_color(arc, b.normalColor, LV_PART_INDICATOR);
    lv_obj_set_style_arc_rounded(arc, rounded, LV_PART_MAIN);
    lv_obj_set_style_arc_rounded(arc, rounded, LV_PART_INDICATOR);
    b.arc = arc;

    const lv_font_t *valFont = fontForSize(cfg["value_font"] | 48);
    b.nameLabel  = makeLabel(sd.root, b.label.c_str(), &lv_font_montserrat_16,
                             lv_color_hex(UI_MUTED), LV_ALIGN_CENTER, 0, -58);
    b.valueLabel = makeLabel(sd.root, "--", valFont, lv_color_hex(UI_TEXT),
                             LV_ALIGN_CENTER, 0, -4);
    b.unitLabel  = makeLabel(sd.root, b.units.c_str(), &lv_font_montserrat_16,
                             lv_color_hex(UI_MUTED), LV_ALIGN_CENTER, 0, 34);
    b.peakLabel  = makeLabel(sd.root, "", &lv_font_montserrat_14,
                             lv_color_hex(UI_ACCENT), LV_ALIGN_CENTER, 0, 58);
    lv_obj_add_flag(b.peakLabel, LV_OBJ_FLAG_HIDDEN);
}

/* ---- meter gauge: radial tachometer with needle & zones ----------------- */

void UIBuilder::buildMeterGauge(ScreenDef &sd, JsonObject cfg) {
    sd.bindings.reserve(1);
    sd.bindings.emplace_back();
    GaugeBinding &b = sd.bindings.back();
    parseCommon(b, cfg);
    b.kind         = WidgetKind::Meter;
    b.tickLabelDiv = cfg["tick_label_div"] | 1.0f;

    JsonObject ac   = cfg["arc"];
    int startAngle  = ac["start_angle"] | 135;
    int endAngle    = ac["end_angle"]   | 45;
    int angleRange  = ((endAngle - startAngle) % 360 + 360) % 360;
    if (angleRange == 0) angleRange = 270;
    b.normalColor   = colorFromHex(ac["color"] | "", lv_color_hex(UI_NEEDLE));

    // Exactly the round board's tach, set into the middle of the panel.
    const int cx = LCD_WIDTH / 2, cy = LCD_HEIGHT / 2;
    lv_obj_t *meter = makeDial(sd.root, cx, cy, cfg["dial_face"] | true);
    b.meter = meter;
    lv_meter_scale_t *scale = dialScale(meter, b.minV, b.maxV,
                                        cfg["major_tick_every"] | 0.0f,
                                        startAngle, angleRange);
    if (b.warn.enabled && b.warn.above)
        dialZone(meter, scale, b.warn.value, b.crit.enabled ? b.crit.value : b.maxV,
                 b.warn.color);
    if (b.crit.enabled && b.crit.above)
        dialZone(meter, scale, b.crit.value, b.maxV, b.crit.color);

    b.needle = lv_meter_add_needle_line(meter, scale, 4, b.normalColor, -16);
    lv_meter_set_indicator_value(meter, b.needle, (int32_t)b.minV);
    if (b.tickLabelDiv > 1.0f)
        lv_obj_add_event_cb(meter, meterTickLabelCb, LV_EVENT_DRAW_PART_BEGIN,
                            &b.tickLabelDiv);

    b.nameLabel  = makeLabel(sd.root, b.label.c_str(), &lv_font_montserrat_16,
                             lv_color_hex(UI_MUTED), LV_ALIGN_CENTER, 0, 28);
    b.valueLabel = makeLabel(sd.root, "--", fontForSize(cfg["value_font"] | 40),
                             lv_color_hex(UI_TEXT), LV_ALIGN_CENTER, 0, 56);
    b.unitLabel  = makeLabel(sd.root, b.units.c_str(), &lv_font_montserrat_12,
                             lv_color_hex(UI_MUTED), LV_ALIGN_CENTER, 0, 84);
    b.peakLabel  = makeLabel(sd.root, "", &lv_font_montserrat_14,
                             lv_color_hex(UI_ACCENT), LV_ALIGN_CENTER, 0, -44);
    lv_obj_add_flag(b.peakLabel, LV_OBJ_FLAG_HIDDEN);
    for (lv_obj_t *l : {b.nameLabel, b.valueLabel, b.unitLabel}) {
        lv_obj_set_width(l, 150);
        lv_label_set_long_mode(l, LV_LABEL_LONG_DOT);
        lv_obj_set_style_text_align(l, LV_TEXT_ALIGN_CENTER, 0);
    }
}

/* ---- quad / split: 2 or 4 metric cells ---------------------------------- */

void UIBuilder::buildQuad(ScreenDef &sd, JsonObject cfg) {
    JsonArray cells = cfg["cells"].as<JsonArray>();
    size_t count = min((size_t)cells.size(), (size_t)GRID_MAX_CELLS);
    if (count == 0) return;
    sd.bindings.reserve(count);
    addHeader(sd.root, screenTitle(cfg).c_str());

    /*
     * Up to 8 cells in 4 columns x 2 rows, each a panel of its own. Columns
     * follow the count so 3 metrics make one clean row of 3, not a 2x2 with
     * a hole in it.
     */
    const int cols = (count <= 2) ? (int)count
                   : (count <= 4) ? 2
                   : (count <= 6) ? 3
                                  : 4;
    const int rows  = (int)((count + cols - 1) / cols);
    const int areaW = LCD_WIDTH - 2 * ds::MARGIN;
    const int areaH = ds::BOTTOM - ds::TOP;
    const int cellW = (areaW - (cols - 1) * ds::GUTTER) / cols;
    const int cellH = (areaH - (rows - 1) * ds::GUTTER) / rows;

    const lv_font_t *valFont = (cols <= 2) ? (rows == 1 ? &lv_font_montserrat_48
                                                        : &lv_font_montserrat_40)
                             : (cols == 3) ? &lv_font_montserrat_32
                                           : &lv_font_montserrat_28;

    size_t i = 0;
    for (JsonObject cellCfg : cells) {
        if (i >= count) break;
        sd.bindings.emplace_back();
        GaugeBinding &b = sd.bindings.back();
        parseCommon(b, cellCfg);
        b.kind        = WidgetKind::Cell;
        b.normalColor = colorFromHex(cellCfg["color"] | "", lv_color_hex(UI_TEXT));

        const int c = (int)i % cols, r = (int)i / cols;
        lv_obj_t *card = makeCard(sd.root, ds::MARGIN + c * (cellW + ds::GUTTER),
                                  ds::TOP + r * (cellH + ds::GUTTER), cellW, cellH);
        b.nameLabel  = makeCaption(card, b.label.c_str(), LV_ALIGN_TOP_LEFT, 10, 8);
        b.valueLabel = makeLabel(card, "--", valFont, b.normalColor,
                                 LV_ALIGN_CENTER, 0, 4);
        b.unitLabel  = makeLabel(card, b.units.c_str(), &lv_font_montserrat_12,
                                 lv_color_hex(UI_MUTED), LV_ALIGN_BOTTOM_MID, 0, -7);
        if (cellH >= 90) {
            b.peakLabel = makeLabel(card, "", &lv_font_montserrat_12,
                                    lv_color_hex(UI_ACCENT), LV_ALIGN_TOP_RIGHT, -10, 8);
            lv_obj_add_flag(b.peakLabel, LV_OBJ_FLAG_HIDDEN);
        }
        lv_obj_set_width(b.valueLabel, cellW - 12);
        lv_label_set_long_mode(b.valueLabel, LV_LABEL_LONG_DOT);
        lv_obj_set_style_text_align(b.valueLabel, LV_TEXT_ALIGN_CENTER, 0);
        i++;
    }
}

/* ---- text list: compact rows -------------------------------------------- */

void UIBuilder::buildTextList(ScreenDef &sd, JsonObject cfg) {
    JsonArray rows = cfg["rows"].as<JsonArray>();
    const size_t count = min((size_t)rows.size(), (size_t)TEXTLIST_MAX_ROWS);
    sd.bindings.reserve(count);
    addHeader(sd.root, screenTitle(cfg).c_str());
    if (count == 0) return;

    // One panel of up to five rows, or two side by side for more.
    const bool twoCol = count > 5;
    const int  perCol = (int)((count + (twoCol ? 1 : 0)) / (twoCol ? 2 : 1));
    const int  areaW  = LCD_WIDTH - 2 * ds::MARGIN;
    const int  cardW  = twoCol ? (areaW - ds::GUTTER) / 2 : areaW;
    const int  cardH  = ds::BOTTOM - ds::TOP;
    const int  pitch  = (cardH - 8) / max(perCol, 1);

    lv_obj_t *card[2] = {nullptr, nullptr};
    card[0] = makeCard(sd.root, ds::MARGIN, ds::TOP, cardW, cardH);
    if (twoCol) card[1] = makeCard(sd.root, ds::MARGIN + cardW + ds::GUTTER,
                                   ds::TOP, cardW, cardH);

    size_t i = 0;
    for (JsonObject rowCfg : rows) {
        if (i >= count) break;
        sd.bindings.emplace_back();
        GaugeBinding &b = sd.bindings.back();
        parseCommon(b, rowCfg);
        b.kind        = WidgetKind::TextRow;
        b.normalColor = colorFromHex(rowCfg["color"] | "", lv_color_hex(UI_TEXT));

        const int col  = twoCol ? (int)i / perCol : 0;
        const int slot = twoCol ? (int)i % perCol : (int)i;
        lv_obj_t *parent = card[col];
        const int y = 4 + slot * pitch;
        if (slot > 0) makeRule(parent, 14, y, cardW - 30);

        b.nameLabel  = makeLabel(parent, b.label.c_str(), &lv_font_montserrat_14,
                                 lv_color_hex(UI_MUTED), LV_ALIGN_TOP_LEFT,
                                 16, y + (pitch - 16) / 2);
        b.valueLabel = makeLabel(parent, "--", &lv_font_montserrat_20,
                                 b.normalColor, LV_ALIGN_TOP_RIGHT,
                                 -16, y + (pitch - 22) / 2);
        lv_obj_set_width(b.valueLabel, cardW / 2);
        lv_label_set_long_mode(b.valueLabel, LV_LABEL_LONG_DOT);
        lv_obj_set_style_text_align(b.valueLabel, LV_TEXT_ALIGN_RIGHT, 0);
        i++;
    }
}

/* ---- bars: horizontal bar gauges, a landscape-native layout ------------- */

void UIBuilder::buildBars(ScreenDef &sd, JsonObject cfg) {
    JsonArray rows = cfg["rows"].as<JsonArray>();
    size_t count = min((size_t)rows.size(), (size_t)BARS_MAX_ROWS);
    if (count == 0) return;
    sd.bindings.reserve(count);
    addHeader(sd.root, screenTitle(cfg).c_str());

    /*
     * A horizontal bar is the shape a wide screen actually wants: the eye
     * compares lengths along one axis far faster than it compares six
     * separate numbers. Each row: caption and value on one line, a slim bar
     * under them, all in one panel.
     */
    const int cardW = LCD_WIDTH - 2 * ds::MARGIN;
    const int cardH = ds::BOTTOM - ds::TOP;
    lv_obj_t *card = makeCard(sd.root, ds::MARGIN, ds::TOP, cardW, cardH);
    const int pitch = (cardH - 12) / (int)count;
    const int barW  = cardW - 34;

    size_t i = 0;
    for (JsonObject rowCfg : rows) {
        if (i >= count) break;
        sd.bindings.emplace_back();
        GaugeBinding &b = sd.bindings.back();
        parseCommon(b, rowCfg);
        b.kind        = WidgetKind::Bar;
        b.inlineUnits = true;
        b.normalColor = colorFromHex(rowCfg["color"] | "", lv_color_hex(UI_ACCENT));

        const int y = 7 + (int)i * pitch;
        b.nameLabel  = makeCaption(card, b.label.c_str(), LV_ALIGN_TOP_LEFT, 16, y + 3);
        b.valueLabel = makeLabel(card, "--", &lv_font_montserrat_16,
                                 lv_color_hex(UI_TEXT), LV_ALIGN_TOP_RIGHT, -16, y);
        lv_obj_set_width(b.valueLabel, 120);
        lv_label_set_long_mode(b.valueLabel, LV_LABEL_LONG_DOT);
        lv_obj_set_style_text_align(b.valueLabel, LV_TEXT_ALIGN_RIGHT, 0);

        lv_obj_t *bar = lv_bar_create(card);
        lv_obj_set_pos(bar, 16, y + pitch - 13);
        lv_obj_set_size(bar, barW, 6);
        // Fixed internal range: the widget works in whole units, so mapping
        // the metric onto 0..1000 keeps fractional scales (boost in bar,
        // volts) from quantising to something useless.
        lv_bar_set_range(bar, 0, 1000);
        lv_bar_set_value(bar, 0, LV_ANIM_OFF);
        lv_obj_set_style_radius(bar, 3, 0);
        lv_obj_set_style_radius(bar, 3, LV_PART_INDICATOR);
        lv_obj_set_style_bg_color(bar, lv_color_hex(UI_LINE), LV_PART_MAIN);
        lv_obj_set_style_bg_color(bar, b.normalColor, LV_PART_INDICATOR);
        lv_obj_clear_flag(bar, LV_OBJ_FLAG_SCROLLABLE | LV_OBJ_FLAG_CLICKABLE);
        b.bar = bar;
        i++;
    }
}

/* ---- cluster: the landscape hero screen --------------------------------- */

void UIBuilder::buildCluster(ScreenDef &sd, JsonObject cfg) {
    /*
     * The round board's tach on the left, a panel on the right: the dominant
     * readout at its top, the secondary values listed under it.
     *
     *   cfg.dial   — object, the metric driving the needle
     *   cfg.main   — object, the big readout
     *   cfg.side[] — up to 4 rows
     */
    // The dial's tick-label hook keeps a pointer into this vector, so it must
    // never reallocate: size it for the dial, the main readout and four side
    // rows before the first binding is added.
    sd.bindings.reserve(2 + 4);
    const int cx = 4 + ds::FACE_D / 2, cy = LCD_HEIGHT / 2;
    const int px = ds::FACE_D + 20, pw = LCD_WIDTH - px - ds::MARGIN;

    /* ---- left: the dial ---- */
    JsonObject dialCfg = cfg["dial"];
    if (!dialCfg.isNull()) {
        sd.bindings.emplace_back();
        GaugeBinding &b = sd.bindings.back();
        parseCommon(b, dialCfg);
        b.kind         = WidgetKind::Meter;
        b.tickLabelDiv = dialCfg["tick_label_div"] | 1.0f;
        b.normalColor  = colorFromHex(dialCfg["color"] | "", lv_color_hex(UI_NEEDLE));

        lv_obj_t *meter = makeDial(sd.root, cx, cy, dialCfg["dial_face"] | true);
        b.meter = meter;
        lv_meter_scale_t *scale = dialScale(meter, b.minV, b.maxV,
                                            dialCfg["major_tick_every"] | 0.0f, 135, 270);
        if (b.warn.enabled && b.warn.above)
            dialZone(meter, scale, b.warn.value, b.crit.enabled ? b.crit.value : b.maxV,
                     b.warn.color);
        if (b.crit.enabled && b.crit.above)
            dialZone(meter, scale, b.crit.value, b.maxV, b.crit.color);
        b.needle = lv_meter_add_needle_line(meter, scale, 4, b.normalColor, -16);
        lv_meter_set_indicator_value(meter, b.needle, (int32_t)b.minV);
        if (b.tickLabelDiv > 1.0f)
            lv_obj_add_event_cb(meter, meterTickLabelCb,
                                LV_EVENT_DRAW_PART_BEGIN, &b.tickLabelDiv);

        // As on the round tach: name, value and units under the hub.
        b.nameLabel  = makeLabel(sd.root, b.label.c_str(), &lv_font_montserrat_14,
                                 lv_color_hex(UI_MUTED), LV_ALIGN_TOP_LEFT, cx - 60, cy + 26);
        b.valueLabel = makeLabel(sd.root, "--", &lv_font_montserrat_32,
                                 lv_color_hex(UI_TEXT), LV_ALIGN_TOP_LEFT, cx - 60, cy + 44);
        b.unitLabel  = makeLabel(sd.root, b.units.c_str(), &lv_font_montserrat_12,
                                 lv_color_hex(UI_MUTED), LV_ALIGN_TOP_LEFT, cx - 60, cy + 82);
        for (lv_obj_t *l : {b.nameLabel, b.valueLabel, b.unitLabel}) {
            lv_obj_set_width(l, 120);
            lv_label_set_long_mode(l, LV_LABEL_LONG_CLIP);
            lv_obj_set_style_text_align(l, LV_TEXT_ALIGN_CENTER, 0);
        }
    }

    /* ---- right: the panel ---- */
    lv_obj_t *card = makeCard(sd.root, px, ds::TOP, pw, ds::BOTTOM - ds::TOP);
    JsonObject mainCfg = cfg["main"];
    if (!mainCfg.isNull()) {
        sd.bindings.emplace_back();
        GaugeBinding &b = sd.bindings.back();
        parseCommon(b, mainCfg);
        b.kind        = WidgetKind::Cell;
        b.normalColor = colorFromHex(mainCfg["color"] | "", lv_color_hex(UI_TEXT));
        b.nameLabel   = makeCaption(card, b.label.c_str(), LV_ALIGN_TOP_LEFT, 14, 10);
        b.valueLabel  = makeLabel(card, "--", &lv_font_montserrat_48, b.normalColor,
                                  LV_ALIGN_TOP_MID, 0, 22);
        b.unitLabel   = makeLabel(card, b.units.c_str(), &lv_font_montserrat_14,
                                  lv_color_hex(UI_MUTED), LV_ALIGN_TOP_MID, 0, 74);
        lv_obj_set_width(b.valueLabel, pw - 16);
        lv_label_set_long_mode(b.valueLabel, LV_LABEL_LONG_CLIP);
        lv_obj_set_style_text_align(b.valueLabel, LV_TEXT_ALIGN_CENTER, 0);
    }

    JsonArray side = cfg["side"].as<JsonArray>();
    const size_t n = min((size_t)side.size(), (size_t)4);
    if (n) makeRule(card, 14, 100, pw - 30);
    size_t i = 0;
    for (JsonObject s : side) {
        if (i >= n) break;
        sd.bindings.emplace_back();
        GaugeBinding &b = sd.bindings.back();
        parseCommon(b, s);
        b.kind        = WidgetKind::TextRow;
        b.normalColor = colorFromHex(s["color"] | "", lv_color_hex(UI_TEXT));
        const int y = 110 + (int)i * 25;
        b.nameLabel  = makeCaption(card, b.label.c_str(), LV_ALIGN_TOP_LEFT, 14, y + 5);
        b.valueLabel = makeLabel(card, "--", &lv_font_montserrat_20, b.normalColor,
                                 LV_ALIGN_TOP_RIGHT, -14, y);
        lv_obj_set_width(b.valueLabel, 110);
        lv_label_set_long_mode(b.valueLabel, LV_LABEL_LONG_DOT);
        lv_obj_set_style_text_align(b.valueLabel, LV_TEXT_ALIGN_RIGHT, 0);
        i++;
    }
}

/* ---- chart: rolling trend of one metric --------------------------------- */

void UIBuilder::buildChart(ScreenDef &sd, JsonObject cfg) {
    /*
     * Two shapes, one screen type:
     *   - "series": [ … ]  overlays several metrics on one set of axes, with a
     *     legend under the plot.
     *   - no "series"      falls back to the single-metric strip chart, so a
     *     layout written for the round board still works unchanged.
     *
     * Every series shares one lv_chart and one Y range, taken from the
     * screen's own min/max.
     */
    JsonArray series = cfg["series"].as<JsonArray>();
    const bool multi = !series.isNull() && series.size() > 0;
    const size_t count = multi ? min((size_t)series.size(), CHART_MAX_SERIES)
                               : 1;
    sd.bindings.reserve(count);
    addHeader(sd.root, screenTitle(cfg, "TREND").c_str());

    const uint16_t points   = constrain((int)(cfg["points"] | 120), 10, 240);
    const uint32_t periodMs = cfg["sample_ms"] | 1000;
    const int cardW = LCD_WIDTH - 2 * ds::MARGIN;
    const int cardH = ds::BOTTOM - ds::TOP;
    lv_obj_t *card = makeCard(sd.root, ds::MARGIN, ds::TOP, cardW, cardH);

    // Window covered by the visible trace, so the axis means something.
    char span[32];
    snprintf(span, sizeof(span), "%lu s", (unsigned long)(points * periodMs / 1000));
    makeLabel(card, span, &lv_font_montserrat_12, lv_color_hex(UI_DIM),
              LV_ALIGN_TOP_RIGHT, -12, 8);

    lv_obj_t *chart = lv_chart_create(card);
    lv_obj_set_pos(chart, 10, 24);
    lv_obj_set_size(chart, cardW - 22, cardH - 24 - 52);
    lv_chart_set_type(chart, LV_CHART_TYPE_LINE);
    lv_chart_set_point_count(chart, points);
    lv_chart_set_range(chart, LV_CHART_AXIS_PRIMARY_Y,
                       (lv_coord_t)(cfg["min"] | 0.0f),
                       (lv_coord_t)(cfg["max"] | 100.0f));
    // SHIFT scrolls old samples left as new ones arrive — a strip chart.
    lv_chart_set_update_mode(chart, LV_CHART_UPDATE_MODE_SHIFT);
    lv_chart_set_div_line_count(chart, 4, 0);
    lv_obj_set_style_bg_opa(chart, LV_OPA_TRANSP, 0);
    lv_obj_set_style_border_width(chart, 0, 0);
    lv_obj_set_style_line_color(chart, lv_color_hex(UI_LINE_SOFT), LV_PART_MAIN);
    lv_obj_set_style_line_width(chart, 1, LV_PART_MAIN);
    lv_obj_set_style_line_width(chart, 2, LV_PART_ITEMS);
    lv_obj_set_style_pad_all(chart, 2, 0);
    lv_obj_set_style_size(chart, 0, LV_PART_INDICATOR);  // no per-point dots
    lv_obj_clear_flag(chart, LV_OBJ_FLAG_SCROLLABLE | LV_OBJ_FLAG_CLICKABLE);

    const int legendY = cardH - 46;
    const int slotW   = (cardW - 24) / (int)count;
    makeRule(card, 12, legendY - 6, cardW - 26);

    for (size_t i = 0; i < count; i++) {
        JsonObject sc = multi ? series[i].as<JsonObject>() : cfg;
        sd.bindings.emplace_back();
        GaugeBinding &b = sd.bindings.back();
        parseCommon(b, sc);
        b.kind        = WidgetKind::Chart;
        b.chartPeriod = sc["sample_ms"] | periodMs;
        b.normalColor = colorFromHex(sc["color"] | "",
                                     lv_color_hex(kSeriesColors[i % 4]));
        b.chart  = chart;
        b.series = lv_chart_add_series(chart, b.normalColor,
                                       LV_CHART_AXIS_PRIMARY_Y);
        // Start blank rather than at zero, so a trace only shows real samples.
        lv_chart_set_all_value(chart, b.series, LV_CHART_POINT_NONE);

        // Legend entry: a colour swatch, the metric name, and its live value.
        const int x0 = 14 + (int)i * slotW;
        lv_obj_t *dot = lv_obj_create(card);
        lv_obj_remove_style_all(dot);
        lv_obj_set_size(dot, 8, 8);
        lv_obj_set_pos(dot, x0, legendY + 4);
        lv_obj_set_style_radius(dot, LV_RADIUS_CIRCLE, 0);
        lv_obj_set_style_bg_color(dot, b.normalColor, 0);
        lv_obj_set_style_bg_opa(dot, LV_OPA_COVER, 0);
        lv_obj_clear_flag(dot, LV_OBJ_FLAG_SCROLLABLE | LV_OBJ_FLAG_CLICKABLE);

        b.nameLabel  = makeCaption(card, b.label.c_str(), LV_ALIGN_TOP_LEFT,
                                   x0 + 14, legendY + 1);
        b.valueLabel = makeLabel(card, "--", &lv_font_montserrat_16,
                                 lv_color_hex(UI_TEXT), LV_ALIGN_TOP_LEFT,
                                 x0 + 14, legendY + 17);
        b.inlineUnits = true;
        lv_obj_set_width(b.nameLabel,  slotW - 20);
        lv_obj_set_width(b.valueLabel, slotW - 20);
        lv_label_set_long_mode(b.nameLabel,  LV_LABEL_LONG_DOT);
        lv_label_set_long_mode(b.valueLabel, LV_LABEL_LONG_DOT);
    }
}

/* ---- dash: the mini instrument cluster ----------------------------------- */

void UIBuilder::dashPart(GaugeBinding &b, JsonVariant v, uint16_t id,
                         const char *label, const char *units, float minV,
                         float maxV, uint8_t dec) {
    JsonObject o = v.as<JsonObject>();         // null when absent or `true`
    b.metricId = o["metric_id"].isNull() ? id : parseMetricId(o["metric_id"]);
    b.label    = String(o["label"] | label);
    b.units    = String(o["units"] | units);
    b.decimals = o["decimals"] | dec;
    b.minV     = o["min"] | minV;
    b.maxV     = o["max"] | maxV;
    if (b.maxV <= b.minV) b.maxV = b.minV + 1;
    JsonObject th = o["thresholds"];
    if (!th.isNull()) {
        parseThreshold(b.warn, th["warning"], false);
        parseThreshold(b.crit, th["critical"], true);
    }
}

void UIBuilder::buildDash(ScreenDef &sd, JsonObject cfg) {
    /*
     * The round board's tach, whole, on the left - gear inside it, shift
     * lights under its 12 o'clock - and one panel on the right with speed,
     * fuel, coolant and four small readouts. The header band over the panel
     * carries the indicators at its ends and the lit warning lamps between.
     *
     * Every part can be switched off with `"part": false`, and every metric
     * repointed, from the layout.
     */
    _dash.emplace_back();
    DashView &dv     = _dash.back();
    dv.screen        = _screens.size() - 1;
    sd.dash          = (int)_dash.size() - 1;
    sd.showTelltales = false;                 // it has its own lamps
    // Bindings are rendered through references into this vector: size it
    // before the first one exists.
    sd.bindings.reserve(9);

    const int cx = 4 + ds::FACE_D / 2, cy = LCD_HEIGHT / 2;       // the dial
    const int px = ds::FACE_D + 20, pw = LCD_WIDTH - px - ds::MARGIN;  // panel

    JsonVariant sl = cfg["shift_light"];
    const float shiftRpm = sl["rpm"] | 6500.0f;

    /* ---- lamps: header band over the panel ---- */
    if (!partOff(cfg["lamps"])) {
        dv.ghosts = true;                     // the indicator arrows, dimmed
        bool hasTurn[2] = {false, false};
        for (size_t i = 0; i < _lamps.size(); i++) {
            const Lamp &l = _lamps[i];
            if (l.enabled && (l.icon == ICON_TURN_L || l.icon == ICON_TURN_R))
                hasTurn[l.icon == ICON_TURN_R] = true;
        }
        if (hasTurn[0]) dv.turn[0] = makeLamp(sd.root, ICON_TURN_L, px + 2, 7);
        if (hasTurn[1]) dv.turn[1] = makeLamp(sd.root, ICON_TURN_R, px + pw - 26, 7);
        // Only lit lamps are shown, as in the car: slots fill at run time.
        dv.slots = DASH_LAMP_SLOTS;
        for (size_t k = 0; k < dv.slots; k++) {
            dv.slot[k]     = makeLamp(sd.root, ICON_WARN, px, 7);
            dv.slotIcon[k] = ICON_WARN;
            dv.slotRgb[k]  = LAMP_HIDDEN;
            lv_obj_add_flag(dv.slot[k], LV_OBJ_FLAG_HIDDEN);
        }
    }

    /* ---- left: the tachometer ---- */
    JsonVariant tachCfg = cfg["tach"];
    uint16_t rpmMetric = METRIC_ID_RPM;
    if (!partOff(tachCfg)) {
        sd.bindings.emplace_back();
        GaugeBinding &b = sd.bindings.back();
        dashPart(b, tachCfg, METRIC_ID_RPM, "RPM", "", 0, 8000, 0);
        b.kind         = WidgetKind::Meter;
        b.normalColor  = colorFromHex(tachCfg["color"] | "", lv_color_hex(UI_NEEDLE));
        b.tickLabelDiv = tachCfg["tick_label_div"] | (b.maxV >= 1000 ? 1000.0f : 1.0f);
        rpmMetric      = b.metricId;

        lv_obj_t *meter = makeDial(sd.root, cx, cy, true);
        b.meter = meter;
        lv_meter_scale_t *scale = dialScale(meter, b.minV, b.maxV,
                                            tachCfg["major_tick_every"] | 0.0f, 135, 270);
        // Zones: the tach's own thresholds when it has them, otherwise
        // orange for the last thousand before the redline and red after it -
        // the round tach's colours.
        if (b.warn.enabled || b.crit.enabled) {
            if (b.warn.enabled && b.warn.above)
                dialZone(meter, scale, b.warn.value,
                         b.crit.enabled ? b.crit.value : b.maxV, b.warn.color);
            if (b.crit.enabled && b.crit.above)
                dialZone(meter, scale, b.crit.value, b.maxV, b.crit.color);
        } else {
            const float redline = tachCfg["redline"] | shiftRpm;
            if (redline > b.minV && redline < b.maxV) {
                const float step = (b.maxV - b.minV) / 8.0f;
                dialZone(meter, scale, fmaxf(b.minV, redline - step), redline,
                         lv_color_hex(UI_ZONE));
                dialZone(meter, scale, redline, b.maxV, lv_color_hex(UI_NEEDLE));
            }
        }
        b.needle = lv_meter_add_needle_line(meter, scale, 4, b.normalColor, -16);
        lv_meter_set_indicator_value(meter, b.needle, (int32_t)b.minV);
        if (b.tickLabelDiv > 1.0f)
            lv_obj_add_event_cb(meter, meterTickLabelCb,
                                LV_EVENT_DRAW_PART_BEGIN, &b.tickLabelDiv);

        // Engine speed in figures, low in the dial's opening.
        b.valueLabel = makeLabel(sd.root, "--", &lv_font_montserrat_16,
                                 lv_color_hex(UI_TEXT_DIM), LV_ALIGN_TOP_LEFT,
                                 cx - 50, cy + 80);
        b.nameLabel  = makeCaption(sd.root, b.label.c_str(), LV_ALIGN_TOP_LEFT,
                                   cx - 50, cy + 99);
        for (lv_obj_t *l : {b.valueLabel, b.nameLabel}) {
            lv_obj_set_width(l, 100);
            lv_obj_set_style_text_align(l, LV_TEXT_ALIGN_CENTER, 0);
        }
    }

    /* ---- shift light: under the dial's 12 o'clock ---- */
    if (!partOff(sl)) {
        dv.shift      = true;
        dv.rpmMetric  = rpmMetric;
        dv.shiftRpm   = shiftRpm;
        dv.shiftStart = sl["start"] | (shiftRpm - 1500.0f);
        if (dv.shiftStart >= dv.shiftRpm) dv.shiftStart = dv.shiftRpm - 1;
        for (int k = 0; k < 5; k++) {
            lv_obj_t *led = lv_obj_create(sd.root);
            lv_obj_remove_style_all(led);
            lv_obj_set_size(led, 9, 9);
            lv_obj_set_pos(led, cx - 40 + k * 18, cy - 60);
            lv_obj_set_style_radius(led, LV_RADIUS_CIRCLE, 0);
            lv_obj_set_style_bg_opa(led, LV_OPA_COVER, 0);
            lv_obj_set_style_bg_color(led, lv_color_hex(UI_LAMP_OFF), 0);
            lv_obj_clear_flag(led, LV_OBJ_FLAG_SCROLLABLE | LV_OBJ_FLAG_CLICKABLE);
            dv.led[k]    = led;
            dv.ledRgb[k] = UI_LAMP_OFF;
        }
    }

    /* ---- gear: large, under the hub ---- */
    JsonVariant gCfg = cfg["gear"];
    if (!partOff(gCfg)) {
        sd.bindings.emplace_back();
        GaugeBinding &b = sd.bindings.back();
        dashPart(b, gCfg, METRIC_ID_GEAR, "GEAR", "", -1, 6, 0);
        b.kind        = WidgetKind::Cell;
        b.fmt         = ValueFmt::Gear;
        b.normalColor = colorFromHex(gCfg["color"] | "", lv_color_hex(UI_ACCENT));
        b.valueLabel  = makeLabel(sd.root, "--", &lv_font_montserrat_48, b.normalColor,
                                  LV_ALIGN_TOP_LEFT, cx - 40, cy + 18);
        lv_obj_set_width(b.valueLabel, 80);
        lv_obj_set_style_text_align(b.valueLabel, LV_TEXT_ALIGN_CENTER, 0);
        dv.gearBox = b.valueLabel;            // flashes with the shift light
        dv.gearRgb = 0;
    }

    /* ---- right: the panel ---- */
    lv_obj_t *card = makeCard(sd.root, px, ds::TOP - 2, pw, ds::BOTTOM - ds::TOP + 6);

    JsonVariant spCfg = cfg["speed"];
    if (!partOff(spCfg)) {
        sd.bindings.emplace_back();
        GaugeBinding &b = sd.bindings.back();
        dashPart(b, spCfg, METRIC_ID_SPEED, "", "km/h", 0, 260, 0);
        b.kind        = WidgetKind::Cell;
        b.normalColor = colorFromHex(spCfg["color"] | "", lv_color_hex(UI_TEXT));
        b.valueLabel  = makeLabel(card, "--", &lv_font_montserrat_48, b.normalColor,
                                  LV_ALIGN_TOP_MID, 0, 2);
        b.unitLabel   = makeLabel(card, b.units.c_str(), &lv_font_montserrat_14,
                                  lv_color_hex(UI_MUTED), LV_ALIGN_TOP_MID, 0, 50);
        lv_obj_set_width(b.valueLabel, pw - 16);
        lv_label_set_long_mode(b.valueLabel, LV_LABEL_LONG_CLIP);
        lv_obj_set_style_text_align(b.valueLabel, LV_TEXT_ALIGN_CENTER, 0);
    }
    makeRule(card, 14, 74, pw - 30);

    /* ---- fuel and coolant: symbol, slim bar, value ---- */
    struct BarSpec {
        const char *key; uint16_t id; const char *units;
        float mn, mx; int y; uint8_t icon;
    };
    static const BarSpec kBars[2] = {
        {"fuel", METRIC_ID_FUEL_LEVEL,   "%",             0, 100,  82, ICON_FUEL},
        {"temp", METRIC_ID_COOLANT_TEMP, "\xC2\xB0" "C", 40, 130, 108, ICON_COOLANT},
    };
    for (const BarSpec &bs : kBars) {
        JsonVariant v = cfg[bs.key];
        if (partOff(v)) continue;
        sd.bindings.emplace_back();
        GaugeBinding &b = sd.bindings.back();
        dashPart(b, v, bs.id, "", bs.units, bs.mn, bs.mx, 0);
        b.kind        = WidgetKind::Bar;
        b.inlineUnits = true;
        b.normalColor = colorFromHex(v["color"] | "", lv_color_hex(UI_ACCENT));

        lv_obj_t *ic = makeLamp(card, bs.icon, 10, bs.y);
        lv_obj_set_style_img_recolor(ic, lv_color_hex(UI_MUTED), 0);
        (bs.icon == ICON_FUEL ? dv.fuelIcon : dv.tempIcon) = ic;
        (bs.icon == ICON_FUEL ? dv.fuelRgb  : dv.tempRgb)  = UI_MUTED;

        lv_obj_t *bar = lv_bar_create(card);
        lv_obj_set_pos(bar, 42, bs.y + 9);
        lv_obj_set_size(bar, pw - 42 - 70, 6);
        lv_bar_set_range(bar, 0, 1000);
        lv_bar_set_value(bar, 0, LV_ANIM_OFF);
        lv_obj_set_style_radius(bar, 3, 0);
        lv_obj_set_style_radius(bar, 3, LV_PART_INDICATOR);
        // The track in the line colour, not the panel colour: the panel
        // shade vanishes at night, and an empty bar then looks like no bar.
        lv_obj_set_style_bg_color(bar, lv_color_hex(UI_LINE), LV_PART_MAIN);
        lv_obj_set_style_bg_color(bar, b.normalColor, LV_PART_INDICATOR);
        lv_obj_clear_flag(bar, LV_OBJ_FLAG_SCROLLABLE | LV_OBJ_FLAG_CLICKABLE);
        b.bar = bar;

        b.valueLabel = makeLabel(card, "--", &lv_font_montserrat_14,
                                 lv_color_hex(UI_TEXT), LV_ALIGN_TOP_RIGHT, -12, bs.y + 4);
        lv_obj_set_width(b.valueLabel, 60);
        lv_label_set_long_mode(b.valueLabel, LV_LABEL_LONG_CLIP);
        lv_obj_set_style_text_align(b.valueLabel, LV_TEXT_ALIGN_RIGHT, 0);
    }

    /* ---- four small readouts, two by two ---- */
    static const struct { uint16_t id; const char *label, *units; uint8_t dec; }
    kInfo[4] = {
        {METRIC_ID_BATT_VOLTAGE, "BATT",  "V",               1},
        {METRIC_ID_OIL_TEMP,     "OIL",   "\xC2\xB0" "C",    0},
        {METRIC_ID_IAT,          "IAT",   "\xC2\xB0" "C",    0},
        {METRIC_ID_BOOST,        "BOOST", "bar",             2},
    };
    JsonVariant infoCfg = cfg["info"];
    if (!partOff(infoCfg)) {
        makeRule(card, 14, 140, pw - 30);
        JsonArray arr = infoCfg.as<JsonArray>();
        const size_t n = arr.isNull() ? 4 : min((size_t)arr.size(), (size_t)4);
        const int colW = (pw - 28) / 2;
        for (size_t i = 0; i < n; i++) {
            sd.bindings.emplace_back();
            GaugeBinding &b = sd.bindings.back();
            if (arr.isNull())
                dashPart(b, JsonVariant(), kInfo[i].id, kInfo[i].label,
                         kInfo[i].units, 0, 100, kInfo[i].dec);
            else
                dashPart(b, arr[i], 0, "", "", 0, 100, 0);
            b.kind        = WidgetKind::TextRow;
            b.normalColor = colorFromHex(arr.isNull() ? "" : (arr[i]["color"] | ""),
                                         lv_color_hex(UI_TEXT));
            const int x = 14 + (int)(i % 2) * (colW + 4);
            const int y = 148 + (int)(i / 2) * 36;
            b.nameLabel  = makeCaption(card, b.label.c_str(), LV_ALIGN_TOP_LEFT, x, y);
            b.valueLabel = makeLabel(card, "--", &lv_font_montserrat_16, b.normalColor,
                                     LV_ALIGN_TOP_LEFT, x, y + 14);
            lv_obj_set_width(b.valueLabel, colW);
            lv_label_set_long_mode(b.valueLabel, LV_LABEL_LONG_DOT);
        }
    }
}

/* ---- watchdog list ------------------------------------------------------- */

/**
 * @brief Parse "watchdog" from layout.json into the guard list.
 *
 * Deliberately independent of the screens: a metric can be policed without
 * being displayed anywhere, which is the whole point of a guard. Items with
 * no usable threshold are dropped rather than silently never firing.
 */
void UIBuilder::parseWatchdog() {
    JsonObject wd = Config.layout()["watchdog"];
    _watchEnabled = wd.isNull() ? true : (wd["enabled"] | true);
    _watchPopups  = wd.isNull() ? true : (wd["show_popup"] | true);
    _alertAsBar   = strcmp(wd["alert_style"] | "bar", "card") != 0;

    JsonArray items = wd["items"].as<JsonArray>();
    if (items.isNull()) return;

    for (JsonObject it : items) {
        WatchItem w;
        w.metricId = parseMetricId(it["metric_id"]);
        w.label    = String(it["label"] | "");
        w.units    = String(it["units"] | "");
        w.decimals = it["decimals"] | 0;
        w.popup    = it["popup"] | true;   // false = police it silently
        parseThreshold(w.warn, it["warning"],  false);
        parseThreshold(w.crit, it["critical"], true);

        if (!w.metricId) continue;
        if (!w.warn.enabled && !w.crit.enabled) {
            log_w("watchdog item 0x%04X has no thresholds — ignored", w.metricId);
            continue;
        }
        if (!w.label.length()) w.label = String("0x") + String(w.metricId, HEX);
        _watch.push_back(w);
    }
    log_i("Watchdog: %u item(s), %s", (unsigned)_watch.size(),
          _watchEnabled ? "armed" : "disabled");
}

/* ---- diagnostics screen -------------------------------------------------- */

void UIBuilder::buildDiag(ScreenDef &sd) {
    sd.isDiag = true;
    addHeader(sd.root, "DIAGNOSTICS");

    static const char *names[DIAG_ROWS] = {"Link", "Rate", "Drops", "Seq",
                                           "Heap", "PSRAM", "Uptime", "GPIO"};

    // Two panels of four rows. The GPIO scan is the widest value, so it
    // takes the last row of the right-hand panel where it has room.
    const int perColumn = DIAG_ROWS / 2;
    const int cardW = (LCD_WIDTH - 2 * ds::MARGIN - ds::GUTTER) / 2;
    const int pitch = 29;
    const int cardH = perColumn * pitch + 8;
    lv_obj_t *card[2] = {
        makeCard(sd.root, ds::MARGIN, ds::TOP, cardW, cardH),
        makeCard(sd.root, ds::MARGIN + cardW + ds::GUTTER, ds::TOP, cardW, cardH)};

    for (int i = 0; i < DIAG_ROWS; i++) {
        const int col = i / perColumn, slot = i % perColumn;
        const int y   = 4 + slot * pitch;
        if (slot > 0) makeRule(card[col], 14, y, cardW - 30);
        makeLabel(card[col], names[i], &lv_font_montserrat_14,
                  lv_color_hex(UI_MUTED), LV_ALIGN_TOP_LEFT, 14, y + 7);
        _diagVals[i] = makeLabel(card[col], "--", &lv_font_montserrat_16,
                                 lv_color_hex(UI_TEXT), LV_ALIGN_TOP_RIGHT, -14, y + 5);
        lv_obj_set_width(_diagVals[i], cardW - 90);
        lv_label_set_long_mode(_diagVals[i], LV_LABEL_LONG_DOT);
        lv_obj_set_style_text_align(_diagVals[i], LV_TEXT_ALIGN_RIGHT, 0);
    }

    /*
     * Live touch readout.
     *
     * Taps working while swipes do not is the signature of a touch panel
     * bonded 90 degrees out: a tap lands wherever it lands, but every
     * horizontal drag arrives as vertical movement and fires the wrong
     * gesture. Watching the raw numbers while dragging a finger settles it in
     * seconds - drag left-to-right and see whether X or Y is the one moving.
     */
    const int touchY = ds::TOP + cardH + ds::GUTTER;
    lv_obj_t *tc = makeCard(sd.root, ds::MARGIN, touchY,
                            LCD_WIDTH - 2 * ds::MARGIN, 32);
    makeLabel(tc, "Touch", &lv_font_montserrat_14, lv_color_hex(UI_MUTED),
              LV_ALIGN_LEFT_MID, 14, 0);
    _diagTouch = makeLabel(tc, "--", &lv_font_montserrat_16, lv_color_hex(UI_TEXT),
                           LV_ALIGN_LEFT_MID, 80, 0);

    /*
     * Colour reference strip.
     *
     * Each patch is a pure primary or secondary, so a colour fault names
     * itself instead of being argued about: if R looks blue the channels are
     * exchanged (set global.bgr_order), and if every patch looks washed
     * toward one hue it is the panel's own cast rather than a channel order
     * problem.
     */
    struct Sw { uint32_t rgb; const char *tag; };
    static const Sw swatches[] = {
        {0xFF0000, "R"}, {0x00FF00, "G"}, {0x0000FF, "B"}, {0x00FFFF, "C"},
        {0xFF00FF, "M"}, {0xFFFF00, "Y"}, {0xFFFFFF, "W"},
    };
    const int n = sizeof(swatches) / sizeof(swatches[0]);
    const int gap = 8;
    const int sw  = (LCD_WIDTH - 2 * ds::MARGIN - (n - 1) * gap) / n;
    const int swY = touchY + 32 + ds::GUTTER;
    for (int i = 0; i < n; i++) {
        lv_obj_t *box = lv_obj_create(sd.root);
        lv_obj_remove_style_all(box);
        lv_obj_set_size(box, sw, 22);
        lv_obj_set_pos(box, ds::MARGIN + i * (sw + gap), swY);
        lv_obj_set_style_bg_color(box, lv_color_hex(swatches[i].rgb), 0);
        lv_obj_set_style_bg_opa(box, LV_OPA_COVER, 0);
        lv_obj_set_style_radius(box, 6, 0);
        lv_obj_clear_flag(box, LV_OBJ_FLAG_SCROLLABLE | LV_OBJ_FLAG_CLICKABLE);
        lv_obj_t *tag = lv_label_create(box);
        lv_label_set_text(tag, swatches[i].tag);
        lv_obj_set_style_text_color(tag, lv_color_black(), 0);
        lv_obj_set_style_text_font(tag, &lv_font_montserrat_14, 0);
        lv_obj_center(tag);
    }
}

/* ═══════════════════════════════ runtime ═════════════════════════════════ */

void UIBuilder::uiTimerCb(lv_timer_t *t) {
    static_cast<UIBuilder *>(t->user_data)->tick();
}

void UIBuilder::tick() {
    if (_configActive) return;
    // The calibration wizard owns the screen: nothing may be drawn over it.
    if (_calActive) { hideOverlays(); return; }

    // Day/night follows the Master's flag unless the user forced a mode.
    const bool night = (_nightOverride == NightOverride::ForceDay)   ? false
                     : (_nightOverride == NightOverride::ForceNight) ? true
                     : Telemetry.nightMode();
    if (night != _night) { _night = night; applyNight(night); }

    // Give a running screen transition the whole frame budget: gauge writes
    // invalidate areas of both screens mid-slide, which is what turns a
    // smooth animation into a stutter.
    if (_sweepActive) return;
    if (_busyMs) {
        // Elapsed time, unsigned: right across the millis() wrap. An end
        // time compared with `<` froze the gauges for 49 days when a slide
        // straddled the wrap.
        if (millis() - _busySinceMs < _busyMs) return;
        _busyMs = 0;
    }

    const float lerp = Config.lerpSpeed();
    const uint32_t now = millis();
    _tickCache.clear();
    const bool reverse = reverseEngaged();
    for (size_t si = 0; si < _screens.size(); si++) {
        const bool visible = (si == _active);
        for (auto &b : _screens[si].bindings) {
            MetricSample s{};
            const bool ok = sampleOnce(b.metricId, lerp, s);
            bool usable = ok && (s.flags & METRIC_FLAG_VALID) && !s.stale;
            float shown = s.value;
            if (b.fmt == ValueFmt::Gear) {
                // Gears are whole: a glide from 2 to 4 would show 3 on the
                // way. And the reverse switch, where the bus has one, wins.
                shown = s.raw;
                if (reverse) { shown = -1; usable = true; }
            }
            evalAlarm(b, ok ? s.raw : 0, ok ? s.flags : 0, usable);
            if (usable) b.lastValue = shown;

            // Chart history advances even while its screen is off-view, so
            // swiping to a trend shows real history instead of a blank strip.
            if (b.chart && b.series && usable &&
                now - b.lastChartMs >= b.chartPeriod) {
                b.lastChartMs = now;
                lv_chart_set_next_value(b.chart, b.series, (lv_coord_t)lroundf(s.raw));
            }

            if (visible) renderBinding(b, shown, usable, ok ? s.peak : 0);
        }
    }

    _lamps.update(Telemetry, now);
    const int dash = _screens[_active].dash;
    if (dash >= 0) updateDash(_dash[dash], lerp, now);

    if (_diagIndex >= 0 && (size_t)_diagIndex == _active) updateDiag();
    updateTelltaleStrip();
    manageAlert();

    // link badge on the visible screen
    lv_obj_t *icon = _screens[_active].linkIcon;
    if (icon) {
        if (Telemetry.linkUp()) lv_obj_add_flag(icon, LV_OBJ_FLAG_HIDDEN);
        else                    lv_obj_clear_flag(icon, LV_OBJ_FLAG_HIDDEN);
    }
}

bool UIBuilder::sampleOnce(uint16_t id, float lerp, MetricSample &s) {
    for (const TickSample &c : _tickCache)
        if (c.id == id) { s = c.s; return c.ok; }
    TickSample c{id, false, {}};
    c.ok = Telemetry.sample(id, lerp, c.s);
    _tickCache.push_back(c);          // reserved in begin(): no churn per tick
    s = c.s;
    return c.ok;
}

bool UIBuilder::reverseEngaged() {
    MetricSample r;
    return Telemetry.peek(METRIC_ID_REVERSE, r) &&
           (r.flags & METRIC_FLAG_VALID) && !r.stale && r.raw >= 0.5f;
}

void UIBuilder::formatBinding(const GaugeBinding &b, float v, char *out,
                              size_t n) {
    if (b.fmt == ValueFmt::Gear && !isnan(v)) {
        const long g = lroundf(v);
        if (g < 0)       strlcpy(out, "R", n);
        else if (g == 0) strlcpy(out, "N", n);
        else if (g <= 9) snprintf(out, n, "%ld", g);
        else             strlcpy(out, "--", n);
        return;
    }
    formatValue(out, n, v, b.decimals);
}

/**
 * @brief Write a label only when its text actually changed.
 *
 * lv_label_set_text reallocates and invalidates unconditionally. At 50 fps
 * with a 48 px font that is the single most expensive thing the UI does, and
 * most of the time the displayed digits are identical to the previous frame.
 *
 * @param label    Target label; nullptr is ignored.
 * @param cache    Buffer holding the last text written to @p label.
 * @param cacheLen Size of @p cache.
 * @param txt      New text.
 */
static void setLabelText(lv_obj_t *label, char *cache, size_t cacheLen,
                         const char *txt) {
    if (!label || strncmp(cache, txt, cacheLen) == 0) return;
    strlcpy(cache, txt, cacheLen);
    lv_label_set_text(label, txt);
}

void UIBuilder::renderBinding(GaugeBinding &b, float value, bool usable,
                              float peak) {
    char buf[24];
    if (!usable) {
        setLabelText(b.valueLabel, b.lastText, sizeof(b.lastText), "--");
        setGaugeValue(b, b.minV);
        return;
    }

    setGaugeValue(b, value);
    if (b.valueLabel) {
        formatBinding(b, value, buf, sizeof(buf));
        if ((b.kind == WidgetKind::TextRow || b.inlineUnits) && b.units.length()) {
            char withUnits[32];
            snprintf(withUnits, sizeof(withUnits), "%s %s", buf, b.units.c_str());
            setLabelText(b.valueLabel, b.lastText, sizeof(b.lastText), withUnits);
        } else {
            setLabelText(b.valueLabel, b.lastText, sizeof(b.lastText), buf);
        }
    }
    if (b.peakLabel && _peaksShown && peak > -INFINITY) {
        char peakTxt[24];
        formatValue(buf, sizeof(buf), peak, b.decimals);
        snprintf(peakTxt, sizeof(peakTxt), LV_SYMBOL_UP " %s", buf);
        setLabelText(b.peakLabel, b.lastPeakText, sizeof(b.lastPeakText), peakTxt);
    }
}

void UIBuilder::setGaugeValue(GaugeBinding &b, float v) {
    v = constrain(v, b.minV, b.maxV);
    if (b.arc) {
        const int32_t pos =
            (int32_t)((v - b.minV) / (b.maxV - b.minV) * 1000.0f);
        if (pos != b.lastArcVal) { b.lastArcVal = pos; lv_arc_set_value(b.arc, pos); }
    }
    if (b.meter && b.needle) {
        // lv_meter_set_indicator_value invalidates unconditionally, so this
        // guard is what keeps a parked needle from redrawing 50×/second.
        const int32_t nv = (int32_t)lroundf(v);
        if (nv != b.lastNeedleVal) {
            b.lastNeedleVal = nv;
            lv_meter_set_indicator_value(b.meter, b.needle, nv);
        }
    }
    if (b.bar) {
        // Same fixed 0..1000 internal range as the arc, so fractional scales
        // do not quantise away.
        const int32_t pos =
            (int32_t)((v - b.minV) / (b.maxV - b.minV) * 1000.0f);
        if (pos != b.lastBarVal) {
            b.lastBarVal = pos;
            lv_bar_set_value(b.bar, pos, LV_ANIM_OFF);
        }
    }
}

/* ---- alarms -------------------------------------------------------------- */

/**
 * @brief Has a value crossed into alarm for this tier?
 * @param t Threshold; a disabled tier never trips.
 * @param v Raw value.
 * @return true when the alarm should engage.
 */
static bool thresholdCrossed(const ThresholdCfg &t, float v) {
    if (!t.enabled) return false;
    return t.above ? v >= t.value : v <= t.value;
}

/**
 * @brief Has a value travelled back past the hysteresis band?
 * @param t Threshold; a disabled tier counts as always clear.
 * @param v Raw value.
 * @return true when the alarm may disengage.
 */
static bool thresholdCleared(const ThresholdCfg &t, float v) {
    if (!t.enabled) return true;
    return t.above ? v < t.value - t.hyst : v > t.value + t.hyst;
}

void UIBuilder::evalAlarm(GaugeBinding &b, float raw, uint8_t flags,
                          bool usable) {
    // Master switch: with gauge alarm colors off, every gauge stays in its
    // configured color. Clear any tier still latched from before the switch
    // so the gauge is not left stranded yellow or red.
    if (!_gaugeAlarms) {
        if (b.state != AlarmState::Normal) {
            b.state = AlarmState::Normal;
            onAlarmChanged(b);
        }
        return;
    }

    AlarmState desired = b.state;

    if (!usable) {
        desired = AlarmState::Normal;
    } else {
        // Local thresholds with hysteresis
        switch (b.state) {
            case AlarmState::Normal:
                if      (thresholdCrossed(b.crit, raw)) desired = AlarmState::Critical;
                else if (thresholdCrossed(b.warn, raw)) desired = AlarmState::Warning;
                break;
            case AlarmState::Warning:
                if      (thresholdCrossed(b.crit, raw)) desired = AlarmState::Critical;
                else if (thresholdCleared(b.warn, raw)) desired = AlarmState::Normal;
                break;
            case AlarmState::Critical:
                if (thresholdCleared(b.crit, raw))
                    desired = thresholdCrossed(b.warn, raw) ? AlarmState::Warning
                                                            : AlarmState::Normal;
                break;
        }
        // Master-side flags can only escalate, never suppress local alarms.
        if      (flags & METRIC_FLAG_CRITICAL) desired = AlarmState::Critical;
        else if ((flags & METRIC_FLAG_WARNING) && desired == AlarmState::Normal)
            desired = AlarmState::Warning;
    }

    if (desired != b.state) {
        b.state = desired;
        onAlarmChanged(b);
    }
}

void UIBuilder::onAlarmChanged(GaugeBinding &b) {
    stopPulse(b);
    switch (b.state) {
        case AlarmState::Normal:
            setBindingColor(b, b.normalColor);
            break;
        case AlarmState::Warning:
            setBindingColor(b, b.warn.enabled ? b.warn.color
                                              : lv_color_hex(UI_WARN));
            startPulse(b);            // yellow pulse
            break;
        case AlarmState::Critical:
            setBindingColor(b, b.crit.enabled ? b.crit.color
                                              : lv_color_hex(UI_CRIT));
            break;                    // alert card handled in manageAlert
    }
}

void UIBuilder::setBindingColor(GaugeBinding &b, lv_color_t c) {
    if (b.arc)
        lv_obj_set_style_arc_color(b.arc, c, LV_PART_INDICATOR);
    if (b.bar)
        lv_obj_set_style_bg_color(b.bar, c, LV_PART_INDICATOR);
    if (b.needle) {                   // lv_meter exposes the indicator struct
        b.needle->type_data.needle_line.color = c;
        lv_obj_invalidate(b.meter);
    }
    if (b.valueLabel &&
        (b.kind == WidgetKind::Cell || b.kind == WidgetKind::TextRow))
        lv_obj_set_style_text_color(b.valueLabel, c, 0);
}

void UIBuilder::startPulse(GaugeBinding &b) {
    lv_obj_t *target = b.arc ? b.arc : b.valueLabel;
    if (!target) return;
    lv_anim_t a;
    lv_anim_init(&a);
    lv_anim_set_var(&a, target);
    lv_anim_set_exec_cb(&a, b.arc ? animArcOpa : animTextOpa);
    lv_anim_set_values(&a, 255, 90);
    lv_anim_set_time(&a, 350);
    lv_anim_set_playback_time(&a, 350);
    lv_anim_set_repeat_count(&a, LV_ANIM_REPEAT_INFINITE);
    lv_anim_start(&a);
    b.pulsing = true;
}

void UIBuilder::stopPulse(GaugeBinding &b) {
    if (!b.pulsing) return;
    if (b.arc) {
        lv_anim_del(b.arc, animArcOpa);
        lv_obj_set_style_arc_opa(b.arc, LV_OPA_COVER, LV_PART_INDICATOR);
    }
    if (b.valueLabel) {
        lv_anim_del(b.valueLabel, animTextOpa);
        lv_obj_set_style_text_opa(b.valueLabel, LV_OPA_COVER, 0);
    }
    b.pulsing = false;
}

/* ═════════════════════ alert card (warning triangle) ═════════════════════
 *
 * Replaces the old full-screen red strobe. A strobe that fills a 240 px round
 * screen tells the driver *that* something is wrong while hiding *what* — and
 * at night it wrecks night vision. This card names the metric, shows its
 * value and the limit it crossed, and leaves the gauges readable underneath.
 * It lives on lv_layer_top, so it is visible from whichever screen is up.
 */

/**
 * @brief Describe why an item is in alarm: "HIGH"/"LOW" plus the limit.
 * @param w        Item in alarm.
 * @param[out] out Destination buffer.
 * @param n        Buffer size.
 */
static void alarmDetail(const WatchItem &w, char *out, size_t n) {
    const ThresholdCfg &t = (w.state == AlarmState::Critical && w.crit.enabled)
                                ? w.crit
                                : w.warn;
    if (!t.enabled) {                      // master-flagged, no local threshold
        strlcpy(out, "REPORTED BY MASTER", n);
        return;
    }
    char lim[16];
    formatValue(lim, sizeof(lim), t.value, w.decimals);
    // U+2022 is in LVGL's built-in fonts; the middle dot U+00B7 is not, and
    // silently rendered as nothing.
    snprintf(out, n, "%s  \xE2\x80\xA2  LIMIT %s %s", t.above ? "HIGH" : "LOW",
             lim, w.units.c_str());
}

void UIBuilder::buildAlertCard() {
    _alertCard = lv_obj_create(lv_layer_top());
    lv_obj_set_style_bg_color(_alertCard, lv_color_hex(UI_ALERT_BG), 0);
    lv_obj_set_style_bg_opa(_alertCard, LV_OPA_COVER, 0);
    lv_obj_set_style_pad_all(_alertCard, 0, 0);
    lv_obj_clear_flag(_alertCard, LV_OBJ_FLAG_SCROLLABLE | LV_OBJ_FLAG_CLICKABLE);

    if (_alertAsBar) {
        /*
         * Landscape default: a full-width strip across the top. Everything the
         * card said fits on one line at this width, and nothing the driver is
         * reading gets covered — which was the whole objection to a centred
         * card on a screen this shape.
         */
        lv_obj_set_size(_alertCard, LCD_WIDTH, 38);
        lv_obj_align(_alertCard, LV_ALIGN_TOP_MID, 0, 0);
        lv_obj_set_style_radius(_alertCard, 0, 0);
        lv_obj_set_style_border_side(_alertCard, LV_BORDER_SIDE_BOTTOM, 0);
        lv_obj_set_style_border_width(_alertCard, 3, 0);
    } else {
        lv_obj_set_size(_alertCard, 260, 116);
        lv_obj_center(_alertCard);
        lv_obj_set_style_radius(_alertCard, 14, 0);
        lv_obj_set_style_border_width(_alertCard, 2, 0);
    }

    _alertIcon   = makeLabel(_alertCard, LV_SYMBOL_WARNING, &lv_font_montserrat_20,
                             lv_color_white(), LV_ALIGN_LEFT_MID, 0, 0);
    _alertName   = makeLabel(_alertCard, "", &lv_font_montserrat_14,
                             lv_color_hex(UI_TEXT_DIM), LV_ALIGN_LEFT_MID, 0, 0);
    _alertValue  = makeLabel(_alertCard, "", &lv_font_montserrat_20,
                             lv_color_white(), LV_ALIGN_LEFT_MID, 0, 0);
    _alertDetail = makeLabel(_alertCard, "", &lv_font_montserrat_12,
                             lv_color_hex(UI_MUTED), LV_ALIGN_LEFT_MID, 0, 0);
    _alertMore   = makeLabel(_alertCard, "", &lv_font_montserrat_12,
                             lv_color_hex(UI_MUTED),
                             _alertAsBar ? LV_ALIGN_RIGHT_MID : LV_ALIGN_BOTTOM_RIGHT,
                             -8, _alertAsBar ? 0 : -4);

    // No zoom: LVGL 8.3 cannot scale an alpha-only image and draws nothing.
    // The card gets its own 36 px bitmaps instead.
    _alertImg = lv_img_create(_alertCard);
    lv_img_set_src(_alertImg, Telltales::iconImage(ICON_WARN));
    lv_obj_set_style_img_recolor_opa(_alertImg, LV_OPA_COVER, 0);
    lv_obj_clear_flag(_alertImg, LV_OBJ_FLAG_CLICKABLE);

    // Truncate with an ellipsis rather than running off the edge, where the
    // text is simply invisible and looks like it was never set.
    for (lv_obj_t *l : {_alertName, _alertValue, _alertDetail})
        lv_label_set_long_mode(l, LV_LABEL_LONG_DOT);

    _alertLampLayout = true;           // force the first arrangement through
    applyAlertLayout(false);
    lv_obj_add_flag(_alertCard, LV_OBJ_FLAG_HIDDEN);
}

void UIBuilder::applyAlertLayout(bool lamp) {
    if (lamp == _alertLampLayout) return;
    _alertLampLayout = lamp;

    auto place = [](lv_obj_t *o, const lv_font_t *font, int x, int y, int w) {
        if (font) lv_obj_set_style_text_font(o, font, 0);
        lv_obj_align(o, LV_ALIGN_LEFT_MID, x, y);
        if (w > 0) lv_obj_set_width(o, w);
    };

    if (lamp) {
        lv_obj_add_flag(_alertIcon, LV_OBJ_FLAG_HIDDEN);
        lv_obj_clear_flag(_alertImg, LV_OBJ_FLAG_HIDDEN);
        if (_alertAsBar) {
            // [symbol] TITLE  value  what to do                    +N more
            place(_alertImg,    nullptr,               12,  0, 0);
            place(_alertName,   &lv_font_montserrat_16, 44,  0, 160);
            place(_alertValue,  &lv_font_montserrat_16, 208, 0, 76);
            place(_alertDetail, &lv_font_montserrat_12, 290, 0, 128);
        } else {
            place(_alertImg,    nullptr,               20, 0, 0);   // 36 px set
            place(_alertName,   &lv_font_montserrat_16, 74, -26, 176);
            place(_alertValue,  &lv_font_montserrat_16, 74,  -2, 176);
            place(_alertDetail, &lv_font_montserrat_12, 74,  24, 176);
        }
        lv_obj_set_style_text_color(_alertName, lv_color_white(), 0);
    } else {
        lv_obj_clear_flag(_alertIcon, LV_OBJ_FLAG_HIDDEN);
        lv_obj_add_flag(_alertImg, LV_OBJ_FLAG_HIDDEN);
        if (_alertAsBar) {
            place(_alertIcon,   &lv_font_montserrat_20, 12,  0, 0);
            place(_alertName,   &lv_font_montserrat_14, 42,  0, 112);
            place(_alertValue,  &lv_font_montserrat_20, 158, 0, 128);
            place(_alertDetail, &lv_font_montserrat_12, 292, 0, 120);
        } else {
            place(_alertIcon,   &lv_font_montserrat_32, 18,  0, 0);
            place(_alertName,   &lv_font_montserrat_14, 74, -32, 168);
            place(_alertValue,  &lv_font_montserrat_28, 74,  -2, 168);
            place(_alertDetail, &lv_font_montserrat_12, 74,  28, 168);
        }
        lv_obj_set_style_text_color(_alertName, lv_color_hex(UI_TEXT_DIM), 0);
    }
    // Everything moved: make the next show rewrite every line.
    _alertLastName[0] = _alertLastValue[0] = _alertLastDetail[0] = '\0';
    _alertDetailWide = false;
    _alertKey = 0;
}

void UIBuilder::hideAlert() {
    if (!_alertShown) return;
    if (_alertPulsing) {
        lv_anim_del(_alertCard, animBorderOpa);
        lv_obj_set_style_border_opa(_alertCard, LV_OPA_COVER, 0);
        _alertPulsing = false;
    }
    lv_obj_add_flag(_alertCard, LV_OBJ_FLAG_HIDDEN);
    _alertShown = false;
    _alertLevel = AlarmState::Normal;
    _alertKey   = 0;
}

void UIBuilder::hideOverlays() {
    hideAlert();
    if (_strip && _stripShown) {
        lv_obj_add_flag(_strip, LV_OBJ_FLAG_HIDDEN);
        _stripShown = false;
    }
}

void UIBuilder::showAlert(const AlertView &v, uint8_t othersActive) {
    const bool critical = (v.level == AlarmState::Critical);
    const bool lamp     = (v.img != nullptr);

    if (!_alertShown) {
        lv_obj_clear_flag(_alertCard, LV_OBJ_FLAG_HIDDEN);
        _alertShown = true;
    }
    applyAlertLayout(lamp);

    // Re-style only when the severity or the subject changes.
    if (v.level != _alertLevel || v.key != _alertKey) {
        _alertLevel = v.level;
        _alertKey   = v.key;
        lv_obj_set_style_border_color(_alertCard, v.accent, 0);
        lv_obj_set_style_bg_color(_alertCard,
            critical ? lv_color_hex(UI_ALERT_BG_CRIT) : lv_color_hex(UI_ALERT_BG), 0);
        lv_obj_set_style_text_color(_alertIcon, v.accent, 0);
        if (lamp) {
            lv_img_set_src(_alertImg, v.img);
            lv_obj_set_style_img_recolor(_alertImg, v.accent, 0);
        }

        // Critical pulses its border; warning stays steady so the two tiers
        // are distinguishable at a glance without reading the text.
        if (_alertPulsing) {
            lv_anim_del(_alertCard, animBorderOpa);
            _alertPulsing = false;
        }
        if (critical) {
            lv_anim_t a;
            lv_anim_init(&a);
            lv_anim_set_var(&a, _alertCard);
            lv_anim_set_exec_cb(&a, animBorderOpa);
            lv_anim_set_values(&a, 255, 60);
            lv_anim_set_time(&a, 320);
            lv_anim_set_playback_time(&a, 320);
            lv_anim_set_repeat_count(&a, LV_ANIM_REPEAT_INFINITE);
            lv_anim_start(&a);
            _alertPulsing = true;
        }
        lv_obj_set_style_border_opa(_alertCard, LV_OPA_COVER, 0);
    }

    setLabelText(_alertName,   _alertLastName,   sizeof(_alertLastName),   v.name);
    setLabelText(_alertValue,  _alertLastValue,  sizeof(_alertLastValue),  v.value);
    setLabelText(_alertDetail, _alertLastDetail, sizeof(_alertLastDetail), v.detail);
    // A lamp with no number ("DOOR OPEN") gives the value's place to the
    // advice: on the bar its column, so the advice is not cut short beside
    // an empty gap; on the card its line, so there is no hole in the middle.
    const bool wide = lamp && !v.value[0];
    if (wide != _alertDetailWide) {
        _alertDetailWide = wide;
        if (_alertAsBar) {
            lv_obj_align(_alertDetail, LV_ALIGN_LEFT_MID, wide ? 208 : 290, 0);
            lv_obj_set_width(_alertDetail, wide ? 212 : 128);
        } else {
            lv_obj_align(_alertDetail, LV_ALIGN_LEFT_MID, 74, wide ? 2 : 24);
        }
    }

    if (othersActive) lv_label_set_text_fmt(_alertMore, "+%u more", othersActive);
    else              lv_label_set_text(_alertMore, "");
}

/**
 * @brief Evaluate every watched metric against its own thresholds.
 *
 * Uses the RAW value, not the smoothed one: a guard must react to what the
 * sensor actually reported, not to a display filter that lags it. Hysteresis
 * stops a value hovering on a limit from flickering the alert on and off.
 */
void UIBuilder::evalWatchdog() {
    for (auto &w : _watch) {
        MetricSample s;
        const bool ok = Telemetry.peek(w.metricId, s);
        w.usable = ok && (s.flags & METRIC_FLAG_VALID) && !s.stale;

        if (!w.usable) {          // no data is not the same as no fault, but
            w.state = AlarmState::Normal;   // we cannot judge it either
            continue;
        }
        w.lastValue = s.raw;

        AlarmState desired = w.state;
        switch (w.state) {
            case AlarmState::Normal:
                if      (thresholdCrossed(w.crit, s.raw)) desired = AlarmState::Critical;
                else if (thresholdCrossed(w.warn, s.raw)) desired = AlarmState::Warning;
                break;
            case AlarmState::Warning:
                if      (thresholdCrossed(w.crit, s.raw)) desired = AlarmState::Critical;
                else if (thresholdCleared(w.warn, s.raw)) desired = AlarmState::Normal;
                break;
            case AlarmState::Critical:
                if (thresholdCleared(w.crit, s.raw))
                    desired = thresholdCrossed(w.warn, s.raw) ? AlarmState::Warning
                                                              : AlarmState::Normal;
                break;
        }
        // Master-side flags escalate but never suppress.
        if      (s.flags & METRIC_FLAG_CRITICAL) desired = AlarmState::Critical;
        else if ((s.flags & METRIC_FLAG_WARNING) && desired == AlarmState::Normal)
            desired = AlarmState::Warning;

        w.state = desired;
    }
}

void UIBuilder::manageAlert() {
    const uint32_t now = millis();

    if (_watchEnabled) evalWatchdog();

    // A mute lasts until it expires or its item recovers, whichever is first:
    // a fault that clears and comes back is a new fault.
    if (_ackActive) {
        bool still = false;
        if (_watchEnabled)
            for (const auto &w : _watch)
                still |= (w.metricId == _ackMetric && w.state != AlarmState::Normal);
        if (!still || (int32_t)(now - _ackUntilMs) >= 0) _ackActive = false;
    }

    // Candidates from both paths. Everything alarming counts toward "+N more";
    // only what may pop up can become the card's subject.
    const WatchItem *bw = nullptr;
    int bl = -1;
    uint8_t active = 0;

    if (_watchEnabled) {
        for (const auto &w : _watch) {
            if (w.state == AlarmState::Normal) continue;
            active++;
            // Silent items never take the card: the gauge already shows it.
            if (!_watchPopups || !w.popup) continue;
            // A muted item steps aside, so a second fault still gets through.
            if (_ackActive && w.metricId == _ackMetric && w.state == _ackLevel) continue;
            const bool better = !bw ||
                (w.state == AlarmState::Critical && bw->state != AlarmState::Critical);
            if (better) bw = &w;
        }
    }
    for (size_t i = 0; i < _lamps.size(); i++) {
        if (!_lamps.wantsPopup(i, now)) continue;
        // One card per fault: a watchdog item already alarming on the same
        // metric says it better, with the number and the limit - provided it
        // is at least as urgent. A critical lamp is never hidden behind a
        // watchdog item that is only at warning.
        bool covered = false;
        if (_watchEnabled && _watchPopups)
            for (const auto &w : _watch)
                covered |= (w.popup && w.metricId == _lamps[i].metric &&
                            (w.state == AlarmState::Critical ||
                             (w.state == AlarmState::Warning && !_lamps[i].critical)));
        if (covered) continue;
        active++;
        if (bl < 0 || _lamps.rank(i) < _lamps.rank((size_t)bl)) bl = (int)i;
    }

    // Popups can be suppressed by the screen currently showing. Everything is
    // still evaluated — lamps light, gauges colour — but nothing is drawn on
    // top of this screen.
    if ((!bw && bl < 0) || !_screens[_active].allowPopup) { hideAlert(); return; }

    // Critical beats warning; at equal severity the watchdog's number wins.
    const bool watchCrit = bw && bw->state == AlarmState::Critical;
    const bool lampCrit  = bl >= 0 && _lamps[bl].critical;
    const bool useLamp   = bl >= 0 && (!bw || (lampCrit && !watchCrit));

    AlertView v;
    char value[28], detail[48];
    if (useLamp) {
        const Lamp &l = _lamps[bl];
        v.key    = ALERT_LAMP_KEY | (uint32_t)bl;
        v.level  = l.critical ? AlarmState::Critical : AlarmState::Warning;
        v.accent = lv_color_hex(Telltales::toneRgb(l.tone));
        v.img    = Telltales::iconImage(l.icon, !_alertAsBar);   // 36 px on the card
        v.name   = l.title;
        _lamps.valueText((size_t)bl, value, sizeof(value));
        v.value  = value;
        v.detail = l.detail;
        _lamps.shown((size_t)bl, now);
    } else {
        const WatchItem &w = *bw;
        const bool critical = (w.state == AlarmState::Critical);
        v.key    = w.metricId;
        v.level  = w.state;
        v.accent = critical ? (w.crit.enabled ? w.crit.color : lv_color_hex(UI_CRIT))
                            : (w.warn.enabled ? w.warn.color : lv_color_hex(UI_WARN));
        v.name   = w.label.c_str();
        char num[16];
        formatValue(num, sizeof(num), w.lastValue, w.decimals);
        snprintf(value, sizeof(value), "%s %s", num, w.units.c_str());
        v.value  = value;
        // A critical tier may carry a custom headline from layout.json.
        if (critical && w.crit.enabled && w.crit.overlayText.length())
            strlcpy(detail, w.crit.overlayText.c_str(), sizeof(detail));
        else
            alarmDetail(w, detail, sizeof(detail));
        v.detail = detail;
    }
    showAlert(v, active > 1 ? (uint8_t)(active - 1) : 0);
}

bool UIBuilder::acknowledgeAlert() {
    if (!_alertShown) return false;
    const uint32_t now = millis();
    if (_alertKey >= ALERT_LAMP_KEY) {
        // Lamps keep their own mute: a Once lamp stays quiet until it goes
        // out, a Repeat lamp for alert_ack_ms.
        _lamps.acknowledge(_alertKey - ALERT_LAMP_KEY, now);
    } else {
        _ackActive  = true;
        _ackMetric  = (uint16_t)_alertKey;
        _ackLevel   = _alertLevel;
        _ackUntilMs = now + Config.alertAckMs();
    }
    hideAlert();
    showToast("ALERT MUTED");
    return true;
}

/* ═════════════════════════════ lamp strip ════════════════════════════════
 *
 * The lit lamps, over whichever screen is up — the way the car's own cluster
 * keeps its telltales visible whatever the trip computer is showing. Only as
 * wide as the lamps it holds, and gone when none are lit.
 */

/** Horizontal distance between strip slots, and the pill's inner margin. */
static constexpr int STRIP_PITCH = 28, STRIP_PAD = 5;

void UIBuilder::buildTelltaleStrip() {
    // Switched off: build nothing, and leave its LVGL heap to the screens.
    if (!_lamps.strip()) return;
    _strip = lv_obj_create(lv_layer_top());
    lv_obj_set_size(_strip, STRIP_PITCH + 8, 32);
    lv_obj_set_style_radius(_strip, 8, 0);
    lv_obj_set_style_bg_color(_strip, lv_color_hex(UI_PANEL), 0);
    lv_obj_set_style_bg_opa(_strip, LV_OPA_90, 0);
    lv_obj_set_style_border_width(_strip, 1, 0);
    lv_obj_set_style_border_color(_strip, lv_color_hex(UI_LINE), 0);
    lv_obj_set_style_pad_all(_strip, 0, 0);
    lv_obj_clear_flag(_strip, LV_OBJ_FLAG_SCROLLABLE | LV_OBJ_FLAG_CLICKABLE);
    // In the header band every screen keeps free for it (top right), so
    // lamps never sit over a reading. strip_position is the round board's
    // choice; here the header is the place.
    lv_obj_align(_strip, LV_ALIGN_TOP_RIGHT, -ds::MARGIN + 4, 3);

    for (size_t j = 0; j < STRIP_SLOTS; j++) {
        _stripImg[j] = makeLamp(_strip, ICON_WARN, 0, 0);
        lv_obj_align(_stripImg[j], LV_ALIGN_LEFT_MID, STRIP_PAD + (int)j * STRIP_PITCH, 0);
        lv_obj_add_flag(_stripImg[j], LV_OBJ_FLAG_HIDDEN);
        _stripIcon[j] = ICON_WARN;
        _stripRgb[j]  = LAMP_HIDDEN;
    }
    _stripMore = makeLabel(_strip, "", &lv_font_montserrat_12,
                           lv_color_hex(UI_MUTED), LV_ALIGN_LEFT_MID, 0, 0);
    lv_obj_add_flag(_stripMore, LV_OBJ_FLAG_HIDDEN);
    lv_obj_add_flag(_strip, LV_OBJ_FLAG_HIDDEN);
}

void UIBuilder::updateTelltaleStrip() {
    if (!_strip) return;

    // Full strip, or folded to the most urgent fault plus "+N" - see
    // Telltales::stripFull.
    int slots[STRIP_SLOTS];
    int more = 0;
    size_t n = 0;
    if (_lamps.strip() && _screens[_active].showTelltales)
        n = collectLamps(_lamps, true, slots, _lamps.stripFull() ? STRIP_SLOTS : 2, more);

    if (n == 0) {
        if (_stripShown) { lv_obj_add_flag(_strip, LV_OBJ_FLAG_HIDDEN); _stripShown = false; }
        return;
    }

    int moreSlot = -1;
    for (size_t j = 0; j < STRIP_SLOTS; j++) {
        uint32_t want = LAMP_HIDDEN;
        if (j < n && slots[j] < 0) {
            moreSlot = (int)j;
        } else if (j < n) {
            const Lamp &l = _lamps[(size_t)slots[j]];
            if (l.icon != _stripIcon[j]) {
                _stripIcon[j] = l.icon;
                lv_img_set_src(_stripImg[j], Telltales::iconImage(l.icon));
            }
            // The dark half of a flash keeps its slot, drawn as a ghost.
            want = l.lit ? Telltales::toneRgb(l.tone) : UI_LAMP_OFF;
        }
        setLamp(_stripImg[j], _stripRgb[j], want);
    }
    const int moreKey = more > 0 ? more * 16 + moreSlot : -1;
    if (moreKey != _stripMoreN) {
        _stripMoreN = moreKey;
        if (more > 0) {
            lv_label_set_text_fmt(_stripMore, "+%d", more);
            lv_obj_align(_stripMore, LV_ALIGN_LEFT_MID,
                         STRIP_PAD + moreSlot * STRIP_PITCH + 2, 0);
            lv_obj_clear_flag(_stripMore, LV_OBJ_FLAG_HIDDEN);
        } else {
            lv_obj_add_flag(_stripMore, LV_OBJ_FLAG_HIDDEN);
        }
    }
    if (n != _stripCount) {
        _stripCount = n;
        lv_obj_set_width(_strip, (int)n * STRIP_PITCH + 8);
    }
    if (!_stripShown) { lv_obj_clear_flag(_strip, LV_OBJ_FLAG_HIDDEN); _stripShown = true; }
}

/* ═══════════════════════════════ dash runtime ════════════════════════════ */

void UIBuilder::updateDash(DashView &dv, float lerp, uint32_t now) {
    uint32_t rgb;
    bool lit;

    // The header over the panel: lit lamps only, centred between the arrows.
    if (dv.slots) {
        int slots[DASH_LAMP_SLOTS];
        int more = 0;
        const size_t n = collectLamps(_lamps, false, slots, dv.slots, more);
        const int px = ds::FACE_D + 20, pw = LCD_WIDTH - px - ds::MARGIN;
        const int x0 = px + pw / 2 - ((int)n * 28 - 4) / 2;
        for (size_t k = 0; k < dv.slots; k++) {
            uint32_t want = LAMP_HIDDEN;
            if (k < n && slots[k] >= 0) {
                const Lamp &l = _lamps[(size_t)slots[k]];
                if (l.icon != dv.slotIcon[k]) {
                    dv.slotIcon[k] = l.icon;
                    lv_img_set_src(dv.slot[k], Telltales::iconImage(l.icon));
                }
                want = l.lit ? Telltales::toneRgb(l.tone) : UI_LAMP_OFF;
                if (lv_obj_get_x(dv.slot[k]) != x0 + (int)k * 28)
                    lv_obj_set_x(dv.slot[k], x0 + (int)k * 28);
            }
            setLamp(dv.slot[k], dv.slotRgb[k], want);
        }
    }
    for (int t = 0; t < 2; t++) {
        uint32_t want = dv.ghosts ? UI_LAMP_OFF : LAMP_HIDDEN;
        if (_lamps.iconState(t ? ICON_TURN_R : ICON_TURN_L, rgb, lit) && lit) want = rgb;
        setLamp(dv.turn[t], dv.turnRgb[t], want);
    }
    // The fuel and coolant symbols take their lamp's colour while it is lit.
    const struct { lv_obj_t *img; uint32_t *cache; uint8_t icon; } marks[2] = {
        {dv.fuelIcon, &dv.fuelRgb, ICON_FUEL}, {dv.tempIcon, &dv.tempRgb, ICON_COOLANT}};
    for (const auto &mk : marks) {
        uint32_t want = UI_MUTED;
        if (_lamps.iconState(mk.icon, rgb, lit) && lit) want = rgb;
        setLamp(mk.img, *mk.cache, want);
    }

    if (dv.shift) {
        MetricSample s{};
        float rpm = 0;
        if (sampleOnce(dv.rpmMetric, lerp, s) && (s.flags & METRIC_FLAG_VALID) && !s.stale)
            rpm = s.raw;                       // raw: a shift light must not lag
        const bool over  = rpm >= dv.shiftRpm;
        const bool flash = ((now / 60) & 1) == 0;         // ~8 Hz at the limit
        static const uint32_t kLed[5] = {UI_LAMP_GREEN, UI_LAMP_GREEN, UI_WARN,
                                         UI_WARN, UI_CRIT};
        for (int k = 0; k < 5; k++) {
            const float at = dv.shiftStart + (dv.shiftRpm - dv.shiftStart) * k / 4.0f;
            const uint32_t want = over ? (flash ? UI_CRIT : UI_LAMP_OFF)
                                       : (rpm >= at ? kLed[k] : UI_LAMP_OFF);
            if (want != dv.ledRgb[k]) {
                dv.ledRgb[k] = want;
                lv_obj_set_style_bg_color(dv.led[k], lv_color_hex(want), 0);
            }
        }
        // The gear figure flashes red with them; 0 hands it back to its own
        // colour (the binding's, which the alarm logic may also set).
        if (dv.gearBox) {
            const uint32_t want = (over && flash) ? UI_CRIT : 0;
            if (want != dv.gearRgb) {
                dv.gearRgb = want;
                if (want) {
                    lv_obj_set_style_text_color(dv.gearBox, lv_color_hex(want), 0);
                } else {
                    for (auto &b : _screens[dv.screen].bindings)
                        if (b.valueLabel == dv.gearBox)
                            lv_obj_set_style_text_color(dv.gearBox, b.normalColor, 0);
                }
            }
        }
    }
}

/* ---- diagnostics --------------------------------------------------------- */

void UIBuilder::updateDiag() {
    LinkStats st = Telemetry.stats();
    const bool up = Telemetry.linkUp();
    char buf[16];

    setLabelText(_diagVals[0], _diagLast[0], sizeof(_diagLast[0]),
                 up ? "UP" : "DOWN");
    lv_obj_set_style_text_color(_diagVals[0],
        up ? lv_palette_main(LV_PALETTE_GREEN)
           : lv_palette_main(LV_PALETTE_RED), 0);

    snprintf(buf, sizeof(buf), "%d pkt/s", (int)st.packetsPerSecond);
    setLabelText(_diagVals[1], _diagLast[1], sizeof(_diagLast[1]), buf);
    snprintf(buf, sizeof(buf), "%u", st.packetsDropped);
    setLabelText(_diagVals[2], _diagLast[2], sizeof(_diagLast[2]), buf);
    snprintf(buf, sizeof(buf), "%u", st.lastSequenceId);
    setLabelText(_diagVals[3], _diagLast[3], sizeof(_diagLast[3]), buf);
    snprintf(buf, sizeof(buf), "%u KB", ESP.getFreeHeap() / 1024);
    setLabelText(_diagVals[4], _diagLast[4], sizeof(_diagLast[4]), buf);

    // PSRAM: zero here means the module's memory type is misconfigured, which
    // is worth seeing at a glance on a board whose UI budget assumes it.
    const uint32_t psk = ESP.getFreePsram() / 1024;
    if (psk) snprintf(buf, sizeof(buf), "%u KB", psk);
    else     strlcpy(buf, "NONE", sizeof(buf));
    setLabelText(_diagVals[5], _diagLast[5], sizeof(_diagLast[5]), buf);

    snprintf(buf, sizeof(buf), "%u s", millis() / 1000);
    setLabelText(_diagVals[6], _diagLast[6], sizeof(_diagLast[6]), buf);

    // Live pin scan: hold the side button and watch which number turns L.
    char scan[24];
    Button.scanState(scan, sizeof(scan));
    setLabelText(_diagVals[7], _diagLast[7], sizeof(_diagLast[7]), scan);
    // Live touch state - see the note in buildDiag on why this is here.
    char t[32];
    // Both frames: raw controller coordinates and the display-pixel result.
    // Touching opposite corners shows whether TOUCH_NATIVE_W/H are right.
    // raw / mapped / largest-raw-seen / last gesture. Drag into all four
    // corners and "max" gives the controller's true range, which is what
    // touch_native_w and touch_native_h must be set to.
    snprintf(t, sizeof(t), "r%d,%d  %d,%d  max%d,%d %s",
             Touch.ctrlX(), Touch.ctrlY(), Touch.rawX(), Touch.rawY(),
             Touch.seenMaxX(), Touch.seenMaxY(), Touch.lastGesture());
    setLabelText(_diagTouch, _diagTouchLast, sizeof(_diagTouchLast), t);
}

/* ---- navigation / gestures ----------------------------------------------- */

void UIBuilder::loadScreen(size_t idx, bool forward) {
    const uint32_t ms = Config.swipeAnimMs();

    /*
     * Transition cost, cheapest first. A screen change repaints all 240×240
     * every frame, and on a 160 MHz single core that budget is tight:
     *
     *   "over" — only the incoming screen moves; the outgoing one is static.
     *            LVGL still composites both, but half the position math and
     *            far less invalidation churn. Default.
     *   "move" — both screens slide. Looks classic, costs the most.
     *   "fade" — cross-fade; blending every pixel, so no cheaper than move.
     *   "none" — instant. Always perfectly smooth because there is nothing
     *            to animate; the honest choice on a busy layout.
     */
    const char *style = Config.swipeAnimStyle();
    lv_scr_load_anim_t anim;
    if (!strcmp(style, "none"))      anim = LV_SCR_LOAD_ANIM_NONE;
    else if (!strcmp(style, "fade")) anim = LV_SCR_LOAD_ANIM_FADE_ON;
    else if (!strcmp(style, "move"))
        anim = forward ? LV_SCR_LOAD_ANIM_MOVE_LEFT : LV_SCR_LOAD_ANIM_MOVE_RIGHT;
    else
        anim = forward ? LV_SCR_LOAD_ANIM_OVER_LEFT : LV_SCR_LOAD_ANIM_OVER_RIGHT;

    // Prime the incoming screen with current values (lerp factor 1 = snap;
    // it is still off-screen, so there is nothing to ease). Without this it
    // slides in showing whatever was last drawn on it, which reads as a
    // one-frame glitch at the start of every transition.
    for (auto &b : _screens[idx].bindings) {
        MetricSample s;
        const bool ok = Telemetry.sample(b.metricId, 1.0f, s);
        const bool usable = ok && (s.flags & METRIC_FLAG_VALID) && !s.stale;
        renderBinding(b, ok ? s.value : 0.0f, usable, ok ? s.peak : 0.0f);
    }

    lv_obj_t *outgoing = _screens[_active].scr;
    _active      = idx;
    // Arrive with lamps already right, and the strip shown or not for the
    // new screen: the tick is suspended for the length of the slide.
    if (_screens[idx].dash >= 0)
        updateDash(_dash[_screens[idx].dash], Config.lerpSpeed(), millis());
    updateTelltaleStrip();
    _busySinceMs = millis();
    _busyMs      = (anim == LV_SCR_LOAD_ANIM_NONE) ? 0 : ms + 40;
    lv_scr_load_anim(_screens[idx].scr, anim,
                     anim == LV_SCR_LOAD_ANIM_NONE ? 0 : ms, 0, false);

    /*
     * LVGL never calls lv_anim_set_path_cb for screen transitions, so they run
     * on the lv_anim_init default: LINEAR. Constant velocity with a hard start
     * and a hard stop is exactly what makes a slide read as mechanical rather
     * than smooth, however high the frame rate is.
     *
     * Retarget the animations LVGL just created. path_cb is consulted on every
     * step, so setting it after the animation has started is safe — and it is
     * the only way in, since the exec callbacks are static inside lv_disp.c.
     * lv_anim_get with a null exec_cb matches any animation on that object.
     */
    const lv_anim_path_cb_t path = easingFromName(Config.swipeEasing());
    if (lv_anim_t *a = lv_anim_get(_screens[idx].scr, nullptr)) a->path_cb = path;
    if (lv_anim_t *a = lv_anim_get(outgoing, nullptr))          a->path_cb = path;
}

void UIBuilder::nextScreen() {
    if (_configActive || _screens.size() < 2) return;
    loadScreen((_active + 1) % _screens.size(), true);
}

void UIBuilder::prevScreen() {
    if (_configActive || _screens.size() < 2) return;
    loadScreen((_active + _screens.size() - 1) % _screens.size(), false);
}

void UIBuilder::togglePeaks() {
    if (_configActive) return;
    _peaksShown = !_peaksShown;
    for (auto &sd : _screens)
        for (auto &b : sd.bindings)
            if (b.peakLabel) {
                if (_peaksShown) lv_obj_clear_flag(b.peakLabel, LV_OBJ_FLAG_HIDDEN);
                else             lv_obj_add_flag(b.peakLabel, LV_OBJ_FLAG_HIDDEN);
            }
    showToast(_peaksShown ? "PEAKS ON" : "PEAKS OFF");
}

void UIBuilder::cycleNightOverride() {
    if (_configActive) return;
    switch (_nightOverride) {
        case NightOverride::Auto:
            _nightOverride = NightOverride::ForceDay;
            showToast("DAY MODE");
            break;
        case NightOverride::ForceDay:
            _nightOverride = NightOverride::ForceNight;
            showToast("NIGHT MODE");
            break;
        default:
            _nightOverride = NightOverride::Auto;
            showToast("AUTO DAY/NIGHT");
            break;
    }
    // tick() picks the new source up on the next pass.
}

void UIBuilder::resetPeaksWithToast() {
    if (_configActive) return;
    Telemetry.resetPeaks();
    for (auto &sd : _screens)
        for (auto &b : sd.bindings) b.lastPeakText[0] = '\0';  // force redraw
    showToast("PEAKS RESET");
}

/* ---- toast ---------------------------------------------------------------- */

void UIBuilder::toastTimerCb(lv_timer_t *t) {
    auto *self = static_cast<UIBuilder *>(t->user_data);
    if (self->_toast) { lv_obj_del(self->_toast); self->_toast = nullptr; }
    self->_toastTimer = nullptr;   // repeat_count 1 — LVGL frees the timer
}

void UIBuilder::showToast(const char *text) {
    if (_toast)      { lv_obj_del(_toast);      _toast = nullptr; }
    if (_toastTimer) { lv_timer_del(_toastTimer); _toastTimer = nullptr; }

    // Lives on lv_layer_top so it survives screen transitions.
    _toast = lv_obj_create(lv_layer_top());
    lv_obj_set_size(_toast, LV_SIZE_CONTENT, LV_SIZE_CONTENT);
    lv_obj_set_style_pad_hor(_toast, 14, 0);
    lv_obj_set_style_pad_ver(_toast, 6, 0);
    lv_obj_set_style_radius(_toast, LV_RADIUS_CIRCLE, 0);
    lv_obj_set_style_bg_color(_toast, lv_color_hex(UI_PANEL), 0);
    lv_obj_set_style_bg_opa(_toast, LV_OPA_90, 0);
    lv_obj_set_style_border_width(_toast, 1, 0);
    lv_obj_set_style_border_color(_toast, lv_color_hex(UI_ACCENT), 0);
    lv_obj_clear_flag(_toast, LV_OBJ_FLAG_SCROLLABLE | LV_OBJ_FLAG_CLICKABLE);
    lv_obj_align(_toast, LV_ALIGN_TOP_MID, 0, 30);

    lv_obj_t *l = lv_label_create(_toast);
    lv_label_set_text(l, text);
    lv_obj_set_style_text_font(l, &lv_font_montserrat_14, 0);
    lv_obj_set_style_text_color(l, lv_color_white(), 0);
    lv_obj_center(l);

    _toastTimer = lv_timer_create(toastTimerCb, 1300, this);
    lv_timer_set_repeat_count(_toastTimer, 1);
}

/* ---- boot needle sweep --------------------------------------------------- */

void UIBuilder::sweepExecCb(void *var, int32_t v) {
    auto *self = static_cast<UIBuilder *>(var);
    ScreenDef &sd = self->_screens[self->_active];
    char buf[24];
    for (auto &b : sd.bindings) {
        float fake = b.minV + (b.maxV - b.minV) * (v / 1000.0f);
        self->setGaugeValue(b, fake);
        if (b.valueLabel) {
            formatBinding(b, fake, buf, sizeof(buf));
            lv_label_set_text(b.valueLabel, buf);
        }
    }
}

void UIBuilder::sweepReadyCb(lv_anim_t *a) {
    static_cast<UIBuilder *>(a->var)->_sweepActive = false;
}

void UIBuilder::startupSweep() {
    if (_screens.empty() || _screens[_active].bindings.empty()) return;
    _sweepActive = true;
    lv_anim_t a;
    lv_anim_init(&a);
    lv_anim_set_var(&a, this);
    lv_anim_set_exec_cb(&a, sweepExecCb);
    lv_anim_set_values(&a, 0, 1000);
    lv_anim_set_time(&a, UI_SWEEP_UP_MS);
    lv_anim_set_playback_time(&a, UI_SWEEP_DOWN_MS);
    lv_anim_set_path_cb(&a, lv_anim_path_ease_in_out);
    lv_anim_set_ready_cb(&a, sweepReadyCb);
    lv_anim_start(&a);
}

/* ---- day / night --------------------------------------------------------- */

void UIBuilder::applyNight(bool night) {
    lv_theme_default_init(lv_disp_get_default(),
                          lv_palette_main(LV_PALETTE_CYAN),
                          lv_palette_main(LV_PALETTE_RED),
                          night, LV_FONT_DEFAULT);
    lv_color_t bg = colorFromHex(night ? Config.nightBg() : Config.dayBg(),
                                 night ? lv_color_black()
                                       : lv_color_hex(UI_BG_DAY));
    for (auto &sd : _screens)
        if (sd.root) lv_obj_set_style_bg_color(sd.root, bg, 0);
    Display.setBrightness(night ? BRIGHTNESS_NIGHT : BRIGHTNESS_DAY);
}

/* ---- config-mode screen --------------------------------------------------- */


/* ═════════════════════ touch calibration wizard ═══════════════════════════
 *
 * Two prompts, two swipes, done. The engine then knows which way raw
 * coordinates move for "right" and for "down", and how many raw units a full
 * traversal covers — the three things that cannot be inferred from the
 * datasheet because they depend on how this particular panel was bonded.
 */

void UIBuilder::startTouchCalibration() {
    _calActive = true;
    hideOverlays();
    _calStep   = 0;

    if (!_calScreen) {
        _calScreen = lv_obj_create(nullptr);
        lv_obj_set_style_bg_color(_calScreen, lv_color_hex(UI_BG_DAY), 0);

        makeLabel(_calScreen, "TOUCH CALIBRATION", &lv_font_montserrat_16,
                  lv_color_hex(UI_ACCENT), LV_ALIGN_TOP_MID, 0, 26);
        _calArrow = makeLabel(_calScreen, LV_SYMBOL_RIGHT,
                              &lv_font_montserrat_48, lv_color_hex(UI_TEXT),
                              LV_ALIGN_CENTER, 0, -20);
        _calTitle = makeLabel(_calScreen, "", &lv_font_montserrat_24,
                              lv_color_hex(UI_TEXT), LV_ALIGN_CENTER, 0, 40);
        _calHint  = makeLabel(_calScreen, "", &lv_font_montserrat_14,
                              lv_color_hex(UI_MUTED), LV_ALIGN_BOTTOM_MID, 0, -26);
    }

    lv_label_set_text(_calArrow, LV_SYMBOL_RIGHT);
    lv_label_set_text(_calTitle, "Swipe LEFT to RIGHT");
    lv_label_set_text(_calHint,
                      "one long swipe across the whole screen");
    lv_scr_load(_calScreen);
    Touch.beginCalibration();
}

void UIBuilder::onCalibrationDrag(int16_t dxRaw, int16_t dyRaw) {
    if (!_calActive) return;

    const float len = sqrtf((float)dxRaw * dxRaw + (float)dyRaw * dyRaw);
    // Reject a stray tap: a calibration swipe has to actually travel, or the
    // direction it implies is noise.
    if (len < 30.0f) {
        lv_label_set_text(_calHint, "too short - swipe further");
        return;
    }

    if (_calStep == 0) {
        _calHdx = dxRaw;
        _calHdy = dyRaw;
        _calStep = 1;
        lv_label_set_text(_calArrow, LV_SYMBOL_DOWN);
        lv_label_set_text(_calTitle, "Swipe TOP to BOTTOM");
        lv_label_set_text(_calHint, "one long swipe down the whole screen");
        return;
    }

    TouchCal c;
    const float hLen = sqrtf((float)_calHdx * _calHdx + (float)_calHdy * _calHdy);
    c.hx   = _calHdx / hLen;      // unit vector pointing screen-RIGHT
    c.hy   = _calHdy / hLen;
    c.vx   = dxRaw / len;         // unit vector pointing screen-DOWN
    c.vy   = dyRaw / len;
    c.hLen = hLen;                // raw units in a full-width traversal
    c.vLen = len;
    c.valid = true;

    Touch.setCalibration(c);
    Touch.endCalibration();
    Config.saveTouchCal(c);

    _calActive = false;
    lv_label_set_text(_calArrow, LV_SYMBOL_OK);
    lv_label_set_text(_calTitle, "Calibrated");
    lv_label_set_text(_calHint, "swipes should work now");
    showToast("TOUCH CALIBRATED");

    // Back to the gauges after a beat so the result can be tried immediately.
    lv_timer_t *t = lv_timer_create([](lv_timer_t *tm) {
        auto *self = static_cast<UIBuilder *>(tm->user_data);
        if (!self->_screens.empty()) lv_scr_load(self->_screens[self->_active].scr);
        lv_timer_del(tm);
    }, 1200, this);
    lv_timer_set_repeat_count(t, 1);
}

/* ═════════════════════════ colour preview ═════════════════════════════════ */

void UIBuilder::previewTimerCb(lv_timer_t *t) {
    auto *self = static_cast<UIBuilder *>(t->user_data);
    self->_previewTimer = nullptr;
    // Put the AP details back so the portal is still findable.
    if (self->_configActive)
        self->showConfigScreen(self->_cfgSsid.c_str(), self->_cfgIp.c_str());
}

void UIBuilder::showColorPreview() {
    if (!_previewScreen) {
        _previewScreen = lv_obj_create(nullptr);
        lv_obj_set_style_bg_color(_previewScreen, lv_color_hex(UI_BG_DAY), 0);

        makeLabel(_previewScreen, "COLOUR CALIBRATION", &lv_font_montserrat_14,
                  lv_color_hex(UI_ACCENT), LV_ALIGN_TOP_MID, 0, 10);

        // Primaries and secondaries: the reference for judging a cast.
        struct Sw { uint32_t rgb; const char *tag; };
        static const Sw sw[] = {
            {0xFF0000,"R"},{0x00FF00,"G"},{0x0000FF,"B"},
            {0x00FFFF,"C"},{0xFF00FF,"M"},{0xFFFF00,"Y"},{0xFFFFFF,"W"},
        };
        const int n = 7, w = 58, gap = 8;
        const int x0 = (LCD_WIDTH - (n * w + (n - 1) * gap)) / 2;
        for (int i = 0; i < n; i++) {
            lv_obj_t *b = lv_obj_create(_previewScreen);
            lv_obj_set_size(b, w, 60);
            lv_obj_set_pos(b, x0 + i * (w + gap), 40);
            lv_obj_set_style_bg_color(b, lv_color_hex(sw[i].rgb), 0);
            lv_obj_set_style_border_width(b, 0, 0);
            lv_obj_set_style_radius(b, 4, 0);
            lv_obj_clear_flag(b, LV_OBJ_FLAG_SCROLLABLE | LV_OBJ_FLAG_CLICKABLE);
            lv_obj_t *tg = lv_label_create(b);
            lv_label_set_text(tg, sw[i].tag);
            lv_obj_set_style_text_color(tg, lv_color_black(), 0);
            lv_obj_center(tg);
        }

        /* A neutral grey ramp is where a colour cast shows up most plainly -
         * far more readable than a saturated patch, because the eye has no
         * expectation of hue to argue with. */
        const int steps = 12, sw2 = 34;
        const int gx = (LCD_WIDTH - steps * sw2) / 2;
        for (int i = 0; i < steps; i++) {
            const uint8_t v = (uint8_t)(255 * i / (steps - 1));
            lv_obj_t *b = lv_obj_create(_previewScreen);
            lv_obj_set_size(b, sw2, 52);
            lv_obj_set_pos(b, gx + i * sw2, 118);
            lv_obj_set_style_bg_color(b, lv_color_make(v, v, v), 0);
            lv_obj_set_style_border_width(b, 0, 0);
            lv_obj_set_style_radius(b, 0, 0);
            lv_obj_clear_flag(b, LV_OBJ_FLAG_SCROLLABLE | LV_OBJ_FLAG_CLICKABLE);
        }

        makeLabel(_previewScreen, "grey ramp - pull a channel down until it looks neutral",
                  &lv_font_montserrat_14, lv_color_hex(UI_MUTED),
                  LV_ALIGN_TOP_MID, 0, 180);
        makeLabel(_previewScreen, "SAMPLE 8888", &lv_font_montserrat_32,
                  lv_color_hex(UI_TEXT), LV_ALIGN_BOTTOM_MID, 0, -14);
    }

    lv_scr_load(_previewScreen);

    // Restart the countdown on every adjustment, so the pattern stays up for
    // as long as sliders are moving and gets out of the way once they stop.
    if (_previewTimer) lv_timer_del(_previewTimer);
    _previewTimer = lv_timer_create(previewTimerCb, 6000, this);
    lv_timer_set_repeat_count(_previewTimer, 1);
}

void UIBuilder::showConfigScreen(const char *ssid, const char *ip) {
    _configActive = true;
    // The tick stops here, so anything left on lv_layer_top would stay over
    // the portal screen for good.
    hideOverlays();
    _cfgSsid = ssid;   // remembered so the colour preview can restore this
    _cfgIp   = ip;

    lv_obj_t *scr = lv_obj_create(nullptr);
    lv_obj_set_style_bg_color(scr, lv_color_hex(UI_CONFIG_BG), 0);

    lv_obj_t *root = lv_obj_create(scr);
    lv_obj_set_size(root, LCD_WIDTH, LCD_HEIGHT);
    lv_obj_center(root);
    lv_obj_set_style_radius(root, LV_RADIUS_CIRCLE, 0);
    lv_obj_set_style_clip_corner(root, true, 0);
    lv_obj_set_style_border_width(root, 0, 0);
    lv_obj_set_style_bg_color(root, lv_color_hex(UI_CONFIG_BG), 0);
    lv_obj_clear_flag(root, LV_OBJ_FLAG_SCROLLABLE);

    lv_obj_t *spin = lv_spinner_create(root, 2000, 40);
    lv_obj_set_size(spin, 220, 220);
    lv_obj_center(spin);
    lv_obj_set_style_arc_width(spin, 4, LV_PART_MAIN);
    lv_obj_set_style_arc_width(spin, 4, LV_PART_INDICATOR);
    lv_obj_set_style_arc_color(spin, lv_color_hex(UI_LINE), LV_PART_MAIN);
    lv_obj_set_style_arc_color(spin, lv_color_hex(UI_ACCENT), LV_PART_INDICATOR);

    makeLabel(root, LV_SYMBOL_WIFI, &lv_font_montserrat_28,
              lv_color_hex(UI_ACCENT), LV_ALIGN_TOP_MID, 0, 40);
    makeLabel(root, "GAUGE STUDIO", &lv_font_montserrat_20,
              lv_color_white(), LV_ALIGN_TOP_MID, 0, 78);
    makeLabel(root, ssid, &lv_font_montserrat_14,
              lv_color_hex(UI_MUTED), LV_ALIGN_CENTER, 0, -6);
    char url[48];
    snprintf(url, sizeof(url), "http://%s", ip);
    makeLabel(root, url, &lv_font_montserrat_16,
              lv_color_hex(UI_ACCENT), LV_ALIGN_CENTER, 0, 22);
    makeLabel(root, "Hold 5s to reboot", &lv_font_montserrat_12,
              lv_color_hex(UI_DIM), LV_ALIGN_BOTTOM_MID, 0, -34);

    lv_scr_load_anim(scr, LV_SCR_LOAD_ANIM_FADE_ON, 300, 0, false);
}
