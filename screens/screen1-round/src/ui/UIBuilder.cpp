/**
 * @file UIBuilder.cpp
 * @ingroup ui
 * @brief Dynamic gauge engine implementation.
 */
#include "UIBuilder.h"

#include "ButtonManager.h"
#include "ConfigManager.h"
#include "DisplayManager.h"
#include "HardwareConfig.h"
#include "MasterPacket.h"
#include "Palette.h"
#include "TelemetryStore.h"
#include "Textures.h"   // generated by tools/make_assets.py

UIBuilder UI;

/* ═══════════════════════════════ helpers ═════════════════════════════════ */

/**
 * @brief Parse a "#RRGGBB" string from the layout.
 * @param s        Candidate string; may be null or malformed.
 * @param fallback Returned when @p s is not a valid 7-character hex color.
 * @return The parsed color, or @p fallback.
 */
static lv_color_t colorFromHex(const char *s, lv_color_t fallback) {
    if (!s || s[0] != '#' || strlen(s) < 7) return fallback;
    uint32_t rgb = strtoul(s + 1, nullptr, 16);
    return lv_color_hex(rgb);
}

/**
 * @brief Read a metric ID written either as "0x010C" or as a number.
 * @param v JSON value holding the ID.
 * @return The 16-bit metric ID, or 0 when unparseable.
 */
static uint16_t parseMetricId(JsonVariantConst v) {
    if (v.is<const char *>())
        return (uint16_t)strtoul(v.as<const char *>(), nullptr, 0);
    return v.as<uint16_t>();
}

/**
 * @brief Map a layout easing name onto an LVGL animation path.
 * @param name One of linear, ease_in, ease_out, ease_in_out, overshoot, bounce.
 * @return The matching path callback; ease-out when unrecognized.
 */
static lv_anim_path_cb_t easingFromName(const char *name) {
    if (!name)                        return lv_anim_path_ease_out;
    if (!strcmp(name, "linear"))      return lv_anim_path_linear;
    if (!strcmp(name, "ease_in"))     return lv_anim_path_ease_in;
    if (!strcmp(name, "ease_in_out")) return lv_anim_path_ease_in_out;
    if (!strcmp(name, "overshoot"))   return lv_anim_path_overshoot;
    if (!strcmp(name, "bounce"))      return lv_anim_path_bounce;
    return lv_anim_path_ease_out;
}

/**
 * @brief Map a requested pixel size onto the nearest compiled-in font.
 * @param px Desired size in pixels.
 * @return The closest enabled Montserrat face; never null.
 */
static const lv_font_t *fontForSize(int px) {
    struct { int sz; const lv_font_t *f; } table[] = {
        {12, &lv_font_montserrat_12}, {14, &lv_font_montserrat_14},
        {16, &lv_font_montserrat_16}, {20, &lv_font_montserrat_20},
        {24, &lv_font_montserrat_24}, {28, &lv_font_montserrat_28},
        {32, &lv_font_montserrat_32}, {40, &lv_font_montserrat_40},
        {48, &lv_font_montserrat_48},
    };
    const lv_font_t *best = table[0].f;
    int bestErr = 999;
    for (auto &e : table) {
        int err = abs(e.sz - px);
        if (err < bestErr) { bestErr = err; best = e.f; }
    }
    return best;
}

/**
 * @brief Format a metric value for display.
 * @param[out] out Destination buffer.
 * @param n        Buffer size.
 * @param v        Value; NaN renders as "--".
 * @param decimals Decimal places.
 */
static void formatValue(char *out, size_t n, float v, uint8_t decimals) {
    if (isnan(v)) { strlcpy(out, "--", n); return; }
    snprintf(out, n, "%.*f", decimals, v);
}

/**
 * @brief The factor that turns a fractional scale into whole numbers.
 *
 * LVGL's meter and chart are integer-valued: a -1..2 bar dial would have four
 * needle positions and an 11..15 V trend five levels. They run in units of
 * 1/unit instead - the smallest power of ten giving about 200 steps across the
 * range, as long as the largest value still fits @p limit.
 */
static float intUnitFor(float minV, float maxV, float limit) {
    const float span = maxV - minV, big = fmaxf(fabsf(minV), fabsf(maxV));
    float u = 1;
    while (span * u < 200.0f && big * u * 10.0f <= limit && u < 10000.0f) u *= 10.0f;
    return u;
}
/** @brief @p v in a meter's or chart's integer units (see intUnitFor). */
static int32_t inUnits(float v, float unit) { return (int32_t)lroundf(v * unit); }
/** @brief ...clamped to what a chart point can hold. */
static lv_coord_t chartPoint(float v, float unit) {
    return (lv_coord_t)constrain(inUnits(v, unit), (int32_t)-32000, (int32_t)32000);
}

/**
 * @brief Create a styled, aligned label in one call.
 * @param parent Container to attach to.
 * @param txt    Initial text.
 * @param font   Face to render with.
 * @param color  Text color.
 * @param align  LVGL alignment anchor.
 * @param x      X offset from the anchor.
 * @param y      Y offset from the anchor.
 * @return The new label.
 */
static lv_obj_t *makeLabel(lv_obj_t *parent, const char *txt,
                           const lv_font_t *font, lv_color_t color,
                           lv_align_t align, int x, int y) {
    lv_obj_t *l = lv_label_create(parent);
    lv_label_set_text(l, txt);
    lv_obj_set_style_text_font(l, font, 0);
    lv_obj_set_style_text_color(l, color, 0);
    lv_obj_align(l, align, x, y);
    return l;
}

/** @name Animation exec callbacks
 *  Each takes the animated object as @p obj and the current value as @p v.
 *  @{ */
/** @brief Animate an arc indicator's opacity. @param obj Arc. @param v Opacity. */
static void animArcOpa(void *obj, int32_t v) {
    lv_obj_set_style_arc_opa((lv_obj_t *)obj, (lv_opa_t)v, LV_PART_INDICATOR);
}
/** @brief Animate a label's opacity. @param obj Label. @param v Opacity. */
static void animTextOpa(void *obj, int32_t v) {
    lv_obj_set_style_text_opa((lv_obj_t *)obj, (lv_opa_t)v, 0);
}
/** @brief Animate a border's opacity. @param obj Object. @param v Opacity. */
static void animBorderOpa(void *obj, int32_t v) {
    lv_obj_set_style_border_opa((lv_obj_t *)obj, (lv_opa_t)v, 0);
}
/** @} */

/**
 * @brief Draw-time hook rewriting meter tick labels: back from the meter's
 *        integer units (GaugeBinding::unit), and divided for display (8000 rpm
 *        shown as "8").
 * @param e LVGL draw event; its user_data is the GaugeBinding.
 */
static void meterTickLabelCb(lv_event_t *e) {
    auto *dsc = lv_event_get_draw_part_dsc(e);
    if (dsc->class_p != &lv_meter_class || dsc->type != LV_METER_DRAW_PART_TICK)
        return;
    if (!dsc->text) return;
    const auto *b = static_cast<const GaugeBinding *>(lv_event_get_user_data(e));
    const float div = b->unit * (b->tickLabelDiv > 1.0f ? b->tickLabelDiv : 1.0f);
    if (div <= 1.0f) return;
    const float v = dsc->value / div;
    // As few decimals as the tick needs: "8", "0.5", "0.25". (LVGL's own
    // printf has no floats; the C library's does.)
    if (fabsf(v - roundf(v)) < 0.005f)
        snprintf(dsc->text, 16, "%d", (int)lroundf(v));
    else if (fabsf(v * 10.0f - roundf(v * 10.0f)) < 0.05f)
        snprintf(dsc->text, 16, "%.1f", v);
    else
        snprintf(dsc->text, 16, "%.2f", v);
}

/** @name Lamp images
 *  @{ */
/** Colour value meaning "hidden" in a lamp's change guard. */
static constexpr uint32_t LAMP_HIDDEN = 0xFFFFFFFFu;

/**
 * @brief Create a lamp symbol: a 24x24 alpha mask coloured by img_recolor.
 * @param parent Container.
 * @param icon   @ref LampIcon.
 * @param x      Left edge.
 * @param y      Top edge.
 * @return The image, drawn in the unlit colour.
 */
static lv_obj_t *makeLamp(lv_obj_t *parent, uint8_t icon, int x, int y) {
    lv_obj_t *img = lv_img_create(parent);
    lv_img_set_src(img, Telltales::iconImage(icon));
    lv_obj_set_pos(img, x, y);
    lv_obj_set_style_img_recolor(img, lv_color_hex(UI_LAMP_OFF), 0);
    lv_obj_set_style_img_recolor_opa(img, LV_OPA_COVER, 0);
    lv_obj_clear_flag(img, LV_OBJ_FLAG_CLICKABLE);
    return img;
}

/**
 * @brief Colour or hide a lamp, touching LVGL only when something changed.
 * @param img   Lamp image; nullptr is ignored.
 * @param cache Last value written, updated here.
 * @param rgb   0xRRGGBB, or LAMP_HIDDEN.
 */
static void setLamp(lv_obj_t *img, uint32_t &cache, uint32_t rgb) {
    if (!img || cache == rgb) return;
    if (rgb == LAMP_HIDDEN) {
        lv_obj_add_flag(img, LV_OBJ_FLAG_HIDDEN);
    } else {
        if (cache == LAMP_HIDDEN) lv_obj_clear_flag(img, LV_OBJ_FLAG_HIDDEN);
        lv_obj_set_style_img_recolor(img, lv_color_hex(rgb), 0);
    }
    cache = rgb;
}

/** @brief `"part": false` in the layout switches a part off. */
static bool partOff(JsonVariant v) { return v.is<bool>() && !v.as<bool>(); }
/** @} */

/* ═══════════════════════════════ build ═══════════════════════════════════ */

void UIBuilder::begin() {
    // Lamps first: the dash screen lays its lamp row out from them.
    _lamps.configure(Config.layout()["warnings"].as<JsonVariantConst>(),
                     Config.alertAckMs());
    _tickCache.reserve(64);

    JsonArray screens = Config.layout()["screens"].as<JsonArray>();
    _screens.reserve(screens.size());
    for (JsonObject cfg : screens) buildScreen(cfg);

    if (_screens.empty()) {                      // defensive: never blank-screen
        JsonDocument d;
        d["type"] = "diag";
        buildScreen(d.as<JsonObject>());
    }

    addPageDots();
    parseWatchdog();
    // The strip goes onto lv_layer_top before the card: later children draw
    // on top, and an alert must never be hidden under the lamps.
    buildTelltaleStrip();
    buildAlertCard();
    _gaugeAlarms = Config.gaugeAlarmColors();
    applyNight(false);
    lv_scr_load(_screens[0].scr);
    _timer = lv_timer_create(uiTimerCb, UI_UPDATE_PERIOD_MS, this);
    log_i("UI built: %u screens, %u lamps, warnings %s", (unsigned)_screens.size(),
          (unsigned)_lamps.size(), _lamps.enabled() ? "on" : "off");
    // LVGL does not report running out of its heap: the next widget comes
    // back null and the display reboots. Log the margin so it can be watched.
    lv_mem_monitor_t mon;
    lv_mem_monitor(&mon);
    log_i("LVGL heap: %u of %u bytes used, largest free block %u",
          (unsigned)(mon.total_size - mon.free_size), (unsigned)mon.total_size,
          (unsigned)mon.free_biggest_size);
}

void UIBuilder::buildScreen(JsonObject cfg) {
    const char *type = cfg["type"] | "arc_gauge";

    _screens.emplace_back();
    ScreenDef &sd = _screens.back();
    sd.allowPopup = cfg["show_popup"] | true;
    sd.showTelltales = cfg["show_telltales"] | true;
    sd.scr = lv_obj_create(nullptr);
    lv_obj_set_style_bg_color(sd.scr, lv_color_black(), 0);
    makeRoundRoot(sd, cfg);

    // Decorative bezel: on for dial-like screens, off for list-like ones
    // where a chapter ring would just crowd the text.
    // The dash draws its own tach arc where the bezel ring would be.
    const bool listLike = !strcmp(type, "diag") || !strcmp(type, "chart") ||
                          !strcmp(type, "dash");
    if (cfg["dial_face"] | !listLike) addDialFace(sd.root);

    if      (!strcmp(type, "arc_gauge"))   buildArcGauge(sd, cfg);
    else if (!strcmp(type, "meter_gauge")) buildMeterGauge(sd, cfg);
    else if (!strcmp(type, "quad") ||
             !strcmp(type, "split"))       buildQuad(sd, cfg);
    else if (!strcmp(type, "text_list"))   buildTextList(sd, cfg);
    else if (!strcmp(type, "chart"))       buildChart(sd, cfg);
    else if (!strcmp(type, "dash"))        buildDash(sd, cfg);
    else if (!strcmp(type, "diag"))      { buildDiag(sd); _diagIndex = _screens.size() - 1; }
    else                                   buildArcGauge(sd, cfg);   // fallback

    // "no link" badge — shown while the firehose is silent
    sd.linkIcon = makeLabel(sd.root, LV_SYMBOL_WIFI, &lv_font_montserrat_14,
                            lv_palette_main(LV_PALETTE_RED),
                            LV_ALIGN_TOP_MID, 0, 10);
    // Inside the dash's tach arc rather than on top of it.
    if (sd.dash >= 0) lv_obj_align(sd.linkIcon, LV_ALIGN_TOP_MID, 0, 16);
    lv_obj_add_flag(sd.linkIcon, LV_OBJ_FLAG_HIDDEN);
}

/**
 * @brief Draw the static "instrument bezel": two concentric hairline rings and
 *        twelve rim ticks, like the chapter ring of a real gauge.
 *
 * Everything here is created once at boot and never touched again, so it
 * costs nothing per frame — LVGL only redraws it when the area is
 * invalidated by something above it.
 */
void UIBuilder::addDialFace(lv_obj_t *root) {
    auto ring = [&](int size, int width, uint32_t color, lv_opa_t opa) {
        lv_obj_t *r = lv_obj_create(root);
        lv_obj_set_size(r, size, size);
        lv_obj_center(r);
        lv_obj_set_style_radius(r, LV_RADIUS_CIRCLE, 0);
        lv_obj_set_style_bg_opa(r, LV_OPA_TRANSP, 0);
        lv_obj_set_style_border_width(r, width, 0);
        lv_obj_set_style_border_color(r, lv_color_hex(color), 0);
        lv_obj_set_style_border_opa(r, opa, 0);
        lv_obj_clear_flag(r, LV_OBJ_FLAG_SCROLLABLE | LV_OBJ_FLAG_CLICKABLE);
        return r;
    };
    ring(238, 2, UI_LINE, LV_OPA_COVER);   // outer bezel
    ring(198, 1, UI_LINE_SOFT, LV_OPA_70);      // inner hairline

    // Twelve rim ticks on the chapter ring.
    for (int i = 0; i < 12; i++) {
        const float ang = i * 30.0f * 3.14159265f / 180.0f;
        lv_obj_t *t = lv_obj_create(root);
        lv_obj_set_size(t, 2, 2);
        lv_obj_set_style_radius(t, LV_RADIUS_CIRCLE, 0);
        lv_obj_set_style_bg_color(t, lv_color_hex(UI_LINE), 0);
        lv_obj_set_style_border_width(t, 0, 0);
        lv_obj_clear_flag(t, LV_OBJ_FLAG_SCROLLABLE | LV_OBJ_FLAG_CLICKABLE);
        lv_obj_align(t, LV_ALIGN_CENTER, (int)(cosf(ang) * 107.0f),
                                          (int)(sinf(ang) * 107.0f));
    }
}

/**
 * @brief Draw one screen's row of page dots.
 *
 * Its user data packs the screen's own index (low byte) and the screen count
 * (next byte). Dots are drawn here rather than created as objects: one
 * object per dot per screen grows with the square of the screen count, and at
 * eight screens that was 64 objects, each with its own style - about 9 KB of
 * the LVGL heap for decoration.
 *
 * @param e LVGL draw event.
 */
static void pageDotsDrawCb(lv_event_t *e) {
    lv_obj_t *obj = lv_event_get_target(e);
    lv_draw_ctx_t *ctx = lv_event_get_draw_ctx(e);
    const uintptr_t packed = (uintptr_t)lv_event_get_user_data(e);
    const int active = (int)(packed & 0xFF), n = (int)((packed >> 8) & 0xFF);

    lv_area_t box;
    lv_obj_get_coords(obj, &box);
    lv_draw_rect_dsc_t d;
    lv_draw_rect_dsc_init(&d);
    d.radius = LV_RADIUS_CIRCLE;
    for (int j = 0; j < n; j++) {
        const int size = (j == active) ? 6 : 4;
        const int cx   = box.x1 + 3 + j * 10;
        d.bg_color = lv_color_hex(j == active ? UI_ACCENT : UI_DIM);
        lv_area_t a;
        a.x1 = cx - size / 2;
        a.x2 = a.x1 + size - 1;
        a.y2 = box.y2;                            // bottom-aligned, as before
        a.y1 = a.y2 - size + 1;
        lv_draw_rect(ctx, &d, &a);
    }
}

/**
 * @brief Page-position dots along the bottom rim, one row per screen.
 *
 * Placed at y = −12 from the bottom, where the round glass still leaves
 * ±56 px of usable width — enough for a dozen dots.
 */
void UIBuilder::addPageDots() {
    const size_t n = _screens.size();
    if (n < 2 || n > 12) return;                 // pointless / too wide

    // One small object per screen that draws the whole row itself.
    for (size_t i = 0; i < n; i++) {
        lv_obj_t *row = lv_obj_create(_screens[i].root);
        lv_obj_remove_style_all(row);
        lv_obj_set_size(row, (lv_coord_t)((n - 1) * 10 + 6), 6);
        lv_obj_align(row, LV_ALIGN_BOTTOM_MID, 0, -12);
        lv_obj_clear_flag(row, LV_OBJ_FLAG_SCROLLABLE | LV_OBJ_FLAG_CLICKABLE);
        lv_obj_add_event_cb(row, pageDotsDrawCb, LV_EVENT_DRAW_MAIN,
                            (void *)(uintptr_t)(i | (n << 8)));
    }
}

lv_obj_t *UIBuilder::makeRoundRoot(ScreenDef &sd, JsonObject cfg) {
    lv_obj_t *root = lv_obj_create(sd.scr);
    lv_obj_set_size(root, LCD_WIDTH, LCD_HEIGHT);
    lv_obj_center(root);
    // Circular canvas discipline: mask children to the round glass.
    lv_obj_set_style_radius(root, LV_RADIUS_CIRCLE, 0);
    lv_obj_set_style_clip_corner(root, true, 0);
    lv_obj_set_style_border_width(root, 0, 0);
    lv_obj_set_style_pad_all(root, 0, 0);
    lv_obj_clear_flag(root, LV_OBJ_FLAG_SCROLLABLE);
    applyBackground(root, cfg);
    sd.root = root;
    return root;
}

/**
 * @brief Paint a screen's background, cheapest option first.
 *
 * Three mechanisms, in ascending cost:
 *
 *  1. "bg_grad": {from, to}  — a two-stop gradient drawn by the style engine.
 *     Essentially free; this is the default.
 *  2. "texture": "carbon"|"mesh" — a 32×32 tile compiled into the firmware
 *     (see tools/make_assets.py). Repeated by LVGL with no filesystem in the
 *     path, so it costs a handful of small blits.
 *  3. "background_asset": "/assets/x.bin" — a full-screen image on LittleFS.
 *     LVGL's built-in decoder streams file-backed images line by line on
 *     EVERY repaint with no full-frame cache, so a 240×240 background is
 *     ~115 KB of flash reads per full repaint. That is fine on a screen that
 *     only invalidates small label areas and ruinous on one that animates,
 *     which is why nothing in the default layout uses it.
 */
void UIBuilder::applyBackground(lv_obj_t *root, JsonObject cfg) {
    lv_color_t base = colorFromHex(Config.dayBg(), lv_color_hex(UI_BG_DAY));
    lv_obj_set_style_bg_color(root, base, 0);

    JsonObject grad = cfg["bg_grad"];
    if (!grad.isNull()) {
        lv_obj_set_style_bg_color(root, colorFromHex(grad["from"] | "", base), 0);
        lv_obj_set_style_bg_grad_color(root,
            colorFromHex(grad["to"] | "", lv_color_hex(UI_BG_GRAD)), 0);
        lv_obj_set_style_bg_grad_dir(root, LV_GRAD_DIR_VER, 0);
    }

    const char *tex = cfg["texture"] | (const char *)nullptr;
    if (tex && tex[0] && strcmp(tex, "none") != 0) {
        const lv_img_dsc_t *src = nullptr;
        if      (!strcmp(tex, "carbon"))  src = &tex_carbon;
        else if (!strcmp(tex, "mesh"))    src = &tex_mesh;
        else if (!strcmp(tex, "gt"))      src = &tex_gt;
        else if (!strcmp(tex, "gt_dial")) src = &tex_gt_dial;
        if (src) {
            // A texture the size of the screen is a complete dial face, so lay
            // it down once, centred. Anything smaller is a swatch meant to be
            // repeated. Deciding from the asset's own dimensions keeps the
            // layout schema free of a flag that could contradict the image.
            const bool full = src->header.w >= LCD_WIDTH &&
                              src->header.h >= LCD_HEIGHT;
            lv_obj_set_style_bg_img_src(root, src, 0);
            lv_obj_set_style_bg_img_tiled(root, !full, 0);
            lv_obj_set_style_bg_img_opa(root, cfg["texture_opa"] | 255, 0);
        } else {
            log_w("unknown texture '%s' — ignored", tex);
        }
    }

    const char *asset = cfg["background_asset"] | (const char *)nullptr;
    if (asset && asset[0]) {
        String src = String("L:") + asset;
        lv_obj_t *img = lv_img_create(root);
        lv_img_set_src(img, src.c_str());
        lv_obj_center(img);
        log_w("screen uses file-backed background '%s' — costs frame rate",
              asset);
    }
}

void UIBuilder::parseCommon(GaugeBinding &b, JsonObject cfg) {
    b.metricId = parseMetricId(cfg["metric_id"]);
    b.label    = String(cfg["label"] | "");
    b.units    = String(cfg["units"] | "");
    b.decimals = (uint8_t)constrain((int)(cfg["decimals"] | 0), 0, 6);
    b.minV     = cfg["min"] | 0.0f;
    b.maxV     = cfg["max"] | 100.0f;
    if (b.maxV <= b.minV) b.maxV = b.minV + 1;    // never divide by zero
    b.unit     = intUnitFor(b.minV, b.maxV, 1e8f);  // meters; charts set their own

    JsonObject th = cfg["thresholds"];
    if (!th.isNull()) {
        parseThreshold(b.warn, th["warning"], false);
        parseThreshold(b.crit, th["critical"], true);
    }
}

void UIBuilder::parseThreshold(ThresholdCfg &t, JsonObject cfg, bool critical) {
    if (cfg.isNull()) return;
    t.enabled = true;
    t.value   = cfg["value"] | 0.0f;
    t.hyst    = fabsf(cfg["hysteresis"] | 0.0f);   // a band, either way
    t.above   = strcmp(cfg["direction"] | "above", "below") != 0;
    t.color   = colorFromHex(cfg["color"] | "",
                             critical ? lv_color_hex(UI_CRIT)
                                      : lv_color_hex(UI_WARN));
    // Leave the headline EMPTY when the layout does not set one. Defaulting it
    // to "CRITICAL" would permanently replace the far more useful
    // "HIGH · LIMIT 115 °C" detail line with a word the red border already
    // conveys. Empty means "fall back to the computed detail".
    if (critical) t.overlayText = String(cfg["overlay_text"] | "");
}

/* ---- arc gauge: one big arc + numeric readout --------------------------- */

void UIBuilder::buildArcGauge(ScreenDef &sd, JsonObject cfg) {
    sd.bindings.reserve(1);
    sd.bindings.emplace_back();
    GaugeBinding &b = sd.bindings.back();
    parseCommon(b, cfg);
    b.kind = WidgetKind::Arc;

    JsonObject ac      = cfg["arc"];
    int  startAngle    = ac["start_angle"] | 135;
    int  endAngle      = ac["end_angle"]   | 45;
    int  width         = ac["width"]       | 18;
    bool rounded       = ac["rounded"]     | true;
    b.normalColor      = colorFromHex(ac["color"] | "", lv_color_hex(UI_ACCENT));
    lv_color_t trackCl = colorFromHex(ac["bg_color"] | "", lv_color_hex(UI_LINE_SOFT));

    lv_obj_t *arc = lv_arc_create(sd.root);
    lv_obj_set_size(arc, 230, 230);
    lv_obj_center(arc);
    lv_arc_set_bg_angles(arc, startAngle, endAngle);
    lv_arc_set_rotation(arc, 0);
    lv_arc_set_range(arc, 0, 1000);               // internal fixed resolution
    lv_arc_set_value(arc, 0);
    lv_obj_remove_style(arc, nullptr, LV_PART_KNOB);
    lv_obj_clear_flag(arc, LV_OBJ_FLAG_CLICKABLE);
    lv_obj_set_style_arc_width(arc, width, LV_PART_MAIN);
    lv_obj_set_style_arc_width(arc, width, LV_PART_INDICATOR);
    lv_obj_set_style_arc_color(arc, trackCl, LV_PART_MAIN);
    lv_obj_set_style_arc_color(arc, b.normalColor, LV_PART_INDICATOR);
    lv_obj_set_style_arc_rounded(arc, rounded, LV_PART_MAIN);
    lv_obj_set_style_arc_rounded(arc, rounded, LV_PART_INDICATOR);
    b.arc = arc;

    const lv_font_t *valFont = fontForSize(cfg["value_font"] | 48);
    b.nameLabel  = makeLabel(sd.root, b.label.c_str(), &lv_font_montserrat_16,
                             lv_color_hex(UI_MUTED), LV_ALIGN_TOP_MID, 0, 44);
    b.valueLabel = makeLabel(sd.root, "--", valFont, lv_color_white(),
                             LV_ALIGN_CENTER, 0, -4);
    b.unitLabel  = makeLabel(sd.root, b.units.c_str(), &lv_font_montserrat_16,
                             lv_color_hex(UI_MUTED), LV_ALIGN_CENTER, 0, 34);
    b.peakLabel  = makeLabel(sd.root, "", &lv_font_montserrat_14,
                             lv_color_hex(UI_ACCENT), LV_ALIGN_CENTER, 0, 58);
    lv_obj_add_flag(b.peakLabel, LV_OBJ_FLAG_HIDDEN);
}

/* ---- meter gauge: radial tachometer with needle & zones ----------------- */

void UIBuilder::buildMeterGauge(ScreenDef &sd, JsonObject cfg) {
    sd.bindings.reserve(1);
    sd.bindings.emplace_back();
    GaugeBinding &b = sd.bindings.back();
    parseCommon(b, cfg);
    b.kind         = WidgetKind::Meter;
    b.tickLabelDiv = cfg["tick_label_div"] | 1.0f;

    JsonObject ac   = cfg["arc"];
    int startAngle  = ac["start_angle"] | 135;
    int endAngle    = ac["end_angle"]   | 45;
    int angleRange  = ((endAngle - startAngle) % 360 + 360) % 360;
    if (angleRange == 0) angleRange = 270;
    b.normalColor   = colorFromHex(ac["color"] | "", lv_color_hex(UI_ACCENT));

    float majorEvery = cfg["major_tick_every"] | ((b.maxV - b.minV) / 8.0f);
    if (majorEvery <= 0) majorEvery = (b.maxV - b.minV) / 8.0f;

    // Every tick is re-rendered on each repaint of the meter, and a screen
    // transition repaints it on every frame. Thin the minor ticks out rather
    // than letting a wide range explode the count.
    int minorPerMajor = 4;
    auto countTicks = [&] {
        // In float first: an absurdly fine spacing would overflow an int.
        const float n = roundf((b.maxV - b.minV) / (majorEvery / minorPerMajor)) + 1.0f;
        return n > 1000.0f ? 1000 : (int)n;
    };
    int tickCnt = countTicks();
    while (tickCnt > 41 && minorPerMajor > 1) {
        minorPerMajor /= 2;
        tickCnt = countTicks();
    }
    tickCnt = constrain(tickCnt, 2, 41);

    lv_obj_t *meter = lv_meter_create(sd.root);
    lv_obj_set_size(meter, 236, 236);
    lv_obj_center(meter);
    lv_obj_set_style_bg_opa(meter, LV_OPA_TRANSP, 0);
    lv_obj_set_style_border_width(meter, 0, 0);
    lv_obj_set_style_pad_all(meter, 0, 0);
    lv_obj_clear_flag(meter, LV_OBJ_FLAG_CLICKABLE);
    b.meter = meter;

    lv_meter_scale_t *scale = lv_meter_add_scale(meter);
    lv_meter_set_scale_ticks(meter, scale, tickCnt, 2, 8,
                             lv_color_hex(UI_DIM));
    lv_meter_set_scale_major_ticks(meter, scale, minorPerMajor, 3, 14,
                                   lv_color_hex(UI_TEXT_DIM), 12);
    lv_meter_set_scale_range(meter, scale, inUnits(b.minV, b.unit),
                             inUnits(b.maxV, b.unit), angleRange, startAngle);

    // Colored warning / critical zones behind the needle
    if (b.warn.enabled && b.warn.above) {
        auto *zone = lv_meter_add_arc(meter, scale, 6, b.warn.color, 0);
        lv_meter_set_indicator_start_value(meter, zone, inUnits(b.warn.value, b.unit));
        lv_meter_set_indicator_end_value(meter, zone,
            inUnits(b.crit.enabled ? b.crit.value : b.maxV, b.unit));
    }
    if (b.crit.enabled && b.crit.above) {
        auto *zone = lv_meter_add_arc(meter, scale, 6, b.crit.color, 0);
        lv_meter_set_indicator_start_value(meter, zone, inUnits(b.crit.value, b.unit));
        lv_meter_set_indicator_end_value(meter, zone, inUnits(b.maxV, b.unit));
    }

    b.needle = lv_meter_add_needle_line(meter, scale, 4, b.normalColor, -16);
    lv_meter_set_indicator_value(meter, b.needle, inUnits(b.minV, b.unit));

    // Divided tick labels ("8" instead of "8000") via draw-part hook.
    if (b.tickLabelDiv > 1.0f || b.unit > 1.0f)
        lv_obj_add_event_cb(meter, meterTickLabelCb, LV_EVENT_DRAW_PART_BEGIN,
                            &b);

    /*
     * The readout stack sits below the hub. Keep it high enough that the round
     * glass never eats it: at 88 px below centre the visible chord is only
     * ~160 px wide and shrinking fast, and the page dots live at the rim
     * below that. Every label is also width-bounded and centre-aligned, so a
     * long units string (e.g. "x1000 rpm") truncates instead of running out
     * past the edge of the circle.
     */
    b.nameLabel  = makeLabel(sd.root, b.label.c_str(), &lv_font_montserrat_16,
                             lv_color_hex(UI_MUTED), LV_ALIGN_CENTER, 0, 28);
    b.valueLabel = makeLabel(sd.root, "--", fontForSize(cfg["value_font"] | 32),
                             lv_color_white(), LV_ALIGN_CENTER, 0, 54);
    b.unitLabel  = makeLabel(sd.root, b.units.c_str(), &lv_font_montserrat_12,
                             lv_color_hex(UI_MUTED), LV_ALIGN_CENTER, 0, 78);
    b.peakLabel  = makeLabel(sd.root, "", &lv_font_montserrat_12,
                             lv_color_hex(UI_ACCENT), LV_ALIGN_TOP_MID, 0, 30);
    lv_obj_add_flag(b.peakLabel, LV_OBJ_FLAG_HIDDEN);

    for (lv_obj_t *l : {b.nameLabel, b.valueLabel, b.unitLabel}) {
        lv_obj_set_width(l, 150);
        lv_label_set_long_mode(l, LV_LABEL_LONG_DOT);
        lv_obj_set_style_text_align(l, LV_TEXT_ALIGN_CENTER, 0);
    }
}

/* ---- quad / split: 2 or 4 metric cells ---------------------------------- */

void UIBuilder::buildQuad(ScreenDef &sd, JsonObject cfg) {
    JsonArray cells = cfg["cells"].as<JsonArray>();
    size_t count = min((size_t)cells.size(), (size_t)4);
    if (count == 0) return;
    sd.bindings.reserve(count);

    // Cell rectangles inside the circle's inscribed square
    struct Rect { int x, y, w, h; };
    static const Rect two[2]  = {{30, 28, 180, 88}, {30, 124, 180, 88}};
    static const Rect four[4] = {{32, 34, 86, 82}, {122, 34, 86, 82},
                                 {32, 124, 86, 82}, {122, 124, 86, 82}};
    const Rect *rects = (count <= 2) ? two : four;

    // Separator lines
    lv_obj_t *hsep = lv_obj_create(sd.root);
    lv_obj_set_size(hsep, 168, 2);
    lv_obj_align(hsep, LV_ALIGN_CENTER, 0, 0);
    lv_obj_set_style_bg_color(hsep, lv_color_hex(UI_LINE), 0);
    lv_obj_set_style_border_width(hsep, 0, 0);
    lv_obj_set_style_radius(hsep, 0, 0);
    if (count > 2) {
        lv_obj_t *vsep = lv_obj_create(sd.root);
        lv_obj_set_size(vsep, 2, 168);
        lv_obj_align(vsep, LV_ALIGN_CENTER, 0, 0);
        lv_obj_set_style_bg_color(vsep, lv_color_hex(UI_LINE), 0);
        lv_obj_set_style_border_width(vsep, 0, 0);
        lv_obj_set_style_radius(vsep, 0, 0);
    }

    const lv_font_t *valFont =
        (count <= 2) ? &lv_font_montserrat_32 : &lv_font_montserrat_24;

    size_t i = 0;
    for (JsonObject cellCfg : cells) {
        if (i >= count) break;
        sd.bindings.emplace_back();
        GaugeBinding &b = sd.bindings.back();
        parseCommon(b, cellCfg);
        b.kind        = WidgetKind::Cell;
        b.normalColor = colorFromHex(cellCfg["color"] | "",
                                     lv_color_hex(UI_TEXT));

        lv_obj_t *cell = lv_obj_create(sd.root);
        lv_obj_set_pos(cell, rects[i].x, rects[i].y);
        lv_obj_set_size(cell, rects[i].w, rects[i].h);
        lv_obj_set_style_bg_opa(cell, LV_OPA_TRANSP, 0);
        lv_obj_set_style_border_width(cell, 0, 0);
        lv_obj_set_style_pad_all(cell, 0, 0);
        lv_obj_clear_flag(cell, LV_OBJ_FLAG_SCROLLABLE);

        b.nameLabel  = makeLabel(cell, b.label.c_str(), &lv_font_montserrat_12,
                                 lv_color_hex(UI_MUTED), LV_ALIGN_TOP_MID, 0, 2);
        b.valueLabel = makeLabel(cell, "--", valFont, b.normalColor,
                                 LV_ALIGN_CENTER, 0, 4);
        b.unitLabel  = makeLabel(cell, b.units.c_str(), &lv_font_montserrat_12,
                                 lv_color_hex(UI_MUTED),
                                 LV_ALIGN_BOTTOM_MID, 0, -2);
        if (count <= 2) {
            b.peakLabel = makeLabel(cell, "", &lv_font_montserrat_12,
                                    lv_color_hex(UI_ACCENT),
                                    LV_ALIGN_BOTTOM_MID, 0, -18);
            lv_obj_add_flag(b.peakLabel, LV_OBJ_FLAG_HIDDEN);
        }
        i++;
    }
}

/* ---- text list: compact rows -------------------------------------------- */

void UIBuilder::buildTextList(ScreenDef &sd, JsonObject cfg) {
    JsonArray rows = cfg["rows"].as<JsonArray>();
    size_t count = min((size_t)rows.size(), (size_t)5);
    sd.bindings.reserve(count);

    const char *title = cfg["label"] | (const char *)nullptr;
    if (title)
        makeLabel(sd.root, title, &lv_font_montserrat_14,
                  lv_color_hex(UI_MUTED), LV_ALIGN_TOP_MID, 0, 22);

    int y = 52;
    size_t i = 0;
    for (JsonObject rowCfg : rows) {
        if (i >= count) break;
        sd.bindings.emplace_back();
        GaugeBinding &b = sd.bindings.back();
        parseCommon(b, rowCfg);
        b.kind        = WidgetKind::TextRow;
        b.normalColor = colorFromHex(rowCfg["color"] | "",
                                     lv_color_hex(UI_TEXT));

        b.nameLabel  = makeLabel(sd.root, b.label.c_str(),
                                 &lv_font_montserrat_14,
                                 lv_color_hex(UI_MUTED), LV_ALIGN_TOP_LEFT,
                                 42, y + 3);
        b.valueLabel = makeLabel(sd.root, "--", &lv_font_montserrat_20,
                                 b.normalColor, LV_ALIGN_TOP_RIGHT, -40, y);
        y += 30;
        i++;
    }
}

/* ---- chart: rolling trend of one metric --------------------------------- */

void UIBuilder::buildChart(ScreenDef &sd, JsonObject cfg) {
    sd.bindings.reserve(1);
    sd.bindings.emplace_back();
    GaugeBinding &b = sd.bindings.back();
    parseCommon(b, cfg);
    b.kind        = WidgetKind::Chart;
    b.chartPeriod = cfg["sample_ms"] | 1000;
    b.unit        = intUnitFor(b.minV, b.maxV, 30000.0f);   // a point is 16-bit
    b.normalColor = colorFromHex(cfg["color"] | "", lv_color_hex(UI_ACCENT));

    const uint16_t points = constrain((int)(cfg["points"] | 60), 10, 120);

    lv_obj_t *chart = lv_chart_create(sd.root);
    lv_obj_set_size(chart, 172, 96);
    lv_obj_align(chart, LV_ALIGN_CENTER, 0, 4);
    lv_chart_set_type(chart, LV_CHART_TYPE_LINE);
    lv_chart_set_point_count(chart, points);
    lv_chart_set_range(chart, LV_CHART_AXIS_PRIMARY_Y,
                       chartPoint(b.minV, b.unit), chartPoint(b.maxV, b.unit));
    // SHIFT scrolls old samples left as new ones arrive — a strip chart.
    lv_chart_set_update_mode(chart, LV_CHART_UPDATE_MODE_SHIFT);
    lv_chart_set_div_line_count(chart, 4, 0);
    lv_obj_set_style_bg_color(chart, lv_color_hex(UI_PANEL), 0);
    lv_obj_set_style_bg_opa(chart, LV_OPA_40, 0);
    lv_obj_set_style_border_width(chart, 0, 0);
    lv_obj_set_style_radius(chart, 6, 0);
    lv_obj_set_style_line_color(chart, lv_color_hex(UI_LINE), LV_PART_MAIN);
    lv_obj_set_style_line_width(chart, 1, LV_PART_MAIN);
    lv_obj_set_style_pad_all(chart, 3, 0);
    lv_obj_set_style_size(chart, 0, LV_PART_INDICATOR);  // no per-point dots
    lv_obj_clear_flag(chart, LV_OBJ_FLAG_SCROLLABLE | LV_OBJ_FLAG_CLICKABLE);

    b.chart  = chart;
    b.series = lv_chart_add_series(chart, b.normalColor, LV_CHART_AXIS_PRIMARY_Y);
    // Start blank rather than at zero, so the trace only shows real samples.
    lv_chart_set_all_value(chart, b.series, LV_CHART_POINT_NONE);

    b.nameLabel  = makeLabel(sd.root, b.label.c_str(), &lv_font_montserrat_14,
                             lv_color_hex(UI_MUTED), LV_ALIGN_TOP_MID, 0, 32);
    b.valueLabel = makeLabel(sd.root, "--", &lv_font_montserrat_24,
                             lv_color_white(), LV_ALIGN_BOTTOM_MID, 0, -32);
    b.unitLabel  = makeLabel(sd.root, b.units.c_str(), &lv_font_montserrat_12,
                             lv_color_hex(UI_MUTED), LV_ALIGN_TOP_MID, 0, 50);
}

/* ---- dash: the mini instrument cluster ----------------------------------- */

void UIBuilder::dashPart(GaugeBinding &b, JsonVariant v, uint16_t id,
                         const char *label, const char *units, float minV,
                         float maxV, uint8_t dec) {
    JsonObject o = v.as<JsonObject>();         // null when absent or `true`
    b.metricId = o["metric_id"].isNull() ? id : parseMetricId(o["metric_id"]);
    b.label    = String(o["label"] | label);
    b.units    = String(o["units"] | units);
    b.decimals = (uint8_t)constrain((int)(o["decimals"] | dec), 0, 6);
    b.minV     = o["min"] | minV;
    b.maxV     = o["max"] | maxV;
    if (b.maxV <= b.minV) b.maxV = b.minV + 1;
    b.unit     = intUnitFor(b.minV, b.maxV, 1e8f);
    JsonObject th = o["thresholds"];
    if (!th.isNull()) {
        parseThreshold(b.warn, th["warning"], false);
        parseThreshold(b.crit, th["critical"], true);
    }
}

void UIBuilder::buildDash(ScreenDef &sd, JsonObject cfg) {
    /*
     * The car's cluster, on a 240 px circle:
     *
     *   rim     — tachometer arc, redline band just inside it
     *   top     — shift light, gear, indicators either side of it
     *   centre  — speed
     *   below   — fuel and coolant, each with its symbol
     *   gap     — the lit warning lamps, in the opening under the arc
     *
     * Every part can be switched off with `"part": false`, and every metric
     * repointed, from the layout. The landscape board's `info` row has no
     * room here and is ignored.
     */
    _dash.emplace_back();
    DashView &dv     = _dash.back();
    dv.screen        = _screens.size() - 1;
    sd.dash          = (int)_dash.size() - 1;
    sd.showTelltales = false;                 // it has its own lamp row
    // Bindings are rendered through references into this vector: size it
    // before the first one exists.
    sd.bindings.reserve(5);

    JsonVariant sl = cfg["shift_light"];
    const float shiftRpm = sl["rpm"] | 6500.0f;

    /* ---- tachometer around the rim ---- */
    JsonVariant tachCfg = cfg["tach"];
    uint16_t rpmMetric = METRIC_ID_RPM;
    if (!partOff(tachCfg)) {
        sd.bindings.emplace_back();
        GaugeBinding &b = sd.bindings.back();
        dashPart(b, tachCfg, METRIC_ID_RPM, "RPM", "", 0, 8000, 0);
        b.kind        = WidgetKind::Arc;
        b.normalColor = colorFromHex(tachCfg["color"] | "", lv_color_hex(UI_ACCENT));
        rpmMetric     = b.metricId;

        lv_obj_t *arc = lv_arc_create(sd.root);
        lv_obj_set_size(arc, 228, 228);
        lv_obj_center(arc);
        lv_arc_set_rotation(arc, 0);
        lv_arc_set_bg_angles(arc, 135, 45);
        lv_arc_set_range(arc, 0, 1000);
        lv_arc_set_value(arc, 0);
        lv_obj_remove_style(arc, nullptr, LV_PART_KNOB);
        lv_obj_clear_flag(arc, LV_OBJ_FLAG_CLICKABLE);
        lv_obj_set_style_arc_width(arc, 10, LV_PART_MAIN);
        lv_obj_set_style_arc_width(arc, 10, LV_PART_INDICATOR);
        lv_obj_set_style_arc_color(arc, lv_color_hex(UI_LINE_SOFT), LV_PART_MAIN);
        lv_obj_set_style_arc_color(arc, b.normalColor, LV_PART_INDICATOR);
        lv_obj_set_style_arc_rounded(arc, false, LV_PART_MAIN);
        lv_obj_set_style_arc_rounded(arc, false, LV_PART_INDICATOR);
        b.arc = arc;

        const float redline = tachCfg["redline"] | shiftRpm;
        if (redline > b.minV && redline < b.maxV) {
            const int a0 = 135 + (int)lroundf(270.0f * (redline - b.minV) /
                                               (b.maxV - b.minV));
            lv_obj_t *band = lv_arc_create(sd.root);
            lv_obj_set_size(band, 202, 202);
            lv_obj_center(band);
            lv_arc_set_rotation(band, 0);
            lv_arc_set_bg_angles(band, a0 % 360, 45);
            lv_obj_remove_style(band, nullptr, LV_PART_KNOB);
            lv_obj_clear_flag(band, LV_OBJ_FLAG_CLICKABLE);
            lv_obj_set_style_arc_width(band, 3, LV_PART_MAIN);
            lv_obj_set_style_arc_color(band, lv_color_hex(UI_CRIT), LV_PART_MAIN);
            lv_obj_set_style_arc_rounded(band, false, LV_PART_MAIN);
            lv_obj_set_style_arc_opa(band, LV_OPA_TRANSP, LV_PART_INDICATOR);
        }
    }

    /* ---- shift light ---- */
    if (!partOff(sl)) {
        dv.shift      = true;
        dv.rpmMetric  = rpmMetric;
        dv.shiftRpm   = shiftRpm;
        dv.shiftStart = sl["start"] | (shiftRpm - 1500.0f);
        if (dv.shiftStart >= dv.shiftRpm) dv.shiftStart = dv.shiftRpm - 1;
        for (int k = 0; k < 5; k++) {
            lv_obj_t *led = lv_obj_create(sd.root);
            lv_obj_set_size(led, 8, 8);
            lv_obj_set_pos(led, 90 + k * 13, 34);
            lv_obj_set_style_radius(led, LV_RADIUS_CIRCLE, 0);
            lv_obj_set_style_border_width(led, 0, 0);
            lv_obj_set_style_bg_color(led, lv_color_hex(UI_LAMP_OFF), 0);
            lv_obj_clear_flag(led, LV_OBJ_FLAG_SCROLLABLE | LV_OBJ_FLAG_CLICKABLE);
            dv.led[k]    = led;
            dv.ledRgb[k] = UI_LAMP_OFF;
        }
    }

    /* ---- gear, with the indicators either side ---- */
    JsonVariant gCfg = cfg["gear"];
    if (!partOff(gCfg)) {
        sd.bindings.emplace_back();
        GaugeBinding &b = sd.bindings.back();
        dashPart(b, gCfg, METRIC_ID_GEAR, "GEAR", "", -1, 6, 0);
        b.kind        = WidgetKind::Cell;
        b.fmt         = ValueFmt::Gear;
        b.normalColor = colorFromHex(gCfg["color"] | "", lv_color_hex(UI_ACCENT));

        lv_obj_t *box = lv_obj_create(sd.root);
        lv_obj_set_size(box, 44, 36);
        lv_obj_set_pos(box, 98, 46);
        lv_obj_set_style_radius(box, 8, 0);
        lv_obj_set_style_bg_color(box, lv_color_hex(UI_PANEL), 0);
        lv_obj_set_style_border_width(box, 2, 0);
        lv_obj_set_style_border_color(box, lv_color_hex(UI_LINE), 0);
        lv_obj_set_style_pad_all(box, 0, 0);
        lv_obj_clear_flag(box, LV_OBJ_FLAG_SCROLLABLE | LV_OBJ_FLAG_CLICKABLE);
        dv.gearBox = box;
        dv.gearRgb = UI_LINE;
        b.valueLabel = makeLabel(box, "--", &lv_font_montserrat_28, b.normalColor,
                                 LV_ALIGN_CENTER, 0, 1);
    }
    if (!partOff(cfg["lamps"])) {
        dv.ghosts = cfg["ghost_lamps"] | true;
        for (size_t i = 0; i < _lamps.size(); i++) {
            const Lamp &l = _lamps[i];
            if (!l.enabled) continue;
            if (l.icon == ICON_TURN_L && !dv.turn[0])
                dv.turn[0] = makeLamp(sd.root, ICON_TURN_L, 64, 52);
            if (l.icon == ICON_TURN_R && !dv.turn[1])
                dv.turn[1] = makeLamp(sd.root, ICON_TURN_R, 152, 52);
        }
        // The row under the arc shows only lit lamps, so its slots are filled
        // at run time; they start hidden.
        dv.slots = DASH_LAMP_SLOTS;
        for (size_t k = 0; k < dv.slots; k++) {
            dv.slot[k]     = makeLamp(sd.root, ICON_WARN, 0, 190);
            dv.slotIcon[k] = ICON_WARN;
            dv.slotRgb[k]  = LAMP_HIDDEN;
            lv_obj_add_flag(dv.slot[k], LV_OBJ_FLAG_HIDDEN);
        }
    }

    /* ---- speed ---- */
    JsonVariant spCfg = cfg["speed"];
    if (!partOff(spCfg)) {
        sd.bindings.emplace_back();
        GaugeBinding &b = sd.bindings.back();
        dashPart(b, spCfg, METRIC_ID_SPEED, "", "km/h", 0, 260, 0);
        b.kind        = WidgetKind::Cell;
        b.normalColor = colorFromHex(spCfg["color"] | "", lv_color_hex(UI_TEXT));
        b.valueLabel  = makeLabel(sd.root, "--", &lv_font_montserrat_48,
                                  b.normalColor, LV_ALIGN_TOP_MID, 0, 88);
        b.unitLabel   = makeLabel(sd.root, b.units.c_str(), &lv_font_montserrat_12,
                                  lv_color_hex(UI_MUTED), LV_ALIGN_TOP_MID, 0, 138);
        lv_obj_set_width(b.valueLabel, 150);
        lv_label_set_long_mode(b.valueLabel, LV_LABEL_LONG_CLIP);
        lv_obj_set_style_text_align(b.valueLabel, LV_TEXT_ALIGN_CENTER, 0);
    }

    /* ---- fuel and coolant: symbol + value ---- */
    struct Spec {
        const char *key; uint16_t id; const char *units;
        float mn, mx; int x; uint8_t icon;
    };
    static const Spec kParts[2] = {
        {"fuel", METRIC_ID_FUEL_LEVEL,   "%",             0, 100,  56, ICON_FUEL},
        {"temp", METRIC_ID_COOLANT_TEMP, "\xC2\xB0" "C", 40, 130, 128, ICON_COOLANT},
    };
    for (const Spec &p : kParts) {
        JsonVariant v = cfg[p.key];
        if (partOff(v)) continue;
        sd.bindings.emplace_back();
        GaugeBinding &b = sd.bindings.back();
        dashPart(b, v, p.id, "", p.units, p.mn, p.mx, 0);
        b.kind        = WidgetKind::TextRow;          // value with its units
        b.normalColor = colorFromHex(v["color"] | "", lv_color_hex(UI_TEXT));
        b.valueLabel  = makeLabel(sd.root, "--", &lv_font_montserrat_14,
                                  b.normalColor, LV_ALIGN_TOP_LEFT, p.x + 27, 162);
        lv_obj_set_width(b.valueLabel, 50);
        lv_label_set_long_mode(b.valueLabel, LV_LABEL_LONG_CLIP);

        lv_obj_t *ic = makeLamp(sd.root, p.icon, p.x, 158);
        lv_obj_set_style_img_recolor(ic, lv_color_hex(UI_MUTED), 0);
        (p.icon == ICON_FUEL ? dv.fuelIcon : dv.tempIcon) = ic;
        (p.icon == ICON_FUEL ? dv.fuelRgb  : dv.tempRgb)  = UI_MUTED;
    }
}

/* ---- watchdog list ------------------------------------------------------- */

/**
 * @brief Parse "watchdog" from layout.json into the guard list.
 *
 * Deliberately independent of the screens: a metric can be policed without
 * being displayed anywhere, which is the whole point of a guard. Items with
 * no usable threshold are dropped rather than silently never firing.
 */
void UIBuilder::parseWatchdog() {
    JsonObject wd = Config.layout()["watchdog"];
    _watchEnabled = wd.isNull() ? true : (wd["enabled"] | true);
    _watchPopups  = wd.isNull() ? true : (wd["show_popup"] | true);

    JsonArray items = wd["items"].as<JsonArray>();
    if (items.isNull()) return;

    for (JsonObject it : items) {
        WatchItem w;
        w.metricId = parseMetricId(it["metric_id"]);
        w.label    = String(it["label"] | "");
        w.units    = String(it["units"] | "");
        w.decimals = (uint8_t)constrain((int)(it["decimals"] | 0), 0, 6);
        w.popup    = it["popup"] | true;   // false = police it silently
        parseThreshold(w.warn, it["warning"],  false);
        parseThreshold(w.crit, it["critical"], true);

        if (!w.metricId) continue;
        if (!w.warn.enabled && !w.crit.enabled) {
            log_w("watchdog item 0x%04X has no thresholds — ignored", w.metricId);
            continue;
        }
        if (!w.label.length()) w.label = String("0x") + String(w.metricId, HEX);
        _watch.push_back(w);
    }
    log_i("Watchdog: %u item(s), %s", (unsigned)_watch.size(),
          _watchEnabled ? "armed" : "disabled");
}

/* ---- diagnostics screen -------------------------------------------------- */

void UIBuilder::buildDiag(ScreenDef &sd) {
    sd.isDiag = true;
    makeLabel(sd.root, "DIAGNOSTICS", &lv_font_montserrat_14,
              lv_color_hex(UI_ACCENT), LV_ALIGN_TOP_MID, 0, 24);

    static const char *names[DIAG_ROWS] = {"Link", "Rate", "Drops",
                                           "Heap", "Uptime", "GPIO"};
    // 24 px pitch keeps the last row clear of the page dots at the rim.
    int y = 50;
    for (int i = 0; i < DIAG_ROWS; i++) {
        const bool wide = (i == DIAG_ROWS - 1);   // GPIO scan needs the width
        makeLabel(sd.root, names[i], &lv_font_montserrat_12,
                  lv_color_hex(UI_MUTED), LV_ALIGN_TOP_LEFT, wide ? 40 : 48, y);
        _diagVals[i] = makeLabel(sd.root, "--",
                                 wide ? &lv_font_montserrat_12
                                      : &lv_font_montserrat_14,
                                 lv_color_white(), LV_ALIGN_TOP_RIGHT,
                                 wide ? -36 : -44, y);
        y += 24;
    }
}

/* ═══════════════════════════════ runtime ═════════════════════════════════ */

void UIBuilder::uiTimerCb(lv_timer_t *t) {
    static_cast<UIBuilder *>(t->user_data)->tick();
}

void UIBuilder::tick() {
    if (_configActive) return;

    // Day/night follows the Master's flag unless the user forced a mode.
    const bool night = (_nightOverride == NightOverride::ForceDay)   ? false
                     : (_nightOverride == NightOverride::ForceNight) ? true
                     : Telemetry.nightMode();
    if (night != _night) { _night = night; applyNight(night); }

    // Give a running screen transition the whole frame budget: gauge writes
    // invalidate areas of both screens mid-slide, which is what turns a
    // smooth animation into a stutter.
    if (_sweepActive) return;
    if (_busyMs) {
        // Elapsed time, unsigned: right across the millis() wrap. An end
        // time compared with `<` froze the gauges for 49 days when a slide
        // straddled the wrap.
        if (millis() - _busySinceMs < _busyMs) return;
        _busyMs = 0;
    }

    const float lerp = Config.lerpSpeed();
    const uint32_t now = millis();
    _tickCache.clear();
    const bool reverse = reverseEngaged();
    for (size_t si = 0; si < _screens.size(); si++) {
        const bool visible = (si == _active);
        for (auto &b : _screens[si].bindings) {
            MetricSample s{};
            const bool ok = sampleOnce(b.metricId, lerp, s);
            bool usable = ok && (s.flags & METRIC_FLAG_VALID) && !s.stale;
            float shown = s.value;
            if (b.fmt == ValueFmt::Gear) {
                // Gears are whole: a glide from 2 to 4 would show 3 on the
                // way. And the reverse switch, where the bus has one, wins.
                shown = s.raw;
                if (reverse) { shown = -1; usable = true; }
            }
            evalAlarm(b, ok ? s.raw : 0, ok ? s.flags : 0, usable);
            if (usable) b.lastValue = shown;

            // Chart history advances even while its screen is off-view, so
            // swiping to a trend shows real history instead of a blank strip.
            if (b.chart && b.series && usable &&
                now - b.lastChartMs >= b.chartPeriod) {
                b.lastChartMs = now;
                lv_chart_set_next_value(b.chart, b.series, chartPoint(s.raw, b.unit));
            }

            if (visible) renderBinding(b, shown, usable, ok ? s.peak : 0);
        }
    }

    _lamps.update(Telemetry, now);
    const int dash = _screens[_active].dash;
    if (dash >= 0) updateDash(_dash[dash], lerp, now);

    if (_diagIndex >= 0 && (size_t)_diagIndex == _active) updateDiag();
    updateTelltaleStrip();
    manageAlert();

    // link badge on the visible screen
    lv_obj_t *icon = _screens[_active].linkIcon;
    if (icon) {
        if (Telemetry.linkUp()) lv_obj_add_flag(icon, LV_OBJ_FLAG_HIDDEN);
        else                    lv_obj_clear_flag(icon, LV_OBJ_FLAG_HIDDEN);
    }
}

bool UIBuilder::sampleOnce(uint16_t id, float lerp, MetricSample &s) {
    for (const TickSample &c : _tickCache)
        if (c.id == id) { s = c.s; return c.ok; }
    TickSample c{id, false, {}};
    c.ok = Telemetry.sample(id, lerp, c.s);
    _tickCache.push_back(c);          // reserved in begin(): no churn per tick
    s = c.s;
    return c.ok;
}

bool UIBuilder::reverseEngaged() {
    MetricSample r;
    return Telemetry.peek(METRIC_ID_REVERSE, r) &&
           (r.flags & METRIC_FLAG_VALID) && !r.stale && r.raw >= 0.5f;
}

void UIBuilder::formatBinding(const GaugeBinding &b, float v, char *out,
                              size_t n) {
    if (b.fmt == ValueFmt::Gear && !isnan(v)) {
        const long g = lroundf(v);
        if (g < 0)       strlcpy(out, "R", n);
        else if (g == 0) strlcpy(out, "N", n);
        else if (g <= 9) snprintf(out, n, "%ld", g);
        else             strlcpy(out, "--", n);
        return;
    }
    formatValue(out, n, v, b.decimals);
}

/**
 * @brief Write a label only when its text actually changed.
 *
 * lv_label_set_text reallocates and invalidates unconditionally. At 50 fps
 * with a 48 px font that is the single most expensive thing the UI does, and
 * most of the time the displayed digits are identical to the previous frame.
 *
 * @param label    Target label; nullptr is ignored.
 * @param cache    Buffer holding the last text written to @p label.
 * @param cacheLen Size of @p cache.
 * @param txt      New text.
 */
static void setLabelText(lv_obj_t *label, char *cache, size_t cacheLen,
                         const char *txt) {
    if (!label || strncmp(cache, txt, cacheLen) == 0) return;
    strlcpy(cache, txt, cacheLen);
    lv_label_set_text(label, txt);
}

void UIBuilder::renderBinding(GaugeBinding &b, float value, bool usable,
                              float peak) {
    char buf[24];
    if (!usable) {
        setLabelText(b.valueLabel, b.lastText, sizeof(b.lastText), "--");
        setGaugeValue(b, b.minV);
        return;
    }

    setGaugeValue(b, value);
    if (b.valueLabel) {
        formatBinding(b, value, buf, sizeof(buf));
        if ((b.kind == WidgetKind::TextRow || b.inlineUnits) && b.units.length()) {
            char withUnits[32];
            snprintf(withUnits, sizeof(withUnits), "%s %s", buf, b.units.c_str());
            setLabelText(b.valueLabel, b.lastText, sizeof(b.lastText), withUnits);
        } else {
            setLabelText(b.valueLabel, b.lastText, sizeof(b.lastText), buf);
        }
    }
    if (b.peakLabel && _peaksShown && peak > -INFINITY) {
        char peakTxt[24];
        formatValue(buf, sizeof(buf), peak, b.decimals);
        snprintf(peakTxt, sizeof(peakTxt), LV_SYMBOL_UP " %s", buf);
        setLabelText(b.peakLabel, b.lastPeakText, sizeof(b.lastPeakText), peakTxt);
    }
}

void UIBuilder::setGaugeValue(GaugeBinding &b, float v) {
    v = constrain(v, b.minV, b.maxV);
    if (b.arc) {
        const int32_t pos =
            (int32_t)((v - b.minV) / (b.maxV - b.minV) * 1000.0f);
        if (pos != b.lastArcVal) { b.lastArcVal = pos; lv_arc_set_value(b.arc, pos); }
    }
    if (b.meter && b.needle) {
        // lv_meter_set_indicator_value invalidates unconditionally, so this
        // guard is what keeps a parked needle from redrawing 50×/second.
        const int32_t nv = inUnits(v, b.unit);
        if (nv != b.lastNeedleVal) {
            b.lastNeedleVal = nv;
            lv_meter_set_indicator_value(b.meter, b.needle, nv);
        }
    }
}

/* ---- alarms -------------------------------------------------------------- */

/**
 * @brief Has a value crossed into alarm for this tier?
 * @param t Threshold; a disabled tier never trips.
 * @param v Raw value.
 * @return true when the alarm should engage.
 */
static bool thresholdCrossed(const ThresholdCfg &t, float v) {
    if (!t.enabled) return false;
    return t.above ? v >= t.value : v <= t.value;
}

/**
 * @brief Has a value travelled back past the hysteresis band?
 * @param t Threshold; a disabled tier counts as always clear.
 * @param v Raw value.
 * @return true when the alarm may disengage.
 */
static bool thresholdCleared(const ThresholdCfg &t, float v) {
    if (!t.enabled) return true;
    return t.above ? v < t.value - t.hyst : v > t.value + t.hyst;
}

void UIBuilder::evalAlarm(GaugeBinding &b, float raw, uint8_t flags,
                          bool usable) {
    // Master switch: with gauge alarm colors off, every gauge stays in its
    // configured color. Clear any tier still latched from before the switch
    // so the gauge is not left stranded yellow or red.
    if (!_gaugeAlarms) {
        if (b.state != AlarmState::Normal) {
            b.state = AlarmState::Normal;
            onAlarmChanged(b);
        }
        return;
    }

    AlarmState desired = b.state;

    if (!usable) {
        desired = AlarmState::Normal;
    } else {
        // Local thresholds with hysteresis
        switch (b.state) {
            case AlarmState::Normal:
                if      (thresholdCrossed(b.crit, raw)) desired = AlarmState::Critical;
                else if (thresholdCrossed(b.warn, raw)) desired = AlarmState::Warning;
                break;
            case AlarmState::Warning:
                if      (thresholdCrossed(b.crit, raw)) desired = AlarmState::Critical;
                else if (thresholdCleared(b.warn, raw)) desired = AlarmState::Normal;
                break;
            case AlarmState::Critical:
                if (thresholdCleared(b.crit, raw))
                    desired = thresholdCrossed(b.warn, raw) ? AlarmState::Warning
                                                            : AlarmState::Normal;
                break;
        }
        // Master-side flags can only escalate, never suppress local alarms.
        if      (flags & METRIC_FLAG_CRITICAL) desired = AlarmState::Critical;
        else if ((flags & METRIC_FLAG_WARNING) && desired == AlarmState::Normal)
            desired = AlarmState::Warning;
    }

    if (desired != b.state) {
        b.state = desired;
        onAlarmChanged(b);
    }
}

void UIBuilder::onAlarmChanged(GaugeBinding &b) {
    stopPulse(b);
    switch (b.state) {
        case AlarmState::Normal:
            setBindingColor(b, b.normalColor);
            break;
        case AlarmState::Warning:
            setBindingColor(b, b.warn.enabled ? b.warn.color
                                              : lv_color_hex(UI_WARN));
            startPulse(b);            // yellow pulse
            break;
        case AlarmState::Critical:
            setBindingColor(b, b.crit.enabled ? b.crit.color
                                              : lv_color_hex(UI_CRIT));
            break;                    // alert card handled in manageAlert
    }
}

void UIBuilder::setBindingColor(GaugeBinding &b, lv_color_t c) {
    if (b.arc)
        lv_obj_set_style_arc_color(b.arc, c, LV_PART_INDICATOR);
    if (b.needle) {                   // lv_meter exposes the indicator struct
        b.needle->type_data.needle_line.color = c;
        lv_obj_invalidate(b.meter);
    }
    if (b.valueLabel &&
        (b.kind == WidgetKind::Cell || b.kind == WidgetKind::TextRow))
        lv_obj_set_style_text_color(b.valueLabel, c, 0);
}

void UIBuilder::startPulse(GaugeBinding &b) {
    lv_obj_t *target = b.arc ? b.arc : b.valueLabel;
    if (!target) return;
    lv_anim_t a;
    lv_anim_init(&a);
    lv_anim_set_var(&a, target);
    lv_anim_set_exec_cb(&a, b.arc ? animArcOpa : animTextOpa);
    lv_anim_set_values(&a, 255, 90);
    lv_anim_set_time(&a, 350);
    lv_anim_set_playback_time(&a, 350);
    lv_anim_set_repeat_count(&a, LV_ANIM_REPEAT_INFINITE);
    lv_anim_start(&a);
    b.pulsing = true;
}

void UIBuilder::stopPulse(GaugeBinding &b) {
    if (!b.pulsing) return;
    if (b.arc) {
        lv_anim_del(b.arc, animArcOpa);
        lv_obj_set_style_arc_opa(b.arc, LV_OPA_COVER, LV_PART_INDICATOR);
    }
    if (b.valueLabel) {
        lv_anim_del(b.valueLabel, animTextOpa);
        lv_obj_set_style_text_opa(b.valueLabel, LV_OPA_COVER, 0);
    }
    b.pulsing = false;
}

/* ═════════════════════ alert card (warning triangle) ═════════════════════
 *
 * Replaces the old full-screen red strobe. A strobe that fills a 240 px round
 * screen tells the driver *that* something is wrong while hiding *what* — and
 * at night it wrecks night vision. This card names the metric, shows its
 * value and the limit it crossed, and leaves the gauges readable underneath.
 * It lives on lv_layer_top, so it is visible from whichever screen is up.
 */

/**
 * @brief Describe why an item is in alarm: "HIGH"/"LOW" plus the limit.
 * @param w        Item in alarm.
 * @param[out] out Destination buffer.
 * @param n        Buffer size.
 */
static void alarmDetail(const WatchItem &w, char *out, size_t n) {
    const ThresholdCfg &t = (w.state == AlarmState::Critical && w.crit.enabled)
                                ? w.crit
                                : w.warn;
    if (!t.enabled) {                      // master-flagged, no local threshold
        strlcpy(out, "REPORTED BY MASTER", n);
        return;
    }
    char lim[16];
    formatValue(lim, sizeof(lim), t.value, w.decimals);
    // U+2022 is in LVGL's built-in fonts; the middle dot U+00B7 is not, and
    // silently rendered as nothing.
    snprintf(out, n, "%s  \xE2\x80\xA2  LIMIT %s %s", t.above ? "HIGH" : "LOW",
             lim, w.units.c_str());
}

void UIBuilder::buildAlertCard() {
    _alertCard = lv_obj_create(lv_layer_top());
    lv_obj_set_size(_alertCard, 200, 104);
    lv_obj_center(_alertCard);
    lv_obj_set_style_radius(_alertCard, 14, 0);
    lv_obj_set_style_bg_color(_alertCard, lv_color_hex(UI_ALERT_BG), 0);
    lv_obj_set_style_bg_opa(_alertCard, LV_OPA_COVER, 0);
    lv_obj_set_style_border_width(_alertCard, 2, 0);
    lv_obj_set_style_pad_all(_alertCard, 0, 0);
    lv_obj_clear_flag(_alertCard, LV_OBJ_FLAG_SCROLLABLE | LV_OBJ_FLAG_CLICKABLE);

    _alertIcon   = makeLabel(_alertCard, LV_SYMBOL_WARNING,
                             &lv_font_montserrat_32, lv_color_white(),
                             LV_ALIGN_LEFT_MID, 14, 0);
    _alertName   = makeLabel(_alertCard, "", &lv_font_montserrat_14,
                             lv_color_hex(UI_TEXT_DIM), LV_ALIGN_LEFT_MID, 0, 0);
    _alertValue  = makeLabel(_alertCard, "", &lv_font_montserrat_28,
                             lv_color_white(), LV_ALIGN_LEFT_MID, 0, 0);
    _alertDetail = makeLabel(_alertCard, "", &lv_font_montserrat_12,
                             lv_color_hex(UI_MUTED), LV_ALIGN_LEFT_MID, 0, 0);
    _alertMore   = makeLabel(_alertCard, "", &lv_font_montserrat_12,
                             lv_color_hex(UI_MUTED), LV_ALIGN_BOTTOM_RIGHT, -8, -4);

    // Its own 36 px bitmaps rather than a zoom: LVGL 8.3 cannot scale an
    // alpha-only image, and silently draws nothing.
    _alertImg = lv_img_create(_alertCard);
    lv_img_set_src(_alertImg, Telltales::iconImage(ICON_WARN, true));
    lv_obj_set_style_img_recolor_opa(_alertImg, LV_OPA_COVER, 0);
    lv_obj_clear_flag(_alertImg, LV_OBJ_FLAG_CLICKABLE);

    // Bound the text column and truncate with an ellipsis. Without this a long
    // headline runs off the card and is simply invisible past the edge, which
    // looks exactly like the text never being set.
    for (lv_obj_t *l : {_alertName, _alertValue, _alertDetail})
        lv_label_set_long_mode(l, LV_LABEL_LONG_DOT);

    _alertLampLayout = true;           // force the first arrangement through
    applyAlertLayout(false);
    lv_obj_add_flag(_alertCard, LV_OBJ_FLAG_HIDDEN);
}

void UIBuilder::applyAlertLayout(bool lamp) {
    if (lamp == _alertLampLayout) return;
    _alertLampLayout = lamp;

    if (lamp) {
        // Symbol on top, the lamp's name under it, then its value or advice:
        // centred, the way the circle reads best.
        lv_obj_add_flag(_alertIcon, LV_OBJ_FLAG_HIDDEN);
        lv_obj_add_flag(_alertValue, LV_OBJ_FLAG_HIDDEN);
        lv_obj_clear_flag(_alertImg, LV_OBJ_FLAG_HIDDEN);
        lv_obj_align(_alertImg, LV_ALIGN_TOP_MID, 0, 8);
        lv_obj_set_style_text_font(_alertName, &lv_font_montserrat_16, 0);
        lv_obj_set_style_text_color(_alertName, lv_color_white(), 0);
        lv_obj_align(_alertName, LV_ALIGN_TOP_MID, 0, 48);
        lv_obj_align(_alertDetail, LV_ALIGN_TOP_MID, 0, 72);
        for (lv_obj_t *l : {_alertName, _alertDetail}) {
            lv_obj_set_width(l, 184);
            lv_obj_set_style_text_align(l, LV_TEXT_ALIGN_CENTER, 0);
        }
    } else {
        lv_obj_clear_flag(_alertIcon, LV_OBJ_FLAG_HIDDEN);
        lv_obj_clear_flag(_alertValue, LV_OBJ_FLAG_HIDDEN);
        lv_obj_add_flag(_alertImg, LV_OBJ_FLAG_HIDDEN);
        lv_obj_set_style_text_font(_alertName, &lv_font_montserrat_14, 0);
        lv_obj_set_style_text_color(_alertName, lv_color_hex(UI_TEXT_DIM), 0);
        lv_obj_align(_alertName,   LV_ALIGN_LEFT_MID, 62, -30);
        lv_obj_align(_alertValue,  LV_ALIGN_LEFT_MID, 62, -2);
        lv_obj_align(_alertDetail, LV_ALIGN_LEFT_MID, 62, 26);
        for (lv_obj_t *l : {_alertName, _alertValue, _alertDetail}) {
            lv_obj_set_width(l, 126);
            lv_obj_set_style_text_align(l, LV_TEXT_ALIGN_LEFT, 0);
        }
    }
    // Everything moved: make the next show rewrite every line.
    _alertLastName[0] = _alertLastValue[0] = _alertLastDetail[0] = '\0';
    _alertKey = 0;
}

void UIBuilder::hideAlert() {
    if (!_alertShown) return;
    if (_alertPulsing) {
        lv_anim_del(_alertCard, animBorderOpa);
        lv_obj_set_style_border_opa(_alertCard, LV_OPA_COVER, 0);
        _alertPulsing = false;
    }
    lv_obj_add_flag(_alertCard, LV_OBJ_FLAG_HIDDEN);
    _alertShown = false;
    _alertLevel = AlarmState::Normal;
    _alertKey   = 0;
}

void UIBuilder::hideOverlays() {
    hideAlert();
    if (_strip && _stripShown) {
        lv_obj_add_flag(_strip, LV_OBJ_FLAG_HIDDEN);
        _stripShown = false;
    }
}

void UIBuilder::showAlert(const AlertView &v, uint8_t othersActive) {
    const bool critical = (v.level == AlarmState::Critical);
    const bool lamp     = (v.img != nullptr);

    if (!_alertShown) {
        lv_obj_clear_flag(_alertCard, LV_OBJ_FLAG_HIDDEN);
        _alertShown = true;
    }
    applyAlertLayout(lamp);

    // Re-style only when the severity or the subject changes.
    if (v.level != _alertLevel || v.key != _alertKey) {
        _alertLevel = v.level;
        _alertKey   = v.key;
        lv_obj_set_style_border_color(_alertCard, v.accent, 0);
        lv_obj_set_style_bg_color(_alertCard,
            critical ? lv_color_hex(UI_ALERT_BG_CRIT) : lv_color_hex(UI_ALERT_BG), 0);
        lv_obj_set_style_text_color(_alertIcon, v.accent, 0);
        if (lamp) {
            lv_img_set_src(_alertImg, v.img);
            lv_obj_set_style_img_recolor(_alertImg, v.accent, 0);
        }

        // Critical pulses its border; warning stays steady so the two tiers
        // are distinguishable at a glance without reading the text.
        if (_alertPulsing) {
            lv_anim_del(_alertCard, animBorderOpa);
            _alertPulsing = false;
        }
        if (critical) {
            lv_anim_t a;
            lv_anim_init(&a);
            lv_anim_set_var(&a, _alertCard);
            lv_anim_set_exec_cb(&a, animBorderOpa);
            lv_anim_set_values(&a, 255, 60);
            lv_anim_set_time(&a, 320);
            lv_anim_set_playback_time(&a, 320);
            lv_anim_set_repeat_count(&a, LV_ANIM_REPEAT_INFINITE);
            lv_anim_start(&a);
            _alertPulsing = true;
        }
        lv_obj_set_style_border_opa(_alertCard, LV_OPA_COVER, 0);
    }

    setLabelText(_alertName, _alertLastName, sizeof(_alertLastName), v.name);
    if (lamp) {
        // Three lines is all the card holds: the value when the lamp has one
        // ("9 %", "11.6 V"), otherwise what to do about it.
        setLabelText(_alertDetail, _alertLastDetail, sizeof(_alertLastDetail),
                     v.value[0] ? v.value : v.detail);
    } else {
        setLabelText(_alertValue,  _alertLastValue,  sizeof(_alertLastValue),  v.value);
        setLabelText(_alertDetail, _alertLastDetail, sizeof(_alertLastDetail), v.detail);
    }

    if (othersActive) lv_label_set_text_fmt(_alertMore, "+%u more", othersActive);
    else              lv_label_set_text(_alertMore, "");
}

/**
 * @brief Evaluate every watched metric against its own thresholds.
 *
 * Uses the RAW value, not the smoothed one: a guard must react to what the
 * sensor actually reported, not to a display filter that lags it. Hysteresis
 * stops a value hovering on a limit from flickering the alert on and off.
 */
void UIBuilder::evalWatchdog() {
    for (auto &w : _watch) {
        MetricSample s;
        const bool ok = Telemetry.peek(w.metricId, s);
        w.usable = ok && (s.flags & METRIC_FLAG_VALID) && !s.stale;

        if (!w.usable) {          // no data is not the same as no fault, but
            w.state = AlarmState::Normal;   // we cannot judge it either
            continue;
        }
        w.lastValue = s.raw;

        AlarmState desired = w.state;
        switch (w.state) {
            case AlarmState::Normal:
                if      (thresholdCrossed(w.crit, s.raw)) desired = AlarmState::Critical;
                else if (thresholdCrossed(w.warn, s.raw)) desired = AlarmState::Warning;
                break;
            case AlarmState::Warning:
                if      (thresholdCrossed(w.crit, s.raw)) desired = AlarmState::Critical;
                else if (thresholdCleared(w.warn, s.raw)) desired = AlarmState::Normal;
                break;
            case AlarmState::Critical:
                if (thresholdCleared(w.crit, s.raw))
                    desired = thresholdCrossed(w.warn, s.raw) ? AlarmState::Warning
                                                              : AlarmState::Normal;
                break;
        }
        // Master-side flags escalate but never suppress.
        if      (s.flags & METRIC_FLAG_CRITICAL) desired = AlarmState::Critical;
        else if ((s.flags & METRIC_FLAG_WARNING) && desired == AlarmState::Normal)
            desired = AlarmState::Warning;

        w.state = desired;
    }
}

void UIBuilder::manageAlert() {
    const uint32_t now = millis();

    if (_watchEnabled) evalWatchdog();

    // A mute lasts until it expires or its item recovers, whichever is first:
    // a fault that clears and comes back is a new fault.
    if (_ackActive) {
        bool still = false;
        if (_watchEnabled)
            for (const auto &w : _watch)
                still |= (w.metricId == _ackMetric && w.state != AlarmState::Normal);
        if (!still || (int32_t)(now - _ackUntilMs) >= 0) _ackActive = false;
    }

    // Candidates from both paths. Everything alarming counts toward "+N more";
    // only what may pop up can become the card's subject.
    const WatchItem *bw = nullptr;
    int bl = -1;
    uint8_t active = 0;

    if (_watchEnabled) {
        for (const auto &w : _watch) {
            if (w.state == AlarmState::Normal) continue;
            active++;
            // Silent items never take the card: the gauge already shows it.
            if (!_watchPopups || !w.popup) continue;
            // A muted item steps aside, so a second fault still gets through.
            if (_ackActive && w.metricId == _ackMetric && w.state == _ackLevel) continue;
            const bool better = !bw ||
                (w.state == AlarmState::Critical && bw->state != AlarmState::Critical);
            if (better) bw = &w;
        }
    }
    for (size_t i = 0; i < _lamps.size(); i++) {
        if (!_lamps.wantsPopup(i, now)) continue;
        // One card per fault: a watchdog item already alarming on the same
        // metric says it better, with the number and the limit - provided it
        // is at least as urgent. A critical lamp is never hidden behind a
        // watchdog item that is only at warning.
        bool covered = false;
        if (_watchEnabled && _watchPopups)
            for (const auto &w : _watch)
                covered |= (w.popup && w.metricId == _lamps[i].metric &&
                            (w.state == AlarmState::Critical ||
                             (w.state == AlarmState::Warning && !_lamps[i].critical)));
        if (covered) continue;
        active++;
        if (bl < 0 || _lamps.rank(i) < _lamps.rank((size_t)bl)) bl = (int)i;
    }

    // Popups can be suppressed by the screen currently showing. Everything is
    // still evaluated — lamps light, gauges colour — but nothing is drawn on
    // top of this screen.
    if ((!bw && bl < 0) || !_screens[_active].allowPopup) { hideAlert(); return; }

    // Critical beats warning; at equal severity the watchdog's number wins.
    const bool watchCrit = bw && bw->state == AlarmState::Critical;
    const bool lampCrit  = bl >= 0 && _lamps[bl].critical;
    const bool useLamp   = bl >= 0 && (!bw || (lampCrit && !watchCrit));

    AlertView v;
    char value[28], detail[48];
    if (useLamp) {
        const Lamp &l = _lamps[bl];
        v.key    = ALERT_LAMP_KEY | (uint32_t)bl;
        v.level  = l.critical ? AlarmState::Critical : AlarmState::Warning;
        v.accent = lv_color_hex(Telltales::toneRgb(l.tone));
        v.img    = Telltales::iconImage(l.icon, true);        // 36 px card
        v.name   = l.title;
        _lamps.valueText((size_t)bl, value, sizeof(value));
        v.value  = value;
        v.detail = l.detail;
        _lamps.shown((size_t)bl, now);
    } else {
        const WatchItem &w = *bw;
        const bool critical = (w.state == AlarmState::Critical);
        v.key    = w.metricId;
        v.level  = w.state;
        v.accent = critical ? (w.crit.enabled ? w.crit.color : lv_color_hex(UI_CRIT))
                            : (w.warn.enabled ? w.warn.color : lv_color_hex(UI_WARN));
        v.name   = w.label.c_str();
        char num[16];
        formatValue(num, sizeof(num), w.lastValue, w.decimals);
        snprintf(value, sizeof(value), "%s %s", num, w.units.c_str());
        v.value  = value;
        // A critical tier may carry a custom headline from layout.json.
        if (critical && w.crit.enabled && w.crit.overlayText.length())
            strlcpy(detail, w.crit.overlayText.c_str(), sizeof(detail));
        else
            alarmDetail(w, detail, sizeof(detail));
        v.detail = detail;
    }
    showAlert(v, active > 1 ? (uint8_t)(active - 1) : 0);
}

bool UIBuilder::acknowledgeAlert() {
    if (!_alertShown) return false;
    const uint32_t now = millis();
    if (_alertKey >= ALERT_LAMP_KEY) {
        // Lamps keep their own mute: a Once lamp stays quiet until it goes
        // out, a Repeat lamp for alert_ack_ms.
        _lamps.acknowledge(_alertKey - ALERT_LAMP_KEY, now);
    } else {
        _ackActive  = true;
        _ackMetric  = (uint16_t)_alertKey;
        _ackLevel   = _alertLevel;
        _ackUntilMs = now + Config.alertAckMs();
    }
    hideAlert();
    showToast("ALERT MUTED");
    return true;
}

/* ═════════════════════════════ lamp strip ════════════════════════════════
 *
 * The lit lamps, over whichever screen is up — the way the car's own cluster
 * keeps its telltales visible whatever the trip computer is showing. It sits
 * on the lower chord of the glass, above the page dots, only as wide as the
 * lamps it holds, and is gone when none are lit.
 */

/** Horizontal distance between strip slots, and the pill's inner margin. */
static constexpr int STRIP_PITCH = 26, STRIP_PAD = 6;

void UIBuilder::buildTelltaleStrip() {
    // Switched off: build nothing, and leave its LVGL heap to the screens.
    if (!_lamps.strip()) return;
    _strip = lv_obj_create(lv_layer_top());
    lv_obj_set_size(_strip, STRIP_PITCH + 10, 30);
    lv_obj_set_style_radius(_strip, 15, 0);
    lv_obj_set_style_bg_color(_strip, lv_color_hex(UI_PANEL), 0);
    lv_obj_set_style_bg_opa(_strip, LV_OPA_90, 0);
    lv_obj_set_style_border_width(_strip, 1, 0);
    lv_obj_set_style_border_color(_strip, lv_color_hex(UI_LINE), 0);
    lv_obj_set_style_pad_all(_strip, 0, 0);
    lv_obj_clear_flag(_strip, LV_OBJ_FLAG_SCROLLABLE | LV_OBJ_FLAG_CLICKABLE);
    if (_lamps.stripTop()) lv_obj_align(_strip, LV_ALIGN_TOP_MID, 0, 20);
    else                   lv_obj_align(_strip, LV_ALIGN_BOTTOM_MID, 0, -20);

    for (size_t j = 0; j < STRIP_SLOTS; j++) {
        _stripImg[j] = makeLamp(_strip, ICON_WARN, 0, 0);
        lv_obj_align(_stripImg[j], LV_ALIGN_LEFT_MID, STRIP_PAD + (int)j * STRIP_PITCH, 0);
        lv_obj_add_flag(_stripImg[j], LV_OBJ_FLAG_HIDDEN);
        _stripIcon[j] = ICON_WARN;
        _stripRgb[j]  = LAMP_HIDDEN;
    }
    _stripMore = makeLabel(_strip, "", &lv_font_montserrat_12,
                           lv_color_hex(UI_MUTED), LV_ALIGN_LEFT_MID, 0, 0);
    lv_obj_add_flag(_stripMore, LV_OBJ_FLAG_HIDDEN);
    lv_obj_add_flag(_strip, LV_OBJ_FLAG_HIDDEN);
}

/**
 * @brief Collect the lit lamps for a row, most urgent first.
 * @param lamps    The lamp set.
 * @param forStrip true for the strip: takes the lamps Telltales::onStrip
 *                 allows, pins the indicators to the ends where the eye expects them,
 *                 and gives up a slot to "+N" when there are too many. false
 *                 for the dash row, whose indicators have their own arrows.
 * @param[out] slots Lamp indices, left to right; -1 marks the "+N" slot.
 * @param cap      Capacity of @p slots.
 * @param[out] more Lamps that did not fit, 0 when all did.
 * @return Slots used.
 */
static size_t collectLamps(const Telltales &lamps, bool forStrip,
                           int *slots, size_t cap, int &more) {
    int order[Telltales::MAX_LAMPS];
    size_t m = 0;
    int left = -1, right = -1;
    for (size_t i = 0; i < lamps.size(); i++) {
        const Lamp &l = lamps[i];
        if (forStrip ? !lamps.onStrip(i) : !l.on) continue;
        if (l.turn) {
            if (!forStrip) continue;
            if (l.icon == ICON_TURN_L && left  < 0) { left  = (int)i; continue; }
            if (l.icon == ICON_TURN_R && right < 0) { right = (int)i; continue; }
        }
        size_t k = m++;                                   // stable insertion
        while (k > 0 && lamps.rank((size_t)order[k - 1]) > lamps.rank(i)) {
            order[k] = order[k - 1];
            k--;
        }
        order[k] = (int)i;
    }
    size_t n = 0;
    const size_t room = cap - (left >= 0) - (right >= 0);
    size_t mid = m;
    more = 0;
    if (mid > room) {
        mid  = (forStrip && room > 0) ? room - 1 : room;   // a slot for "+N"
        more = (int)(m - mid);
    }
    if (left >= 0) slots[n++] = left;
    for (size_t k = 0; k < mid; k++) slots[n++] = order[k];
    if (forStrip && more > 0) slots[n++] = -1;
    if (right >= 0) slots[n++] = right;
    return n;
}

void UIBuilder::updateTelltaleStrip() {
    if (!_strip) return;

    int slots[STRIP_SLOTS];
    int more = 0;
    size_t n = 0;
    // Full strip, or folded to the most urgent fault plus "+N" - see
    // Telltales::stripFull.
    if (_lamps.strip() && _screens[_active].showTelltales)
        n = collectLamps(_lamps, true, slots, _lamps.stripFull() ? STRIP_SLOTS : 2, more);

    if (n == 0) {
        if (_stripShown) { lv_obj_add_flag(_strip, LV_OBJ_FLAG_HIDDEN); _stripShown = false; }
        return;
    }

    int moreSlot = -1;
    for (size_t j = 0; j < STRIP_SLOTS; j++) {
        uint32_t want = LAMP_HIDDEN;
        if (j < n && slots[j] < 0) {
            moreSlot = (int)j;
        } else if (j < n) {
            const Lamp &l = _lamps[(size_t)slots[j]];
            if (l.icon != _stripIcon[j]) {
                _stripIcon[j] = l.icon;
                lv_img_set_src(_stripImg[j], Telltales::iconImage(l.icon));
            }
            // The dark half of a flash keeps its slot, drawn as a ghost.
            want = l.lit ? Telltales::toneRgb(l.tone) : UI_LAMP_OFF;
        }
        setLamp(_stripImg[j], _stripRgb[j], want);
    }
    const int moreKey = more > 0 ? more * 16 + moreSlot : -1;
    if (moreKey != _stripMoreN) {
        _stripMoreN = moreKey;
        if (more > 0) {
            lv_label_set_text_fmt(_stripMore, "+%d", more);
            lv_obj_align(_stripMore, LV_ALIGN_LEFT_MID,
                         STRIP_PAD + moreSlot * STRIP_PITCH + 2, 0);
            lv_obj_clear_flag(_stripMore, LV_OBJ_FLAG_HIDDEN);
        } else {
            lv_obj_add_flag(_stripMore, LV_OBJ_FLAG_HIDDEN);
        }
    }
    if (n != _stripCount) {
        _stripCount = n;
        lv_obj_set_width(_strip, (int)n * STRIP_PITCH + 10);
    }
    if (!_stripShown) { lv_obj_clear_flag(_strip, LV_OBJ_FLAG_HIDDEN); _stripShown = true; }
}

/* ═══════════════════════════════ dash runtime ════════════════════════════ */

void UIBuilder::updateDash(DashView &dv, float lerp, uint32_t now) {
    uint32_t rgb;
    bool lit;
    const uint32_t unlit = dv.ghosts ? UI_LAMP_OFF : LAMP_HIDDEN;

    // The row under the arc: the lit lamps only, centred in the gap.
    if (dv.slots) {
        int slots[DASH_LAMP_SLOTS];
        int more = 0;
        const size_t n = collectLamps(_lamps, false, slots, dv.slots, more);
        const int x0 = 120 - ((int)n * 26 - 2) / 2;
        for (size_t k = 0; k < dv.slots; k++) {
            uint32_t want = LAMP_HIDDEN;
            if (k < n && slots[k] >= 0) {
                const Lamp &l = _lamps[(size_t)slots[k]];
                if (l.icon != dv.slotIcon[k]) {
                    dv.slotIcon[k] = l.icon;
                    lv_img_set_src(dv.slot[k], Telltales::iconImage(l.icon));
                }
                want = l.lit ? Telltales::toneRgb(l.tone) : UI_LAMP_OFF;
                // Position follows the count; only moved when it changes.
                if (lv_obj_get_x(dv.slot[k]) != x0 + (int)k * 26)
                    lv_obj_set_x(dv.slot[k], x0 + (int)k * 26);
            }
            setLamp(dv.slot[k], dv.slotRgb[k], want);
        }
    }
    for (int t = 0; t < 2; t++) {
        uint32_t want = unlit;
        if (_lamps.iconState(t ? ICON_TURN_R : ICON_TURN_L, rgb, lit) && lit) want = rgb;
        setLamp(dv.turn[t], dv.turnRgb[t], want);
    }
    // The fuel and coolant symbols take their lamp's colour while it is lit.
    const struct { lv_obj_t *img; uint32_t *cache; uint8_t icon; } marks[2] = {
        {dv.fuelIcon, &dv.fuelRgb, ICON_FUEL}, {dv.tempIcon, &dv.tempRgb, ICON_COOLANT}};
    for (const auto &mk : marks) {
        uint32_t want = UI_MUTED;
        if (_lamps.iconState(mk.icon, rgb, lit) && lit) want = rgb;
        setLamp(mk.img, *mk.cache, want);
    }

    if (dv.shift) {
        MetricSample s{};
        float rpm = 0;
        if (sampleOnce(dv.rpmMetric, lerp, s) && (s.flags & METRIC_FLAG_VALID) && !s.stale)
            rpm = s.raw;                       // raw: a shift light must not lag
        const bool over  = rpm >= dv.shiftRpm;
        const bool flash = ((now / 60) & 1) == 0;         // ~8 Hz at the limit
        static const uint32_t kLed[5] = {UI_LAMP_GREEN, UI_LAMP_GREEN, UI_WARN,
                                         UI_WARN, UI_CRIT};
        for (int k = 0; k < 5; k++) {
            const float at = dv.shiftStart + (dv.shiftRpm - dv.shiftStart) * k / 4.0f;
            const uint32_t want = over ? (flash ? UI_CRIT : UI_LAMP_OFF)
                                       : (rpm >= at ? kLed[k] : UI_LAMP_OFF);
            if (want != dv.ledRgb[k]) {
                dv.ledRgb[k] = want;
                lv_obj_set_style_bg_color(dv.led[k], lv_color_hex(want), 0);
            }
        }
        if (dv.gearBox) {
            const uint32_t want = (over && flash) ? UI_CRIT : UI_LINE;
            if (want != dv.gearRgb) {
                dv.gearRgb = want;
                lv_obj_set_style_border_color(dv.gearBox, lv_color_hex(want), 0);
            }
        }
    }
}

/* ---- diagnostics --------------------------------------------------------- */

void UIBuilder::updateDiag() {
    LinkStats st = Telemetry.stats();
    const bool up = Telemetry.linkUp();
    char buf[16];

    setLabelText(_diagVals[0], _diagLast[0], sizeof(_diagLast[0]),
                 up ? "UP" : "DOWN");
    lv_obj_set_style_text_color(_diagVals[0],
        up ? lv_palette_main(LV_PALETTE_GREEN)
           : lv_palette_main(LV_PALETTE_RED), 0);

    snprintf(buf, sizeof(buf), "%d pkt/s", (int)st.packetsPerSecond);
    setLabelText(_diagVals[1], _diagLast[1], sizeof(_diagLast[1]), buf);
    snprintf(buf, sizeof(buf), "%u", st.packetsDropped);
    setLabelText(_diagVals[2], _diagLast[2], sizeof(_diagLast[2]), buf);
    snprintf(buf, sizeof(buf), "%u KB", ESP.getFreeHeap() / 1024);
    setLabelText(_diagVals[3], _diagLast[3], sizeof(_diagLast[3]), buf);
    snprintf(buf, sizeof(buf), "%u s", millis() / 1000);
    setLabelText(_diagVals[4], _diagLast[4], sizeof(_diagLast[4]), buf);

    // Live pin scan: hold the side button and watch which number turns L.
    char scan[24];
    Button.scanState(scan, sizeof(scan));
    setLabelText(_diagVals[5], _diagLast[5], sizeof(_diagLast[5]), scan);
}

/* ---- navigation / gestures ----------------------------------------------- */

void UIBuilder::loadScreen(size_t idx, bool forward) {
    const uint32_t ms = Config.swipeAnimMs();

    /*
     * Transition cost, cheapest first. A screen change repaints all 240×240
     * every frame, and on a 160 MHz single core that budget is tight:
     *
     *   "over" — only the incoming screen moves; the outgoing one is static.
     *            LVGL still composites both, but half the position math and
     *            far less invalidation churn. Default.
     *   "move" — both screens slide. Looks classic, costs the most.
     *   "fade" — cross-fade; blending every pixel, so no cheaper than move.
     *   "none" — instant. Always perfectly smooth because there is nothing
     *            to animate; the honest choice on a busy layout.
     */
    const char *style = Config.swipeAnimStyle();
    lv_scr_load_anim_t anim;
    if (!strcmp(style, "none"))      anim = LV_SCR_LOAD_ANIM_NONE;
    else if (!strcmp(style, "fade")) anim = LV_SCR_LOAD_ANIM_FADE_ON;
    else if (!strcmp(style, "move"))
        anim = forward ? LV_SCR_LOAD_ANIM_MOVE_LEFT : LV_SCR_LOAD_ANIM_MOVE_RIGHT;
    else
        anim = forward ? LV_SCR_LOAD_ANIM_OVER_LEFT : LV_SCR_LOAD_ANIM_OVER_RIGHT;

    // Prime the incoming screen with current values (lerp factor 1 = snap;
    // it is still off-screen, so there is nothing to ease). Without this it
    // slides in showing whatever was last drawn on it, which reads as a
    // one-frame glitch at the start of every transition.
    for (auto &b : _screens[idx].bindings) {
        MetricSample s;
        const bool ok = Telemetry.sample(b.metricId, 1.0f, s);
        const bool usable = ok && (s.flags & METRIC_FLAG_VALID) && !s.stale;
        renderBinding(b, ok ? s.value : 0.0f, usable, ok ? s.peak : 0.0f);
    }

    lv_obj_t *outgoing = _screens[_active].scr;
    _active      = idx;
    // Arrive with lamps already right, and the strip shown or not for the
    // new screen: the tick is suspended for the length of the slide.
    if (_screens[idx].dash >= 0)
        updateDash(_dash[_screens[idx].dash], Config.lerpSpeed(), millis());
    updateTelltaleStrip();
    _busySinceMs = millis();
    _busyMs      = (anim == LV_SCR_LOAD_ANIM_NONE) ? 0 : ms + 40;
    lv_scr_load_anim(_screens[idx].scr, anim,
                     anim == LV_SCR_LOAD_ANIM_NONE ? 0 : ms, 0, false);

    /*
     * LVGL never calls lv_anim_set_path_cb for screen transitions, so they run
     * on the lv_anim_init default: LINEAR. Constant velocity with a hard start
     * and a hard stop is exactly what makes a slide read as mechanical rather
     * than smooth, however high the frame rate is.
     *
     * Retarget the animations LVGL just created. path_cb is consulted on every
     * step, so setting it after the animation has started is safe — and it is
     * the only way in, since the exec callbacks are static inside lv_disp.c.
     * lv_anim_get with a null exec_cb matches any animation on that object.
     */
    const lv_anim_path_cb_t path = easingFromName(Config.swipeEasing());
    if (lv_anim_t *a = lv_anim_get(_screens[idx].scr, nullptr)) a->path_cb = path;
    if (lv_anim_t *a = lv_anim_get(outgoing, nullptr))          a->path_cb = path;
}

void UIBuilder::nextScreen() {
    if (_configActive || _screens.size() < 2) return;
    loadScreen((_active + 1) % _screens.size(), true);
}

void UIBuilder::prevScreen() {
    if (_configActive || _screens.size() < 2) return;
    loadScreen((_active + _screens.size() - 1) % _screens.size(), false);
}

void UIBuilder::togglePeaks() {
    if (_configActive) return;
    _peaksShown = !_peaksShown;
    for (auto &sd : _screens)
        for (auto &b : sd.bindings)
            if (b.peakLabel) {
                if (_peaksShown) lv_obj_clear_flag(b.peakLabel, LV_OBJ_FLAG_HIDDEN);
                else             lv_obj_add_flag(b.peakLabel, LV_OBJ_FLAG_HIDDEN);
            }
    showToast(_peaksShown ? "PEAKS ON" : "PEAKS OFF");
}

void UIBuilder::cycleNightOverride() {
    if (_configActive) return;
    switch (_nightOverride) {
        case NightOverride::Auto:
            _nightOverride = NightOverride::ForceDay;
            showToast("DAY MODE");
            break;
        case NightOverride::ForceDay:
            _nightOverride = NightOverride::ForceNight;
            showToast("NIGHT MODE");
            break;
        default:
            _nightOverride = NightOverride::Auto;
            showToast("AUTO DAY/NIGHT");
            break;
    }
    // tick() picks the new source up on the next pass.
}

void UIBuilder::resetPeaksWithToast() {
    if (_configActive) return;
    Telemetry.resetPeaks();
    for (auto &sd : _screens)
        for (auto &b : sd.bindings) b.lastPeakText[0] = '\0';  // force redraw
    showToast("PEAKS RESET");
}

/* ---- toast ---------------------------------------------------------------- */

void UIBuilder::toastTimerCb(lv_timer_t *t) {
    auto *self = static_cast<UIBuilder *>(t->user_data);
    if (self->_toast) { lv_obj_del(self->_toast); self->_toast = nullptr; }
    self->_toastTimer = nullptr;   // repeat_count 1 — LVGL frees the timer
}

void UIBuilder::showToast(const char *text) {
    if (_toast)      { lv_obj_del(_toast);      _toast = nullptr; }
    if (_toastTimer) { lv_timer_del(_toastTimer); _toastTimer = nullptr; }

    // Lives on lv_layer_top so it survives screen transitions.
    _toast = lv_obj_create(lv_layer_top());
    lv_obj_set_size(_toast, LV_SIZE_CONTENT, LV_SIZE_CONTENT);
    lv_obj_set_style_pad_hor(_toast, 14, 0);
    lv_obj_set_style_pad_ver(_toast, 6, 0);
    lv_obj_set_style_radius(_toast, LV_RADIUS_CIRCLE, 0);
    lv_obj_set_style_bg_color(_toast, lv_color_hex(UI_PANEL), 0);
    lv_obj_set_style_bg_opa(_toast, LV_OPA_90, 0);
    lv_obj_set_style_border_width(_toast, 1, 0);
    lv_obj_set_style_border_color(_toast, lv_color_hex(UI_ACCENT), 0);
    lv_obj_clear_flag(_toast, LV_OBJ_FLAG_SCROLLABLE | LV_OBJ_FLAG_CLICKABLE);
    lv_obj_align(_toast, LV_ALIGN_TOP_MID, 0, 30);

    lv_obj_t *l = lv_label_create(_toast);
    lv_label_set_text(l, text);
    lv_obj_set_style_text_font(l, &lv_font_montserrat_14, 0);
    lv_obj_set_style_text_color(l, lv_color_white(), 0);
    lv_obj_center(l);

    _toastTimer = lv_timer_create(toastTimerCb, 1300, this);
    lv_timer_set_repeat_count(_toastTimer, 1);
}

/* ---- boot needle sweep --------------------------------------------------- */

void UIBuilder::sweepExecCb(void *var, int32_t v) {
    auto *self = static_cast<UIBuilder *>(var);
    ScreenDef &sd = self->_screens[self->_active];
    char buf[24];
    for (auto &b : sd.bindings) {
        float fake = b.minV + (b.maxV - b.minV) * (v / 1000.0f);
        self->setGaugeValue(b, fake);
        if (b.valueLabel) {
            formatBinding(b, fake, buf, sizeof(buf));
            lv_label_set_text(b.valueLabel, buf);
        }
    }
}

void UIBuilder::sweepReadyCb(lv_anim_t *a) {
    static_cast<UIBuilder *>(a->var)->_sweepActive = false;
}

void UIBuilder::startupSweep() {
    if (_screens.empty() || _screens[_active].bindings.empty()) return;
    _sweepActive = true;
    lv_anim_t a;
    lv_anim_init(&a);
    lv_anim_set_var(&a, this);
    lv_anim_set_exec_cb(&a, sweepExecCb);
    lv_anim_set_values(&a, 0, 1000);
    lv_anim_set_time(&a, UI_SWEEP_UP_MS);
    lv_anim_set_playback_time(&a, UI_SWEEP_DOWN_MS);
    lv_anim_set_path_cb(&a, lv_anim_path_ease_in_out);
    lv_anim_set_ready_cb(&a, sweepReadyCb);
    lv_anim_start(&a);
}

/* ---- day / night --------------------------------------------------------- */

void UIBuilder::applyNight(bool night) {
    lv_theme_default_init(lv_disp_get_default(),
                          lv_palette_main(LV_PALETTE_CYAN),
                          lv_palette_main(LV_PALETTE_RED),
                          night, LV_FONT_DEFAULT);
    lv_color_t bg = colorFromHex(night ? Config.nightBg() : Config.dayBg(),
                                 night ? lv_color_black()
                                       : lv_color_hex(UI_BG_DAY));
    for (auto &sd : _screens)
        if (sd.root) lv_obj_set_style_bg_color(sd.root, bg, 0);
    Display.setBrightness(night ? BRIGHTNESS_NIGHT : BRIGHTNESS_DAY);
}

/* ---- config-mode screen --------------------------------------------------- */

void UIBuilder::showConfigScreen(const char *ssid, const char *ip) {
    _configActive = true;
    // The tick stops here, so anything left on lv_layer_top would stay over
    // the portal screen for good.
    hideOverlays();

    lv_obj_t *scr = lv_obj_create(nullptr);
    lv_obj_set_style_bg_color(scr, lv_color_hex(UI_CONFIG_BG), 0);

    lv_obj_t *root = lv_obj_create(scr);
    lv_obj_set_size(root, LCD_WIDTH, LCD_HEIGHT);
    lv_obj_center(root);
    lv_obj_set_style_radius(root, LV_RADIUS_CIRCLE, 0);
    lv_obj_set_style_clip_corner(root, true, 0);
    lv_obj_set_style_border_width(root, 0, 0);
    lv_obj_set_style_bg_color(root, lv_color_hex(UI_CONFIG_BG), 0);
    lv_obj_clear_flag(root, LV_OBJ_FLAG_SCROLLABLE);

    lv_obj_t *spin = lv_spinner_create(root, 2000, 40);
    lv_obj_set_size(spin, 220, 220);
    lv_obj_center(spin);
    lv_obj_set_style_arc_width(spin, 4, LV_PART_MAIN);
    lv_obj_set_style_arc_width(spin, 4, LV_PART_INDICATOR);
    lv_obj_set_style_arc_color(spin, lv_color_hex(UI_LINE), LV_PART_MAIN);
    lv_obj_set_style_arc_color(spin, lv_color_hex(UI_ACCENT), LV_PART_INDICATOR);

    makeLabel(root, LV_SYMBOL_WIFI, &lv_font_montserrat_28,
              lv_color_hex(UI_ACCENT), LV_ALIGN_TOP_MID, 0, 40);
    makeLabel(root, "GAUGE STUDIO", &lv_font_montserrat_20,
              lv_color_white(), LV_ALIGN_TOP_MID, 0, 78);
    makeLabel(root, ssid, &lv_font_montserrat_14,
              lv_color_hex(UI_MUTED), LV_ALIGN_CENTER, 0, -6);
    char url[48];
    snprintf(url, sizeof(url), "http://%s", ip);
    makeLabel(root, url, &lv_font_montserrat_16,
              lv_color_hex(UI_ACCENT), LV_ALIGN_CENTER, 0, 22);
    char hold[32];                                // the board's own hold time
    snprintf(hold, sizeof(hold), "Hold %us to reboot",
             (unsigned)(GESTURE_HOLD_CONFIG_MS / 1000));
    makeLabel(root, hold, &lv_font_montserrat_12,
              lv_color_hex(UI_DIM), LV_ALIGN_BOTTOM_MID, 0, -34);

    lv_scr_load_anim(scr, LV_SCR_LOAD_ANIM_FADE_ON, 300, 0, false);
}
