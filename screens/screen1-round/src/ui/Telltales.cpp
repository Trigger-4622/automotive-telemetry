/**
 * @file Telltales.cpp
 * @ingroup ui
 * @brief Warning-lamp logic. Identical in both display projects.
 */
#include "Telltales.h"

#include <math.h>

#include "HardwareConfig.h"
#include "MasterPacket.h"
#include "Palette.h"
#include "TelemetryStore.h"
#include "TelltaleIcons.h"   // generated by tools/make_icons.py

/**
 * Where the strip may stay up by default. The landscape cluster keeps a header
 * band free for it on every screen, so there it covers nothing and can stay
 * like a real cluster's lamps; on the round glass it sits over content, so
 * there it folds away after a peek.
 */
static constexpr bool kStripAlwaysDefault = LCD_WIDTH != LCD_HEIGHT;

/* ═══════════════════════════════ tables ══════════════════════════════════ */

/** Bitmaps (24 and 36 px) and layout names, indexed by @ref LampIcon. */
static const struct { const lv_img_dsc_t *img, *big; const char *name; }
kIcons[ICON_COUNT] = {
    { &icon_mil,       &icon_mil_36,       "mil"       },
    { &icon_seatbelt,  &icon_seatbelt_36,  "seatbelt"  },
    { &icon_door,      &icon_door_36,      "door"      },
    { &icon_park,      &icon_park_36,      "park"      },
    { &icon_turn_l,    &icon_turn_l_36,    "turn_l"    },
    { &icon_turn_r,    &icon_turn_r_36,    "turn_r"    },
    { &icon_high_beam, &icon_high_beam_36, "high_beam" },
    { &icon_lights,    &icon_lights_36,    "lights"    },
    { &icon_cruise,    &icon_cruise_36,    "cruise"    },
    { &icon_fuel,      &icon_fuel_36,      "fuel"      },
    { &icon_battery,   &icon_battery_36,   "battery"   },
    { &icon_oil,       &icon_oil_36,       "oil"       },
    { &icon_coolant,   &icon_coolant_36,   "coolant"   },
    { &icon_knock,     &icon_knock_36,     "knock"     },
    { &icon_warn,      &icon_warn_36,      "warn"      },
};

const lv_img_dsc_t *Telltales::iconImage(uint8_t icon, bool large) {
    const auto &e = kIcons[icon < ICON_COUNT ? icon : (uint8_t)ICON_WARN];
    return large ? e.big : e.img;
}

int Telltales::iconFromName(const char *name) {
    if (!name) return -1;
    for (int i = 0; i < ICON_COUNT; i++)
        if (!strcmp(kIcons[i].name, name)) return i;
    return -1;
}

uint32_t Telltales::toneRgb(LampTone t) {
    switch (t) {
        case LampTone::Red:   return UI_CRIT;
        case LampTone::Amber: return UI_WARN;
        case LampTone::Green: return UI_LAMP_GREEN;
        default:              return UI_LAMP_BLUE;
    }
}

/* ═══════════════════════════ defaults ═════════════════════════════════════ */

Lamp &Telltales::add(const char *key, const char *title, const char *detail,
                     uint8_t icon, LampTone tone, uint16_t metric,
                     LampRule rule, float threshold, float hyst) {
    Lamp &l = _lamps[_n++];
    l = Lamp{};
    strlcpy(l.key,    key,    sizeof(l.key));
    strlcpy(l.title,  title,  sizeof(l.title));
    strlcpy(l.detail, detail, sizeof(l.detail));
    l.icon       = icon;
    l.tone       = tone;
    l.enabled    = true;
    l.strip      = true;
    l.metric     = metric;
    l.rule       = rule;
    l.threshold  = threshold;
    l.hyst       = hyst;
    l.popup      = LampPopup::Off;
    l.blinkSpeed = -1;
    l.value      = NAN;
    l.extra      = NAN;
    return l;
}

/*
 * The built-in set. Order is the order of the dash's lamp row, left to right,
 * roughly by how much each one matters. Every field can be overridden per lamp
 * from the layout; these are only the defaults.
 */
void Telltales::loadDefaults() {
    _n = 0;

    Lamp *l = &add("mil", "CHECK ENGINE", "ENGINE FAULT STORED",
                   ICON_MIL, LampTone::Amber, METRIC_ID_MIL, LampRule::On);
    l->popup = LampPopup::Once;  l->popupSecs = 10;
    l->extraMetric = METRIC_ID_DTC_COUNT;
    strlcpy(l->units, "CODES", sizeof(l->units));

    l = &add("oil", "OIL PRESSURE", "STOP THE ENGINE SAFELY",
             ICON_OIL, LampTone::Red, METRIC_ID_OIL_PRESSURE, LampRule::Below,
             0.5f, 0.2f);
    l->engine = true;  l->critical = true;  l->popup = LampPopup::Repeat;
    l->debounceMs = 1000;  l->decimals = 1;
    strlcpy(l->units, "bar", sizeof(l->units));

    // A healthy alternator holds 13.5-14.5 V. Below 12 V with the engine
    // running the car is living off the battery.
    l = &add("charging", "CHARGING", "ALTERNATOR NOT CHARGING",
             ICON_BATTERY, LampTone::Red, METRIC_ID_BATT_VOLTAGE,
             LampRule::Below, 12.0f, 0.5f);
    l->engine = true;  l->popup = LampPopup::Once;  l->debounceMs = 5000;
    l->decimals = 1;
    strlcpy(l->units, "V", sizeof(l->units));

    l = &add("coolant_hot", "ENGINE HOT", "EASE OFF, CHECK COOLANT",
             ICON_COOLANT, LampTone::Red, METRIC_ID_COOLANT_TEMP,
             LampRule::Above, 110.0f, 3.0f);
    l->critical = true;  l->popup = LampPopup::Repeat;  l->debounceMs = 2000;
    strlcpy(l->units, "\xC2\xB0" "C", sizeof(l->units));

    l = &add("coolant_cold", "ENGINE COLD", "GO EASY UNTIL IT WARMS UP",
             ICON_COOLANT, LampTone::Blue, METRIC_ID_COOLANT_TEMP,
             LampRule::Below, 45.0f, 3.0f);
    strlcpy(l->units, "\xC2\xB0" "C", sizeof(l->units));

    // Belt, door and brake: the lamp shows at a standstill like the car's own,
    // but only a car that is moving earns a popup.
    l = &add("seatbelt", "FASTEN SEAT BELT", "DRIVER BELT NOT FASTENED",
             ICON_SEATBELT, LampTone::Red, METRIC_ID_SEATBELT, LampRule::On);
    l->popup = LampPopup::Repeat;  l->popupSpeed = 10;  l->blinkSpeed = 10;

    l = &add("door", "DOOR OPEN", "CLOSE ALL DOORS",
             ICON_DOOR, LampTone::Red, METRIC_ID_DOOR_OPEN, LampRule::On);
    l->critical = true;  l->popup = LampPopup::Repeat;  l->popupSpeed = 5;
    l->blinkSpeed = 5;

    l = &add("parking_brake", "PARKING BRAKE", "RELEASE THE PARKING BRAKE",
             ICON_PARK, LampTone::Red, METRIC_ID_HANDBRAKE, LampRule::On);
    l->critical = true;  l->popup = LampPopup::Repeat;  l->popupSpeed = 5;
    l->blinkSpeed = 5;

    // Fuel sloshes: only a level that stays low for a while is believed.
    l = &add("low_fuel", "LOW FUEL", "REFUEL SOON",
             ICON_FUEL, LampTone::Amber, METRIC_ID_FUEL_LEVEL,
             LampRule::Below, 12.0f, 3.0f);
    l->popup = LampPopup::Once;  l->popupSecs = 8;  l->debounceMs = 10000;
    strlcpy(l->units, "%", sizeof(l->units));

    // Knock correction is negative when the ECU pulls timing. Held for a few
    // seconds, because an event lasts a fraction of one.
    l = &add("knock", "KNOCK", "ECU IS PULLING TIMING",
             ICON_KNOCK, LampTone::Amber, METRIC_ID_SSM_KNOCK_CORR,
             LampRule::Below, -3.0f, 0.5f);
    l->holdMs = 3000;  l->decimals = 1;
    strlcpy(l->units, "\xC2\xB0", sizeof(l->units));

    add("high_beam", "HIGH BEAM", "", ICON_HIGH_BEAM, LampTone::Blue,
        METRIC_ID_HIGH_BEAM, LampRule::On);
    // On for the whole of every night drive: on the dash, but kept off the
    // strip, where it would sit over the screens all evening saying nothing.
    l = &add("lights", "LIGHTS ON", "", ICON_LIGHTS, LampTone::Green,
             METRIC_ID_SW_LIGHTS, LampRule::On);
    l->strip = false;
    add("cruise", "CRUISE", "", ICON_CRUISE, LampTone::Green,
        METRIC_ID_CRUISE_ON, LampRule::On);

    l = &add("turn_left", "LEFT INDICATOR", "", ICON_TURN_L, LampTone::Green,
             METRIC_ID_TURN_LEFT, LampRule::On);
    l->turn = true;  l->holdMs = 1000;
    l = &add("turn_right", "RIGHT INDICATOR", "", ICON_TURN_R, LampTone::Green,
             METRIC_ID_TURN_RIGHT, LampRule::On);
    l->turn = true;  l->holdMs = 1000;

    // Spare lamps for anything found on the bus later - ABS, airbag, TPMS...
    // Point one at a metric (a custom channel, usually) and give it a name.
    static const char *const customKeys[]   = {"custom_1", "custom_2", "custom_3"};
    static const char *const customTitles[] = {"CUSTOM 1", "CUSTOM 2", "CUSTOM 3"};
    for (int i = 0; i < 3; i++) {
        l = &add(customKeys[i], customTitles[i], "", ICON_WARN,
                 LampTone::Amber, 0, LampRule::On);
        l->enabled = false;
    }
}

/* ═══════════════════════════ configuration ════════════════════════════════ */

/**
 * @brief Read a metric ID written as "0x010C" or as a number.
 * @param v JSON value.
 * @param fallback Returned when @p v is absent or out of range.
 * @return The ID.
 */
static uint16_t metricFrom(JsonVariantConst v, uint16_t fallback) {
    if (v.isNull()) return fallback;
    unsigned long id;
    if (v.is<const char *>()) {
        const char *s = v.as<const char *>();
        char *end = nullptr;
        id = strtoul(s, &end, 0);
        if (end == s) return fallback;
    } else if (v.is<long>()) {
        const long n = v.as<long>();
        if (n < 0) return fallback;
        id = (unsigned long)n;
    } else {
        return fallback;
    }
    return id <= 0xFFFF ? (uint16_t)id : fallback;
}

/**
 * @brief Read a non-negative duration, clamped to a uint16_t field.
 * @param v        JSON value.
 * @param fallback Returned when @p v is absent or not a number.
 * @param maxV     Upper clamp.
 */
static uint16_t msFrom(JsonVariantConst v, uint16_t fallback, uint16_t maxV) {
    if (!v.is<float>() && !v.is<long>()) return fallback;
    const float f = v.as<float>();
    if (!(f >= 0)) return 0;                 // negative or NaN
    return f >= maxV ? maxV : (uint16_t)f;
}

/** @brief Read a finite float, or keep @p fallback. */
static float floatFrom(JsonVariantConst v, float fallback) {
    if (!v.is<float>() && !v.is<long>()) return fallback;
    const float f = v.as<float>();
    return isfinite(f) ? f : fallback;
}

void Telltales::override(Lamp &l, JsonVariantConst o) {
    // "knock": false switches a lamp off outright, "knock": true on.
    if (o.is<bool>()) { l.enabled = o.as<bool>(); return; }
    if (!o.is<JsonObjectConst>()) return;

    l.enabled     = o["enabled"] | l.enabled;
    l.strip       = o["strip"]   | l.strip;
    l.metric      = metricFrom(o["metric_id"], l.metric);
    l.extraMetric = metricFrom(o["extra_metric_id"], l.extraMetric);

    if (const char *r = o["rule"] | (const char *)nullptr) {
        if      (!strcmp(r, "on"))    l.rule = LampRule::On;
        else if (!strcmp(r, "off"))   l.rule = LampRule::Off;
        else if (!strcmp(r, "above")) l.rule = LampRule::Above;
        else if (!strcmp(r, "below")) l.rule = LampRule::Below;
    }
    l.threshold = floatFrom(o["threshold"],  l.threshold);
    l.hyst      = fabsf(floatFrom(o["hysteresis"], l.hyst));
    l.engine    = o["engine"]   | l.engine;
    l.critical  = o["critical"] | l.critical;

    JsonVariantConst p = o["popup"];
    if (p.is<bool>()) {
        // true keeps the lamp's own mode, or picks Once for a lamp that had
        // none; false silences it.
        if (!p.as<bool>())                  l.popup = LampPopup::Off;
        else if (l.popup == LampPopup::Off) l.popup = LampPopup::Once;
    } else if (const char *m = p | (const char *)nullptr) {
        if      (!strcmp(m, "off"))    l.popup = LampPopup::Off;
        else if (!strcmp(m, "once"))   l.popup = LampPopup::Once;
        else if (!strcmp(m, "repeat")) l.popup = LampPopup::Repeat;
    }
    l.popupSpeed = fmaxf(0.0f, floatFrom(o["popup_speed"], l.popupSpeed));
    l.blinkSpeed = floatFrom(o["blink_speed"], l.blinkSpeed);
    l.popupSecs  = msFrom(o["popup_secs"],  l.popupSecs,  3600);
    l.debounceMs = msFrom(o["debounce_ms"], l.debounceMs, 60000);
    l.holdMs     = msFrom(o["hold_ms"],     l.holdMs,     60000);

    if (const char *t = o["tone"] | (const char *)nullptr) {
        if      (!strcmp(t, "red"))   l.tone = LampTone::Red;
        else if (!strcmp(t, "amber")) l.tone = LampTone::Amber;
        else if (!strcmp(t, "green")) l.tone = LampTone::Green;
        else if (!strcmp(t, "blue"))  l.tone = LampTone::Blue;
    }
    const int icon = iconFromName(o["icon"] | (const char *)nullptr);
    if (icon >= 0) l.icon = (uint8_t)icon;

    if (const char *s = o["title"]  | (const char *)nullptr) strlcpy(l.title,  s, sizeof(l.title));
    if (const char *s = o["detail"] | (const char *)nullptr) strlcpy(l.detail, s, sizeof(l.detail));
    if (const char *s = o["units"]  | (const char *)nullptr) strlcpy(l.units,  s, sizeof(l.units));
    const int dec = o["decimals"] | (int)l.decimals;
    l.decimals = (uint8_t)constrain(dec, 0, 3);
}

void Telltales::configure(JsonVariantConst w, uint32_t snoozeMs) {
    loadDefaults();
    _snoozeMs = snoozeMs;
    _enabled = true;  _strip = true;  _stripTop = false;  _popups = true;
    _stripAlways = kStripAlwaysDefault;  _peekMs = 6000;
    _stripLit = 0;  _peeking = false;  _turnOn = false;

    if (w.is<bool>()) { _enabled = w.as<bool>(); return; }
    if (!w.is<JsonObjectConst>()) return;         // absent: all defaults

    _enabled  = w["enabled"] | true;
    _strip    = w["strip"]   | true;
    _popups   = w["popups"]  | true;
    _stripTop = !strcmp(w["strip_position"] | "bottom", "top");
    _stripAlways = !strcmp(w["strip_mode"] | (kStripAlwaysDefault ? "always" : "peek"),
                           "always");
    _peekMs   = (uint32_t)msFrom(w["peek_secs"], 6, 60) * 1000u;

    JsonObjectConst lamps = w["lamps"];
    for (JsonPairConst kv : lamps) {
        const int i = find(kv.key().c_str());
        if (i < 0) {
            log_w("warnings: unknown lamp '%s' ignored", kv.key().c_str());
            continue;
        }
        override(_lamps[i], kv.value());
    }
}

int Telltales::find(const char *key) const {
    for (size_t i = 0; i < _n; i++)
        if (!strcmp(_lamps[i].key, key)) return (int)i;
    return -1;
}

/* ═════════════════════════════ evaluation ═════════════════════════════════ */

void Telltales::reset(Lamp &l) {
    l.on = l.lit = false;
    l.value = l.extra = NAN;
    l.cond = l.pending = false;
    l.rawPrev = false;
    l.speedGate = false;
    l.spent = l.snoozed = false;
    l.showing = false;
}

/**
 * @brief Read a metric that is present, valid and fresh.
 * @return The raw value, or NaN.
 */
static float usableRaw(TelemetryStore &store, uint16_t id) {
    MetricSample s;
    if (!id || !store.peek(id, s)) return NAN;
    if (!(s.flags & METRIC_FLAG_VALID) || s.stale) return NAN;
    return s.raw;
}

void Telltales::update(TelemetryStore &store, uint32_t now) {
    const float spd = usableRaw(store, METRIC_ID_SPEED);
    _speed = isnan(spd) ? 0.0f : spd;

    // Engine running = above cranking speed, continuously. Unknown RPM counts
    // as not running, which keeps every engine-gated lamp dark rather than
    // lighting oil and charging on a car whose ECU simply is not answering.
    const float rpm = usableRaw(store, METRIC_ID_RPM);
    if (!isnan(rpm) && rpm > ENGINE_RPM) {
        if (!_engineRunning) { _engineRunning = true; _engineSince = now; }
    } else {
        _engineRunning = false;
    }
    _engineSettled = _engineRunning && now - _engineSince >= ENGINE_SETTLE_MS;

    for (size_t i = 0; i < _n; i++) {
        Lamp &l = _lamps[i];
        if (!_enabled || !l.enabled || !l.metric) { reset(l); continue; }

        l.value = usableRaw(store, l.metric);
        l.extra = usableRaw(store, l.extraMetric);
        const float v = l.value;

        // Raw condition, latched through the hysteresis band.
        bool c = false;
        if (!isnan(v)) {
            switch (l.rule) {
                case LampRule::On:    c = v >= 0.5f; break;
                case LampRule::Off:   c = v <  0.5f; break;
                case LampRule::Above: c = l.cond ? v > l.threshold - l.hyst
                                                 : v >= l.threshold;  break;
                case LampRule::Below: c = l.cond ? v < l.threshold + l.hyst
                                                 : v <= l.threshold;  break;
            }
        }
        if (l.engine && !_engineSettled) c = false;
        l.cond = c;

        const bool wasOn = l.on;

        if (l.turn) {
            // Indicators ignore the debounce: the flasher IS the signal.
            if (c != l.rawPrev) { l.rawPrev = c; l.edgeMs = now; }
            if (c) l.lastTrueMs = now;
            // Kept on through the flasher's dark half, so the strip does not
            // open and close its slot twice a second.
            l.on = c || (wasOn && now - l.lastTrueMs < l.holdMs);
            if (!c) {
                l.lit = false;
            } else {
                const uint32_t held = now - l.edgeMs;
                // Short bright phases are the car's own flasher: follow it.
                // A steady bit is the lever: flash it ourselves, dark first,
                // since the first TURN_STEADY_MS were already shown bright.
                l.lit = held < TURN_STEADY_MS ||
                        ((held - TURN_STEADY_MS) / TURN_HALF_MS) % 2 == 1;
            }
        } else {
            if (!c) {
                l.pending = false;
            } else if (!l.pending) {
                l.pending = true;
                l.condSince = now;
            }
            const bool held = c && now - l.condSince >= l.debounceMs;
            if (held) l.lastTrueMs = now;
            l.on = held || (wasOn && now - l.lastTrueMs < l.holdMs);
            if (l.on && !wasOn) l.onSince = now;     // the flash starts bright

            const bool blink = l.on && l.blinkSpeed >= 0 && _speed >= l.blinkSpeed;
            l.lit = l.on && (!blink || ((now - l.onSince) / BLINK_HALF_MS) % 2 == 0);
        }

        if (l.on != wasOn) {
            // A fresh lighting earns a fresh popup; going out forgets it.
            l.spent = l.snoozed = false;
            l.showing = false;
            if (!l.on) l.speedGate = false;
        }

        // Speed gate for the popup, with hysteresis so crawling around the
        // limit does not flash the card on and off.
        if (l.popupSpeed <= 0)                    l.speedGate = true;
        else if (_speed >= l.popupSpeed)          l.speedGate = true;
        else if (_speed < l.popupSpeed * 0.6f)    l.speedGate = false;

        if (l.snoozed && (int32_t)(now - l.snoozeUntil) >= 0) l.snoozed = false;
        // A gap in being shown restarts the popup_secs clock next time.
        if (l.showing && now - l.lastShownMs > 500) l.showing = false;
    }

    // The strip: open it in full whenever a lamp comes on, fold it again
    // peek_secs later. Lamps going out never reopen it.
    uint32_t lit = 0;
    _turnOn = false;
    for (size_t i = 0; i < _n; i++) {
        const Lamp &l = _lamps[i];
        if (!l.on || !l.strip) continue;
        lit |= 1u << i;
        _turnOn |= l.turn;
    }
    if (lit & ~_stripLit) { _peeking = true; _peekSince = now; }
    if (_peeking && now - _peekSince >= _peekMs) _peeking = false;
    _stripLit = lit;
}

bool Telltales::onStrip(size_t i) const {
    if (i >= _n) return false;
    const Lamp &l = _lamps[i];
    if (!l.on || !l.strip) return false;
    return stripFull() || l.tone == LampTone::Red || l.tone == LampTone::Amber;
}

bool Telltales::wantsPopup(size_t i, uint32_t now) const {
    if (i >= _n || !popups()) return false;
    const Lamp &l = _lamps[i];
    if (!l.on || l.turn || l.popup == LampPopup::Off) return false;
    if (!l.speedGate || l.spent) return false;
    if (l.snoozed && (int32_t)(now - l.snoozeUntil) < 0) return false;
    return true;
}

void Telltales::shown(size_t i, uint32_t now) {
    if (i >= _n) return;
    Lamp &l = _lamps[i];
    if (!l.showing) { l.showing = true; l.shownSince = now; }
    l.lastShownMs = now;
    if (l.popupSecs && now - l.shownSince >= (uint32_t)l.popupSecs * 1000u)
        acknowledge(i, now);   // timed out: as if tapped
}

void Telltales::acknowledge(size_t i, uint32_t now) {
    if (i >= _n) return;
    Lamp &l = _lamps[i];
    l.showing = false;
    if (l.popup == LampPopup::Repeat) {
        l.snoozed     = true;
        l.snoozeUntil = now + _snoozeMs;
    } else {
        l.spent = true;
    }
}

uint8_t Telltales::rank(size_t i) const {
    const Lamp &l = _lamps[i];
    static const uint8_t toneOrder[] = {0, 1, 3, 2};   // red amber green blue
    return (l.critical ? 0 : 4) + toneOrder[(uint8_t)l.tone & 3];
}

void Telltales::valueText(size_t i, char *out, size_t n) const {
    if (!n) return;
    out[0] = '\0';
    if (i >= _n) return;
    const Lamp &l = _lamps[i];
    float v = NAN;
    if (l.extraMetric)                                          v = l.extra;
    else if (l.rule == LampRule::Above || l.rule == LampRule::Below) v = l.value;
    if (isnan(v)) return;
    if (l.units[0]) snprintf(out, n, "%.*f %s", l.decimals, v, l.units);
    else            snprintf(out, n, "%.*f", l.decimals, v);
}

bool Telltales::iconState(uint8_t icon, uint32_t &rgb, bool &lit) const {
    int best = -1;
    for (size_t i = 0; i < _n; i++) {
        const Lamp &l = _lamps[i];
        if (!l.on || l.icon != icon) continue;
        if (best < 0 || rank(i) < rank((size_t)best)) best = (int)i;
    }
    if (best < 0) return false;
    rgb = toneRgb(_lamps[best].tone);
    lit = _lamps[best].lit;
    return true;
}
